AUTOSAR XML (schema 00044)
package /Predefined_DEV/PortInterfaces
  5 x client server interface, all with is-service=true:
    NvMAdministration
      operation SetBlockProtection: possible-error=NvMAdministration/E_NOT_OK
        arg ProtectionEnabled: type=boolean, direction=IN, server-argument-impl-policy=USE-ARGUMENT-TYPE
      error E_NOT_OK: error-code=1
    NvMNotifyInitBlock
      operation InitBlock
    NvMNotifyJobFinished
      operation JobFinished
        arg ServiceId: type=NvM_ServiceIdType, direction=IN, server-argument-impl-policy=USE-ARGUMENT-TYPE
        arg JobResult: type=NvM_RequestResultType, direction=IN, server-argument-impl-policy=USE-ARGUMENT-TYPE
    NvMService
      operation GetErrorStatus: possible-error=NvMService/E_NOT_OK
        arg ErrorStatus: type=NvM_RequestResultType, direction=OUT, server-argument-impl-policy=USE-ARGUMENT-TYPE
      error E_NOT_OK: error-code=1
    CallbackDTCStatusChange: service-kind=DIAGNOSTIC-EVENT-MANAGER
      operation DTCStatusChanged: possible-error=CallbackDTCStatusChange/E_NOT_OK
        arg DTC: type=uint32, direction=IN, server-argument-impl-policy=USE-ARGUMENT-TYPE
        arg DTCStatusOld: type=Dem_UdsStatusByteType, direction=IN, server-argument-impl-policy=USE-ARGUMENT-TYPE
        arg DTCStatusNew: type=Dem_UdsStatusByteType, direction=IN, server-argument-impl-policy=USE-ARGUMENT-TYPE
      error E_NOT_OK: error-code=1
package /myPackage
  5 x sender receiver interface:
    uint8data
      data data: type=uint8
    uint16data
      data data: type=uint16
    DoorStatus
      data data: type=DoorStatus
    singleData
      data data: type=float32
    boolData
      data data: type=boolean
package /PortInterfaces
  9 x sender receiver interface:
    port01
      data Element1: type=uint16
      data Element2: type=uint8
    int16data
      data Element: type=sint16
    DoorStatus
      data DoorStatus: type=DoorStatus
    DriverSeatHeatStatus
      data DriverSeatHeatStatus: type=DriverSeatHeatStatus
    DriverSeatHeatStatus_1
      data DriverSeatHeatStatus: type=DriverSeatHeatStatus
    DriverSeatHeatStatus_2
      data DriverSeatHeatStatus: type=DriverSeatHeatStatus
    CellVoltage
      16 x data:
        CellVoltage{01..16}: type=CellVoltage{01..16}
    rawCurrentData
      data rawCurrentData: type=rawCurrentData
    DoorStatus_1
      data DoorStatus: type=DoorStatus
