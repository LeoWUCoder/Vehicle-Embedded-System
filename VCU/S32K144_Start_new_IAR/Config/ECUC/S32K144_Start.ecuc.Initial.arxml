AUTOSAR XML (schema 4-2-1)
package /InitialEcuC
  ecuc value collection InitialEcuC: ecuc-values=[Can, CanIf, CanNm, CanSM, Com, ComM, Dcm, Dem, EcuC, EcuM, Nm, PduR]
  module config Can
    CanConfigSet
      CT_CAN00_9df8a959 (CanController):
        CanControllerActivation = true
        CanControllerDefaultBaudrate = CanControllerBaudrateConfig
        CanControllerSystemRef = CT_CAN00
        CanWakeupSourceRef = EcuMCommonConfiguration/CN_CAN00_5e566ad9
        CanControllerBaudrateConfig
      CN_CAN00_5e566ad9_Tx (CanHardwareObject): CanHandleType=BASIC, CanIdValue=0, CanObjectType=TRANSMIT, CanControllerRef=CanConfigSet/CT_CAN00_9df8a959
      CN_CAN00_770af0b0_Rx (CanHardwareObject): CanHandleType=BASIC, CanIdType=STANDARD, CanIdValue=0, CanObjectType=RECEIVE, CanControllerRef=CanConfigSet/CT_CAN00_9df8a959
    CanGeneral: CanIndex=0
  module config CanIf
    CanIfCtrlDrvCfg_7d254554 (CanIfCtrlDrvCfg): CanIfCtrlDrvInitHohConfigRef=CanIfInitHohCfg, CanIfCtrlDrvNameRef=CanGeneral
      CT_CAN00_9df8a959 (CanIfCtrlCfg): CanIfCtrlCanCtrlRef=CanConfigSet/CT_CAN00_9df8a959
    CanIfInitCfg
      CHNL_0fb271d2 (CanIfBufferCfg): CanIfBufferSize=0, CanIfBufferHthRef=CanIfInitHohCfg/CN_CAN00_5e566ad9_Tx
      CanIfInitHohCfg: CanIfInitRefCfgSet=CanConfigSet
        CN_CAN00_770af0b0_Rx (CanIfHrhCfg): CanIfHrhCanCtrlIdRef=CanIfCtrlDrvCfg_7d254554/CT_CAN00_9df8a959, CanIfHrhIdSymRef=CanConfigSet/CN_CAN00_770af0b0_Rx
        CN_CAN00_5e566ad9_Tx (CanIfHthCfg): CanIfHthCanCtrlIdRef=CanIfCtrlDrvCfg_7d254554/CT_CAN00_9df8a959, CanIfHthIdSymRef=CanConfigSet/CN_CAN00_5e566ad9_Tx
      BatteryStatus_oCAN00_9788814a_Rx (CanIfRxPduCfg):
        CanIfRxPduCanId = 258
        CanIfRxPduCanIdType = STANDARD_CAN
        CanIfRxPduDlc = 8
        CanIfRxPduUserRxIndicationName = PduR_CanIfRxIndication
        CanIfRxPduUserRxIndicationUL = PDUR
        CanIfRxPduHrhIdRef = CanIfInitHohCfg/CN_CAN00_770af0b0_Rx
        CanIfRxPduRef = EcucPduCollection/BatteryStatus_oCAN00_26c24fb8_Rx
      BodyStatus_oCAN00_b774dab4_Rx (CanIfRxPduCfg):
        CanIfRxPduCanId = 256
        CanIfRxPduCanIdType = STANDARD_CAN
        CanIfRxPduDlc = 8
        CanIfRxPduUserRxIndicationName = PduR_CanIfRxIndication
        CanIfRxPduUserRxIndicationUL = PDUR
        CanIfRxPduHrhIdRef = CanIfInitHohCfg/CN_CAN00_770af0b0_Rx
        CanIfRxPduRef = EcucPduCollection/BodyStatus_oCAN00_a235940f_Rx
      5 x CanIfTxPduCfg, all with CanIfTxPduCanIdType=STANDARD_CAN, CanIfTxPduDlc=8, CanIfTxPduUserTxConfirmationName=PduR_CanIfTxConfirmation, CanIfTxPduUserTxConfirmationUL=PDUR, CanIfTxPduBufferRef=CanIfInitCfg/CHNL_0fb271d2:
        BattVoltage01_oCAN00_6f293810_Tx: CanIfTxPduCanId=512, CanIfTxPduRef=EcucPduCollection/BattVoltage01_oCAN00_6c2eb606_Tx
        BattVoltage02_oCAN00_c9eb173f_Tx: CanIfTxPduCanId=513, CanIfTxPduRef=EcucPduCollection/BattVoltage02_oCAN00_1acb8f3b_Tx
        BattVoltage03_oCAN00_1d7a0fe5_Tx: CanIfTxPduCanId=514, CanIfTxPduRef=EcucPduCollection/BattVoltage03_oCAN00_81b865ef_Tx
        BattVoltage04_oCAN00_5f1e4f20_Tx: CanIfTxPduCanId=515, CanIfTxPduRef=EcucPduCollection/BattVoltage04_oCAN00_f701fd41_Tx
        SeatStatus_oCAN00_17556e0c_Tx: CanIfTxPduCanId=257, CanIfTxPduRef=EcucPduCollection/SeatStatus_oCAN00_73107919_Tx
    CanIfPrivateCfg: CanIfPrivateSoftwareFilterType=LINEAR
    CanIfPublicCfg: CanIfPublicPnSupport=false
  module config CanNm
    CanNmGlobalConfig:
      CanNmBusSynchronizationEnabled = false
      CanNmPassiveModeEnabled = true
      CanNmPnEiraCalcEnabled = false
      CanNmRemoteSleepIndEnabled = false
      CanNmUserDataEnabled = true
      CAN00_CAN_5faa4e95 (CanNmChannelConfig):
        CanNmMsgReducedTime = 0.05
        CanNmNodeId = 0
        CanNmRepeatMessageTime = 0.4
        CanNmTimeoutTime = 1
        CanNmUserDataLength = 6
        CanNmWaitBusSleepTime = 0.75
        CanNmComMNetworkHandleRef = ComMConfigSet/CN_CAN00_5e566ad9
        CAN00_CAN_5faa4e95_Rx (CanNmRxPdu)
  module config CanSM
    CanSMConfiguration
      CHNL_0fb271d2 (CanSMManagerNetwork): CanSMComMNetworkHandleRef=ComMConfigSet/CN_CAN00_5e566ad9
        CT_CAN00_f3aba03e (CanSMController): CanSMControllerId=CanIfCtrlDrvCfg_7d254554/CT_CAN00_9df8a959
  module config Com
    ComConfig
      7 x ComIPdu, all with ComIPduType=NORMAL:
        BattVoltage01_oCAN00_da960f6f_Tx: ComIPduDirection=SEND, ComIPduGroupRef=MyECU_oCAN00_Tx_1ae5d671, ComIPduSignalRef=CellVoltage01_oBattVoltage01_oCAN00_9716e70d_Tx, ComIPduSignalRef=CellVoltage02_oBattVoltage01_oCAN00_e1f3de30_Tx, ComIPduSignalRef=CellVoltage03_oBattVoltage01_oCAN00_7a8034e4_Tx, ComIPduSignalRef=CellVoltage04_oBattVoltage01_oCAN00_0c39ac4a_Tx, ComPduIdRef=EcucPduCollection/BattVoltage01_oCAN00_da960f6f_Tx
          ComTxIPdu: ComMinimumDelayTime=0, ComTxIPduUnusedAreasDefault=0
            ComTxModeFalse
              ComTxMode: ComTxModeMode=PERIODIC, ComTxModeTimeOffset=0, ComTxModeTimePeriod=0.1
            ComTxModeTrue
              ComTxMode: ComTxModeMode=PERIODIC, ComTxModeTimeOffset=0, ComTxModeTimePeriod=0.1
        BattVoltage02_oCAN00_5419088c_Tx: ComIPduDirection=SEND, ComIPduGroupRef=MyECU_oCAN00_Tx_1ae5d671, ComIPduSignalRef=CellVoltage05_oBattVoltage02_oCAN00_19c5417d_Tx, ComIPduSignalRef=CellVoltage06_oBattVoltage02_oCAN00_6f207840_Tx, ComIPduSignalRef=CellVoltage07_oBattVoltage02_oCAN00_f4539294_Tx, ComIPduSignalRef=CellVoltage08_oBattVoltage02_oCAN00_8253491c_Tx, ComPduIdRef=EcucPduCollection/BattVoltage02_oCAN00_5419088c_Tx
          ComTxIPdu: ComMinimumDelayTime=0, ComTxIPduUnusedAreasDefault=0
            ComTxModeFalse
              ComTxMode: ComTxModeMode=PERIODIC, ComTxModeTimeOffset=0, ComTxModeTimePeriod=0.1
            ComTxModeTrue
              ComTxMode: ComTxModeMode=PERIODIC, ComTxModeTimeOffset=0, ComTxModeTimePeriod=0.1
        BattVoltage03_oCAN00_98b30812_Tx: ComIPduDirection=SEND, ComIPduGroupRef=MyECU_oCAN00_Tx_1ae5d671, ComIPduSignalRef=CellVoltage09_oBattVoltage03_oCAN00_d58aa356_Tx, ComIPduSignalRef=CellVoltage10_oBattVoltage03_oCAN00_cf656f83_Tx, ComIPduSignalRef=CellVoltage11_oBattVoltage03_oCAN00_54168557_Tx, ComIPduSignalRef=CellVoltage12_oBattVoltage03_oCAN00_22f3bc6a_Tx, ComPduIdRef=EcucPduCollection/BattVoltage03_oCAN00_98b30812_Tx
          ComTxIPdu: ComMinimumDelayTime=0, ComTxIPduUnusedAreasDefault=0
            ComTxModeFalse
              ComTxMode: ComTxModeMode=PERIODIC, ComTxModeTimeOffset=0, ComTxModeTimePeriod=0.1
            ComTxModeTrue
              ComTxMode: ComTxModeMode=PERIODIC, ComTxModeTimeOffset=0, ComTxModeTimePeriod=0.1
        BattVoltage04_oCAN00_9276010b_Tx: ComIPduDirection=SEND, ComIPduGroupRef=MyECU_oCAN00_Tx_1ae5d671, ComIPduSignalRef=CellVoltage13_oBattVoltage04_oCAN00_b3455fa7_Tx, ComIPduSignalRef=CellVoltage14_oBattVoltage04_oCAN00_c5fcc709_Tx, ComIPduSignalRef=CellVoltage15_oBattVoltage04_oCAN00_5e8f2ddd_Tx, ComIPduSignalRef=CellVoltage16_oBattVoltage04_oCAN00_286a14e0_Tx, ComPduIdRef=EcucPduCollection/BattVoltage04_oCAN00_9276010b_Tx
          ComTxIPdu: ComMinimumDelayTime=0, ComTxIPduUnusedAreasDefault=0
            ComTxModeFalse
              ComTxMode: ComTxModeMode=PERIODIC, ComTxModeTimeOffset=0, ComTxModeTimePeriod=0.1
            ComTxModeTrue
              ComTxMode: ComTxModeMode=PERIODIC, ComTxModeTimeOffset=0, ComTxModeTimePeriod=0.1
        BatteryStatus_oCAN00_dde93530_Rx: ComIPduDirection=RECEIVE, ComIPduGroupRef=MyECU_oCAN00_Rx_4cbf71f7, ComIPduSignalRef=rawCurrentData_oBatteryStatus_oCAN00_e9e83638_Rx, ComPduIdRef=EcucPduCollection/BatteryStatus_oCAN00_dde93530_Rx
        BodyStatus_oCAN00_b72f18b8_Rx: ComIPduDirection=RECEIVE, ComIPduGroupRef=MyECU_oCAN00_Rx_4cbf71f7, ComIPduSignalRef=AccPedalPosition_oBodyStatus_oCAN00_c6d350a8_Rx, ComIPduSignalRef=BrakePedalPosition_oBodyStatus_oCAN00_a54a2792_Rx, ComIPduSignalRef=DoorStatus_oBodyStatus_oCAN00_ae48aece_Rx, ComIPduSignalRef=HeadLampStatus_oBodyStatus_oCAN00_201d252f_Rx, ComIPduSignalRef=SteeringWheelAngle_oBodyStatus_oCAN00_fc8e2fc0_Rx, ComIPduSignalRef=WindowStatus_oBodyStatus_oCAN00_a8a3dd45_Rx, ComPduIdRef=EcucPduCollection/BodyStatus_oCAN00_b72f18b8_Rx
        SeatStatus_oCAN00_57163e7a_Tx: ComIPduDirection=SEND, ComIPduGroupRef=MyECU_oCAN00_Tx_1ae5d671, ComIPduSignalRef=DriverSeatHeatStatus_oSeatStatus_oCAN00_3348deb2_Tx, ComIPduSignalRef=DriverSeatVentilationStatus_oSeatStatus_oCAN00_bad12d43_Tx, ComIPduSignalRef=PassengerSeatHeatStatus_oSeatStatus_oCAN00_3fdf4506_Tx, ComIPduSignalRef=PassengerSeatVentilationStatus_oSeatStatus_oCAN00_30bae4c8_Tx, ComIPduSignalRef=RearLeftSeatHeatStatus_oSeatStatus_oCAN00_8ea8ef6d_Tx, ComIPduSignalRef=RearLeftSeatVentilationStatus_oSeatStatus_oCAN00_efb0db7f_Tx, ComIPduSignalRef=RearRightSeatHeatStatus_oSeatStatus_oCAN00_fe77aadb_Tx, ComIPduSignalRef=RearRightSeatVentilationStatus_oSeatStatus_oCAN00_931a722e_Tx, ComPduIdRef=EcucPduCollection/SeatStatus_oCAN00_57163e7a_Tx
          ComTxIPdu: ComMinimumDelayTime=0, ComTxIPduUnusedAreasDefault=0
            ComTxModeFalse
              ComTxMode: ComTxModeMode=PERIODIC, ComTxModeTimeOffset=0, ComTxModeTimePeriod=0.1
            ComTxModeTrue
              ComTxMode: ComTxModeMode=PERIODIC, ComTxModeTimeOffset=0, ComTxModeTimePeriod=0.1
      MyECU_oCAN00_Rx_4cbf71f7 (ComIPduGroup)
      MyECU_oCAN00_Tx_1ae5d671 (ComIPduGroup)
      31 x ComSignal, all with ComSignalEndianness=BIG_ENDIAN:
        AccPedalPosition_oBodyStatus_oCAN00_c6d350a8_Rx: ComBitPosition=17, ComBitSize=10, ComSignalInitValue=0, ComSignalType=UINT16, ComTimeout=0, ComSystemTemplateSystemSignalRef=AccPedalPosition
        BrakePedalPosition_oBodyStatus_oCAN00_a54a2792_Rx: ComBitPosition=11, ComBitSize=10, ComSignalInitValue=0, ComSignalType=UINT16, ComTimeout=0, ComSystemTemplateSystemSignalRef=BrakePedalPosition
        CellVoltage01_oBattVoltage01_oCAN00_9716e70d_Tx: ComBitPosition=7, ComBitSize=13, ComSignalInitValue=0, ComSignalType=UINT16, ComTransferProperty=PENDING, ComSystemTemplateSystemSignalRef=CellVoltage01
        CellVoltage02_oBattVoltage01_oCAN00_e1f3de30_Tx: ComBitPosition=10, ComBitSize=13, ComSignalInitValue=0, ComSignalType=UINT16, ComTransferProperty=PENDING, ComSystemTemplateSystemSignalRef=CellVoltage02
        CellVoltage03_oBattVoltage01_oCAN00_7a8034e4_Tx: ComBitPosition=29, ComBitSize=13, ComSignalInitValue=0, ComSignalType=UINT16, ComTransferProperty=PENDING, ComSystemTemplateSystemSignalRef=CellVoltage03
        CellVoltage04_oBattVoltage01_oCAN00_0c39ac4a_Tx: ComBitPosition=32, ComBitSize=13, ComSignalInitValue=0, ComSignalType=UINT16, ComTransferProperty=PENDING, ComSystemTemplateSystemSignalRef=CellVoltage04
        CellVoltage05_oBattVoltage02_oCAN00_19c5417d_Tx: ComBitPosition=7, ComBitSize=13, ComSignalInitValue=0, ComSignalType=UINT16, ComTransferProperty=PENDING, ComSystemTemplateSystemSignalRef=CellVoltage05
        CellVoltage06_oBattVoltage02_oCAN00_6f207840_Tx: ComBitPosition=10, ComBitSize=13, ComSignalInitValue=0, ComSignalType=UINT16, ComTransferProperty=PENDING, ComSystemTemplateSystemSignalRef=CellVoltage06
        CellVoltage07_oBattVoltage02_oCAN00_f4539294_Tx: ComBitPosition=29, ComBitSize=13, ComSignalInitValue=0, ComSignalType=UINT16, ComTransferProperty=PENDING, ComSystemTemplateSystemSignalRef=CellVoltage07
        CellVoltage08_oBattVoltage02_oCAN00_8253491c_Tx: ComBitPosition=32, ComBitSize=13, ComSignalInitValue=0, ComSignalType=UINT16, ComTransferProperty=PENDING, ComSystemTemplateSystemSignalRef=CellVoltage08
        CellVoltage09_oBattVoltage03_oCAN00_d58aa356_Tx: ComBitPosition=7, ComBitSize=13, ComSignalInitValue=0, ComSignalType=UINT16, ComTransferProperty=PENDING, ComSystemTemplateSystemSignalRef=CellVoltage09
        CellVoltage10_oBattVoltage03_oCAN00_cf656f83_Tx: ComBitPosition=10, ComBitSize=13, ComSignalInitValue=0, ComSignalType=UINT16, ComTransferProperty=PENDING, ComSystemTemplateSystemSignalRef=CellVoltage10
        CellVoltage11_oBattVoltage03_oCAN00_54168557_Tx: ComBitPosition=29, ComBitSize=13, ComSignalInitValue=0, ComSignalType=UINT16, ComTransferProperty=PENDING, ComSystemTemplateSystemSignalRef=CellVoltage11
        CellVoltage12_oBattVoltage03_oCAN00_22f3bc6a_Tx: ComBitPosition=32, ComBitSize=13, ComSignalInitValue=0, ComSignalType=UINT16, ComTransferProperty=PENDING, ComSystemTemplateSystemSignalRef=CellVoltage12
        CellVoltage13_oBattVoltage04_oCAN00_b3455fa7_Tx: ComBitPosition=7, ComBitSize=13, ComSignalInitValue=0, ComSignalType=UINT16, ComTransferProperty=PENDING, ComSystemTemplateSystemSignalRef=CellVoltage13
        CellVoltage14_oBattVoltage04_oCAN00_c5fcc709_Tx: ComBitPosition=10, ComBitSize=13, ComSignalInitValue=0, ComSignalType=UINT16, ComTransferProperty=PENDING, ComSystemTemplateSystemSignalRef=CellVoltage14
        CellVoltage15_oBattVoltage04_oCAN00_5e8f2ddd_Tx: ComBitPosition=29, ComBitSize=13, ComSignalInitValue=0, ComSignalType=UINT16, ComTransferProperty=PENDING, ComSystemTemplateSystemSignalRef=CellVoltage15
        CellVoltage16_oBattVoltage04_oCAN00_286a14e0_Tx: ComBitPosition=32, ComBitSize=13, ComSignalInitValue=0, ComSignalType=UINT16, ComTransferProperty=PENDING, ComSystemTemplateSystemSignalRef=CellVoltage16
        DoorStatus_oBodyStatus_oCAN00_ae48aece_Rx: ComBitPosition=3, ComBitSize=4, ComSignalInitValue=0, ComSignalType=UINT8, ComTimeout=0, ComSystemTemplateSystemSignalRef=DoorStatus
        DriverSeatHeatStatus_oSeatStatus_oCAN00_3348deb2_Tx: ComBitPosition=23, ComBitSize=4, ComSignalInitValue=0, ComSignalType=UINT8, ComTransferProperty=PENDING, ComSystemTemplateSystemSignalRef=DriverSeatHeatStatus
        DriverSeatVentilationStatus_oSeatStatus_oCAN00_bad12d43_Tx: ComBitPosition=7, ComBitSize=4, ComSignalInitValue=0, ComSignalType=UINT8, ComTransferProperty=PENDING, ComSystemTemplateSystemSignalRef=DriverSeatVentilationStatus
        HeadLampStatus_oBodyStatus_oCAN00_201d252f_Rx: ComBitPosition=7, ComBitSize=4, ComSignalInitValue=0, ComSignalType=UINT8, ComTimeout=0, ComSystemTemplateSystemSignalRef=HeadLampStatus
        PassengerSeatHeatStatus_oSeatStatus_oCAN00_3fdf4506_Tx: ComBitPosition=19, ComBitSize=4, ComSignalInitValue=0, ComSignalType=UINT8, ComTransferProperty=PENDING, ComSystemTemplateSystemSignalRef=PassengerSeatHeatStatus
        PassengerSeatVentilationStatus_oSeatStatus_oCAN00_30bae4c8_Tx: ComBitPosition=3, ComBitSize=4, ComSignalInitValue=0, ComSignalType=UINT8, ComTransferProperty=PENDING, ComSystemTemplateSystemSignalRef=PassengerSeatVentilationStatus
        RearLeftSeatHeatStatus_oSeatStatus_oCAN00_8ea8ef6d_Tx: ComBitPosition=31, ComBitSize=4, ComSignalInitValue=0, ComSignalType=UINT8, ComTransferProperty=PENDING, ComSystemTemplateSystemSignalRef=RearLeftSeatHeatStatus
        RearLeftSeatVentilationStatus_oSeatStatus_oCAN00_efb0db7f_Tx: ComBitPosition=15, ComBitSize=4, ComSignalInitValue=0, ComSignalType=UINT8, ComTransferProperty=PENDING, ComSystemTemplateSystemSignalRef=RearLeftSeatVentilationStatus
        RearRightSeatHeatStatus_oSeatStatus_oCAN00_fe77aadb_Tx: ComBitPosition=27, ComBitSize=4, ComSignalInitValue=0, ComSignalType=UINT8, ComTransferProperty=PENDING, ComSystemTemplateSystemSignalRef=RearRightSeatHeatStatus
        RearRightSeatVentilationStatus_oSeatStatus_oCAN00_931a722e_Tx: ComBitPosition=11, ComBitSize=4, ComSignalInitValue=0, ComSignalType=UINT8, ComTransferProperty=PENDING, ComSystemTemplateSystemSignalRef=RearRightSeatVentilationStatus
        SteeringWheelAngle_oBodyStatus_oCAN00_fc8e2fc0_Rx: ComBitPosition=39, ComBitSize=16, ComSignalInitValue=0, ComSignalType=SINT16, ComTimeout=0, ComSystemTemplateSystemSignalRef=SteeringWheelAngle
        WindowStatus_oBodyStatus_oCAN00_a8a3dd45_Rx: ComBitPosition=15, ComBitSize=4, ComSignalInitValue=0, ComSignalType=UINT8, ComTimeout=0, ComSystemTemplateSystemSignalRef=WindowStatus
        rawCurrentData_oBatteryStatus_oCAN00_e9e83638_Rx: ComBitPosition=7, ComBitSize=16, ComSignalInitValue=32768, ComSignalType=UINT16, ComTimeout=0, ComSystemTemplateSystemSignalRef=rawCurrentData
    ComGeneral
  module config ComM
    ComMConfigSet: ComMPncEnabled=false
      CN_CAN00_5e566ad9 (ComMChannel): ComMBusType=COMM_BUS_TYPE_CAN, ComMChannelId=0
        ComMNetworkManagement: ComMNmVariant=PASSIVE
        CN_CAN00_cd7594b0 (ComMUserPerChannel): ComMUserChannel=CN_CAN00_06ecbb07
      CN_CAN00_06ecbb07 (ComMUser): ComMUserIdentifier=0
    ComMGeneral: ComMPncIdCounting=COMM_PNC_ID_COUNT_FROM_NM_MESSAGE, ComMPncSupport=false
  module config Dcm
    DcmConfigSet  # Diagnostics Data Import
      DcmDsp: DcmDspMaxDidToRead=5  # Diagnostics Data Import
        DcmDspSession  # Diagnostics Data Import
          3 x DcmDspSessionRow, all with DcmDspSessionP2ServerMax=0.05, DcmDspSessionP2StarServerMax=5:
            Extended: DcmDspSessionLevel=3, DcmDspSessionForBoot=DCM_NO_BOOT  # Diagnostics Data Import
            Programming: DcmDspSessionLevel=2  # Diagnostics Data Import
            Default: DcmDspSessionLevel=1, DcmDspSessionForBoot=DCM_NO_BOOT  # Diagnostics Data Import
        DcmDspSecurity  # Diagnostics Data Import
          Level_01 (DcmDspSecurityRow):  # Diagnostics Data Import
            DcmDspSecurityDelayTime = 10
            DcmDspSecurityDelayTimeOnBoot = 0
            DcmDspSecurityKeySize = 2
            DcmDspSecurityLevel = 1
            DcmDspSecurityNumAttDelay = 3
            DcmDspSecuritySeedSize = 2
        DcmDspControlDTCSetting: DcmSupportDTCSettingControlOptionRecord=true  # Diagnostics Data Import
        DidInfo_Diag_RWDI_LightOnOffCounter (DcmDspDidInfo)  # Diagnostics Data Import
          DcmDspDidAccess  # Diagnostics Data Import
            DcmDspDidWrite  # Diagnostics Data Import
            DcmDspDidRead  # Diagnostics Data Import
        Diag_RWDI_LightOnOffCounter (DcmDspDid): DcmDspDidIdentifier=4096, DcmDspDidInfoRef=DidInfo_Diag_RWDI_LightOnOffCounter  # Diagnostics Data Import
          LightOnOffCounter_Value (DcmDspDidSignal): DcmDspDidDataPos=0, DcmDspDidDataRef=Diag_RWDI_LightOnOffCounter_LightOnOffCounter_Value  # Diagnostics Data Import
        DataInfo_Diag_RWDI_LightOnOffCounter_LightOnOffCounter_Value (DcmDspDataInfo): DcmDspDataFixedLength=true  # Diagnostics Data Import
        Diag_RWDI_LightOnOffCounter_LightOnOffCounter_Value (DcmDspData): DcmDspDataSize=32, DcmDspDataType=UINT32, DcmDspDataInfoRef=DataInfo_Diag_RWDI_LightOnOffCounter_LightOnOffCounter_Value  # Diagnostics Data Import
      DcmDsd  # Diagnostics Data Import
        DcmDsdServiceTable  # Diagnostics Data Import
          9 x DcmDsdService:
            ControlDtcSetting: DcmDsdSidTabServiceId=133, DcmDsdSidTabSubfuncAvail=true  # Diagnostics Data Import
              Disable (DcmDsdSubService): DcmDsdSubServiceId=2  # Diagnostics Data Import
              Enable (DcmDsdSubService): DcmDsdSubServiceId=1  # Diagnostics Data Import
            TesterPresent: DcmDsdSidTabServiceId=62, DcmDsdSidTabSubfuncAvail=true  # Diagnostics Data Import
              TesterPresent (DcmDsdSubService): DcmDsdSubServiceId=0  # Diagnostics Data Import
            WriteDataById: DcmDsdSidTabServiceId=46, DcmDsdSidTabSubfuncAvail=false  # Diagnostics Data Import
            SecurityAccess: DcmDsdSidTabServiceId=39, DcmDsdSidTabSubfuncAvail=true, DcmDsdSidTabSessionLevelRef=DcmDspSession/Programming, DcmDsdSidTabSessionLevelRef=DcmDspSession/Extended  # Diagnostics Data Import
              Level1_1_Send (DcmDsdSubService): DcmDsdSubServiceId=2, DcmDsdSubServiceSessionLevelRef=DcmDspSession/Programming, DcmDsdSubServiceSessionLevelRef=DcmDspSession/Extended  # Diagnostics Data Import
              Seed_Level1_Request (DcmDsdSubService): DcmDsdSubServiceId=1, DcmDsdSubServiceSessionLevelRef=DcmDspSession/Programming, DcmDsdSubServiceSessionLevelRef=DcmDspSession/Extended  # Diagnostics Data Import
            ReadDataById: DcmDsdSidTabServiceId=34, DcmDsdSidTabSubfuncAvail=false  # Diagnostics Data Import
            ReadDtcInfo: DcmDsdSidTabServiceId=25, DcmDsdSidTabSubfuncAvail=true  # Diagnostics Data Import
              3 x DcmDsdSubService:
                RDTCEDRBDN: DcmDsdSubServiceId=6  # Diagnostics Data Import
                RNODTCBSM: DcmDsdSubServiceId=1  # Diagnostics Data Import
                RDTCBSM: DcmDsdSubServiceId=2  # Diagnostics Data Import
            ClearDiagInfo: DcmDsdSidTabServiceId=20, DcmDsdSidTabSubfuncAvail=false  # Diagnostics Data Import
            EcuReset: DcmDsdSidTabServiceId=17, DcmDsdSidTabSubfuncAvail=true  # Diagnostics Data Import
              Hard (DcmDsdSubService): DcmDsdSubServiceId=1  # Diagnostics Data Import
            DiagSessionControl: DcmDsdSidTabServiceId=16, DcmDsdSidTabSubfuncAvail=true  # Diagnostics Data Import
              3 x DcmDsdSubService:
                Extended: DcmDsdSubServiceId=3  # Diagnostics Data Import
                Programming: DcmDsdSubServiceId=2, DcmDsdSubServiceSessionLevelRef=DcmDspSession/Programming, DcmDsdSubServiceSessionLevelRef=DcmDspSession/Extended  # Diagnostics Data Import
                Default: DcmDsdSubServiceId=1  # Diagnostics Data Import
      DcmGeneral  # Diagnostics Data Import
  module config Dem
    DemGeneral:  # Diagnostics Data Import
      DemAgingCycleCounterProcessing = DEM_PROCESS_AGINGCTR_INTERN
      DemDebounceCounterBasedSupport = true
      DemDtcStatusAvailabilityMask = 121
      DemMaxNumberEventEntryMirror = 0
      DemPTOSupport = false
      DemTypeOfFreezeFrameRecordNumeration = DEM_FF_RECNUM_CALCULATED
      OdometerValue_OdometerValue (DemDataClass):  # Diagnostics Data Import
        DemDataElementDataSize = 4
        DemDataElementDataType = UINT32
        DemDataElementEndianness = LITTLE_ENDIAN
        DemDataElementUsePort = USE_DATA_CLIENT_SERVER_PORT
        DemDataElementStoreNonVolatile = true
      OccurrenceCounter_OccurenceCounter (DemDataClass):  # Diagnostics Data Import
        DemDataElementDataSize = 4
        DemDataElementDataType = UINT32
        DemDataElementEndianness = LITTLE_ENDIAN
        DemDataElementUsePort = USE_DATA_CLIENT_SERVER_PORT
        DemDataElementStoreNonVolatile = true
      PowerCycle (DemOperationCycle): DemOperationCycleType=DEM_OPCYC_POWER  # Diagnostics Data Import
      IgnitionCycle (DemOperationCycle): DemOperationCycleType=DEM_OPCYC_IGNITION  # Diagnostics Data Import
      OdometerValue (DemExtendedDataRecordClass): DemExtendedDataRecordNumber=2, DemDataClassRef=OdometerValue_OdometerValue  # Diagnostics Data Import
      OccurrenceCounter (DemExtendedDataRecordClass): DemExtendedDataRecordNumber=1, DemDataClassRef=OccurrenceCounter_OccurenceCounter  # Diagnostics Data Import
      ExtendedDataClass_4f5344cd (DemExtendedDataClass): DemExtendedDataRecordClassRef=OccurrenceCounter, DemExtendedDataRecordClassRef=OdometerValue  # Diagnostics Data Import
    DemConfigSet  # Diagnostics Data Import
      DTC_0x000002 (DemEventParameter): DemEventKind=DEM_EVENT_KIND_SWC, DemDTCClassRef=DTCClass_DTC_0x000002, DemExtendedDataClassRef=ExtendedDataClass_4f5344cd  # Diagnostics Data Import
        DemEventClass:  # Diagnostics Data Import
          DemAgingAllowed = false
          DemAgingCycleCounterThreshold = 1
          DemEventDestination = DEM_DTC_ORIGIN_PRIMARY_MEMORY
          DemEventPriority = 2
          DemAgingCycleRef = IgnitionCycle
          DemOperationCycleRef = IgnitionCycle
          DemDebounceAlgorithmClass  # Diagnostics Data Import
            DemDebounceCounterBased: DemDebounceCounterDecrementStepSize=1, DemDebounceCounterIncrementStepSize=1, DemDebounceCounterJumpDown=false, DemDebounceCounterJumpUp=true  # Diagnostics Data Import
      DTCClass_DTC_0x000002 (DemDTCClass): DemUdsDTC=2  # Diagnostics Data Import
  module config EcuC
    EcucPduCollection: PduIdTypeEnum=UINT8, PduLengthTypeEnum=UINT8
      14 x Pdu, all with PduLength=8:
        BattVoltage01_oCAN00_6c2eb606_Tx: SysTPduToFrameMappingRef=BattVoltage01
        BattVoltage01_oCAN00_da960f6f_Tx
        BattVoltage02_oCAN00_1acb8f3b_Tx: SysTPduToFrameMappingRef=BattVoltage02
        BattVoltage02_oCAN00_5419088c_Tx
        BattVoltage03_oCAN00_81b865ef_Tx: SysTPduToFrameMappingRef=BattVoltage03
        BattVoltage03_oCAN00_98b30812_Tx
        BattVoltage04_oCAN00_9276010b_Tx
        BattVoltage04_oCAN00_f701fd41_Tx: SysTPduToFrameMappingRef=BattVoltage04
        BatteryStatus_oCAN00_26c24fb8_Rx: SysTPduToFrameMappingRef=BatteryStatus
        BatteryStatus_oCAN00_dde93530_Rx
        BodyStatus_oCAN00_a235940f_Rx: SysTPduToFrameMappingRef=BodyStatus
        BodyStatus_oCAN00_b72f18b8_Rx
        SeatStatus_oCAN00_57163e7a_Tx
        SeatStatus_oCAN00_73107919_Tx: SysTPduToFrameMappingRef=SeatStatus
  module config EcuM
    EcuMConfiguration
      EcuMCommonConfiguration
        EcuMDriverInitListOne
        EcuMDriverRestartList
        CN_CAN00_5e566ad9 (EcuMWakeupSource): EcuMWakeupSourceId=5, EcuMComMChannelRef=ComMConfigSet/CN_CAN00_5e566ad9
      EcuMFlexConfiguration: EcuMFlexModuleConfigurationRef=CanConfigSet
  module config Nm
    CN_CAN00_5e566ad9 (NmChannelConfig): NmPassiveModeEnabled=true, NmComMChannelRef=ComMConfigSet/CN_CAN00_5e566ad9
      CAN00_CAN_5faa4e95 (NmBusType)
        NmStandardBusNmConfig: NmStandardBusType=NM_BUSNM_CANNM  # CAN00_CAN
    NmGlobalConfig
      NmGlobalFeatures: NmBusSynchronizationEnabled=false, NmNodeIdEnabled=true, NmUserDataEnabled=true
      NmGlobalProperties
  module config PduR
    PduRGeneral
    PduRRoutingTables
      PduRRoutingTable
        7 x PduRRoutingPath:
          BattVoltage01_oCAN00_da960f6f_Tx
            BattVoltage01_oCAN00_6c2eb606_Tx (PduRDestPdu): PduRDestPduRef=EcucPduCollection/BattVoltage01_oCAN00_6c2eb606_Tx
            PduRSrcPdu_882601b8 (PduRSrcPdu): PduRSrcPduRef=EcucPduCollection/BattVoltage01_oCAN00_da960f6f_Tx
          BattVoltage02_oCAN00_5419088c_Tx
            BattVoltage02_oCAN00_1acb8f3b_Tx (PduRDestPdu): PduRDestPduRef=EcucPduCollection/BattVoltage02_oCAN00_1acb8f3b_Tx
            PduRSrcPdu_1d1094fa (PduRSrcPdu): PduRSrcPduRef=EcucPduCollection/BattVoltage02_oCAN00_5419088c_Tx
          BattVoltage03_oCAN00_98b30812_Tx
            BattVoltage03_oCAN00_81b865ef_Tx (PduRDestPdu): PduRDestPduRef=EcucPduCollection/BattVoltage03_oCAN00_81b865ef_Tx
            PduRSrcPdu_ccefb638 (PduRSrcPdu): PduRSrcPduRef=EcucPduCollection/BattVoltage03_oCAN00_98b30812_Tx
          BattVoltage04_oCAN00_9276010b_Tx
            BattVoltage04_oCAN00_f701fd41_Tx (PduRDestPdu): PduRDestPduRef=EcucPduCollection/BattVoltage04_oCAN00_f701fd41_Tx
            PduRSrcPdu_9bcefde5 (PduRSrcPdu): PduRSrcPduRef=EcucPduCollection/BattVoltage04_oCAN00_9276010b_Tx
          BatteryStatus_oCAN00_26c24fb8_Rx
            BatteryStatus_oCAN00_26c24fb8_Rx_838eb9ca_Rx (PduRDestPdu): PduRDestPduRef=EcucPduCollection/BatteryStatus_oCAN00_dde93530_Rx
            PduRSrcPdu_838eb9ca (PduRSrcPdu): PduRSrcPduRef=EcucPduCollection/BatteryStatus_oCAN00_26c24fb8_Rx
          BodyStatus_oCAN00_a235940f_Rx
            BodyStatus_oCAN00_a235940f_Rx_5b31d4cf_Rx (PduRDestPdu): PduRDestPduRef=EcucPduCollection/BodyStatus_oCAN00_b72f18b8_Rx
            PduRSrcPdu_5b31d4cf (PduRSrcPdu): PduRSrcPduRef=EcucPduCollection/BodyStatus_oCAN00_a235940f_Rx
          SeatStatus_oCAN00_57163e7a_Tx
            SeatStatus_oCAN00_73107919_Tx (PduRDestPdu): PduRDestPduRef=EcucPduCollection/SeatStatus_oCAN00_73107919_Tx
            PduRSrcPdu_b36f7279 (PduRSrcPdu): PduRSrcPduRef=EcucPduCollection/SeatStatus_oCAN00_57163e7a_Tx
