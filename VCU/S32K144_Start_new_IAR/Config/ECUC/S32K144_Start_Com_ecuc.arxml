AUTOSAR XML (schema 4-2-1)
package /ActiveEcuC
  module config Com: implementation-config-variant=VARIANT-PRE-COMPILE, module-description=Com_Impl
    ComGeneration:
      ComOutOfBoundsWriteProtectionStrategy = NONE
      ComOutOfBoundsWriteSanitizer = false
      ComOutOfBoundsReadSanitizer = false
      ComReduceConstantData2Define = false
      ComBoolDataInArrayOfStructStrategy = BOOLEAN
      ComDeduplicateIndirectedData = true
      ComDataDeduplicationStrategy = WITH_CAST
      ComReduceBoolDataByNegationThreshold = 2
      ComReduceBoolDataByNumericalComparisonThreshold = 2
      ComReduceBoolDataByNumericalRelationThreshold = 2
      ComReduceBoolDataByNumericalOperandStrategy = WITH_ANY_VALUE
      ComReduceNumericalDataByOffsetThreshold = 2
      ComReduceNumericalDataByArraySubtractionThreshold = 2
      ComReduceDataByStreaming = false
      ComShortSymbols = false
      ComInterfacesForDeactivatedData = false
      ComReferringKeysInComments = false
    ComOptimization:
      ComTxCyclicProcessingISRLockThreshold = 1
      ComTxDeadlineMonitoringISRLockThreshold = 1
      ComTxProcessingISRLockThreshold = 1
      ComRxDeadlineMonitoringISRLockThreshold = 1
      ComRxDeferredProcessingISRLockThreshold = 1
      ComGatewayProcessingISRLockThreshold = 1
      ComGatewayDescriptionProcessingISRLockThreshold = 1
      ComIPduGroupISRLockThreshold = 1
    ComConfig: ComConfigurationId=0, ComRxDeferredNotificationCacheSize=0, ComRxImmediateNotificationCacheSize=0
      MyECU_oCAN00_Rx_4cbf71f7 (ComIPduGroup): ComIPduGroupHandleId=0
      ComTimeBase: ComRxTimeBase=0.01, ComTxTimeBase=0.01, ComGwTimeBase=0.01
      MyECU_oCAN00_Tx_1ae5d671 (ComIPduGroup): ComIPduGroupHandleId=1
      BattVoltage02_oCAN00_5419088c_Tx (ComIPdu):
        ComIPduDirection = SEND
        ComIPduType = NORMAL
        ComIPduHandleId = 1
        ComIPduSignalProcessing = DEFERRED
        ComIPduCancellationSupport = false
        ComIPduGroupRef = MyECU_oCAN00_Tx_1ae5d671
        ComIPduSignalRef = CellVoltage05_oBattVoltage02_oCAN00_19c5417d_Tx
        ComIPduSignalRef = CellVoltage06_oBattVoltage02_oCAN00_6f207840_Tx
        ComIPduSignalRef = CellVoltage07_oBattVoltage02_oCAN00_f4539294_Tx
        ComIPduSignalRef = CellVoltage08_oBattVoltage02_oCAN00_8253491c_Tx
        ComPduIdRef = BattVoltage02_oCAN00_5419088c_Tx
        ComTxIPdu: ComMinimumDelayTime=0, ComTxIPduUnusedAreasDefault=0
          ComTxModeTrue
            ComTxMode: ComTxModeMode=PERIODIC, ComTxModeTimeOffset=0, ComTxModeTimePeriod=0.1
          ComTxModeFalse
            ComTxMode: ComTxModeMode=PERIODIC, ComTxModeTimeOffset=0, ComTxModeTimePeriod=0.1
      5 x ComSignal, all with ComBitSize=13, ComSignalEndianness=BIG_ENDIAN, ComSignalInitValue=0, ComSignalType=UINT16, ComTransferProperty=PENDING, ComSignalAccess=ACCESS_UNCLEAR:
        CellVoltage10_oBattVoltage03_oCAN00_cf656f83_Tx: ComBitPosition=10, ComHandleId=9, ComSystemTemplateSystemSignalRef=CellVoltage10
        CellVoltage15_oBattVoltage04_oCAN00_5e8f2ddd_Tx: ComBitPosition=29, ComHandleId=14, ComSystemTemplateSystemSignalRef=CellVoltage15
        CellVoltage08_oBattVoltage02_oCAN00_8253491c_Tx: ComBitPosition=32, ComHandleId=7, ComSystemTemplateSystemSignalRef=CellVoltage08
        CellVoltage05_oBattVoltage02_oCAN00_19c5417d_Tx: ComBitPosition=7, ComHandleId=4, ComSystemTemplateSystemSignalRef=CellVoltage05
        CellVoltage11_oBattVoltage03_oCAN00_54168557_Tx: ComBitPosition=29, ComHandleId=10, ComSystemTemplateSystemSignalRef=CellVoltage11
      BattVoltage03_oCAN00_98b30812_Tx (ComIPdu):
        ComIPduDirection = SEND
        ComIPduType = NORMAL
        ComIPduHandleId = 2
        ComIPduSignalProcessing = DEFERRED
        ComIPduCancellationSupport = false
        ComIPduGroupRef = MyECU_oCAN00_Tx_1ae5d671
        ComIPduSignalRef = CellVoltage09_oBattVoltage03_oCAN00_d58aa356_Tx
        ComIPduSignalRef = CellVoltage10_oBattVoltage03_oCAN00_cf656f83_Tx
        ComIPduSignalRef = CellVoltage11_oBattVoltage03_oCAN00_54168557_Tx
        ComIPduSignalRef = CellVoltage12_oBattVoltage03_oCAN00_22f3bc6a_Tx
        ComPduIdRef = BattVoltage03_oCAN00_98b30812_Tx
        ComTxIPdu: ComMinimumDelayTime=0, ComTxIPduUnusedAreasDefault=0
          ComTxModeTrue
            ComTxMode: ComTxModeMode=PERIODIC, ComTxModeTimeOffset=0, ComTxModeTimePeriod=0.1
          ComTxModeFalse
            ComTxMode: ComTxModeMode=PERIODIC, ComTxModeTimeOffset=0, ComTxModeTimePeriod=0.1
      11 x ComSignal, all with ComSignalEndianness=BIG_ENDIAN, ComSignalInitValue=0, ComSignalAccess=ACCESS_UNCLEAR:
        CellVoltage06_oBattVoltage02_oCAN00_6f207840_Tx: ComBitPosition=10, ComBitSize=13, ComSignalType=UINT16, ComTransferProperty=PENDING, ComHandleId=5, ComSystemTemplateSystemSignalRef=CellVoltage06
        CellVoltage14_oBattVoltage04_oCAN00_c5fcc709_Tx: ComBitPosition=10, ComBitSize=13, ComSignalType=UINT16, ComTransferProperty=PENDING, ComHandleId=13, ComSystemTemplateSystemSignalRef=CellVoltage14
        BrakePedalPosition_oBodyStatus_oCAN00_a54a2792_Rx: ComBitPosition=11, ComBitSize=10, ComSignalType=UINT16, ComTimeout=0, ComHandleId=1, ComSystemTemplateSystemSignalRef=BrakePedalPosition
        WindowStatus_oBodyStatus_oCAN00_a8a3dd45_Rx: ComBitPosition=15, ComBitSize=4, ComSignalType=UINT8, ComTimeout=0, ComHandleId=5, ComSystemTemplateSystemSignalRef=WindowStatus
        CellVoltage07_oBattVoltage02_oCAN00_f4539294_Tx: ComBitPosition=29, ComBitSize=13, ComSignalType=UINT16, ComTransferProperty=PENDING, ComHandleId=6, ComSystemTemplateSystemSignalRef=CellVoltage07
        CellVoltage03_oBattVoltage01_oCAN00_7a8034e4_Tx: ComBitPosition=29, ComBitSize=13, ComSignalType=UINT16, ComTransferProperty=PENDING, ComHandleId=2, ComSystemTemplateSystemSignalRef=CellVoltage03
        AccPedalPosition_oBodyStatus_oCAN00_c6d350a8_Rx: ComBitPosition=17, ComBitSize=10, ComSignalType=UINT16, ComTimeout=0, ComHandleId=0, ComSystemTemplateSystemSignalRef=AccPedalPosition
        HeadLampStatus_oBodyStatus_oCAN00_201d252f_Rx: ComBitPosition=7, ComBitSize=4, ComSignalType=UINT8, ComTimeout=0, ComHandleId=3, ComSystemTemplateSystemSignalRef=HeadLampStatus
        CellVoltage13_oBattVoltage04_oCAN00_b3455fa7_Tx: ComBitPosition=7, ComBitSize=13, ComSignalType=UINT16, ComTransferProperty=PENDING, ComHandleId=12, ComSystemTemplateSystemSignalRef=CellVoltage13
        CellVoltage16_oBattVoltage04_oCAN00_286a14e0_Tx: ComBitPosition=32, ComBitSize=13, ComSignalType=UINT16, ComTransferProperty=PENDING, ComHandleId=15, ComSystemTemplateSystemSignalRef=CellVoltage16
        SteeringWheelAngle_oBodyStatus_oCAN00_fc8e2fc0_Rx: ComBitPosition=39, ComBitSize=16, ComSignalType=SINT16, ComTimeout=0, ComHandleId=4, ComSystemTemplateSystemSignalRef=SteeringWheelAngle
      BattVoltage04_oCAN00_9276010b_Tx (ComIPdu):
        ComIPduDirection = SEND
        ComIPduType = NORMAL
        ComIPduHandleId = 3
        ComIPduSignalProcessing = DEFERRED
        ComIPduCancellationSupport = false
        ComIPduGroupRef = MyECU_oCAN00_Tx_1ae5d671
        ComIPduSignalRef = CellVoltage13_oBattVoltage04_oCAN00_b3455fa7_Tx
        ComIPduSignalRef = CellVoltage14_oBattVoltage04_oCAN00_c5fcc709_Tx
        ComIPduSignalRef = CellVoltage15_oBattVoltage04_oCAN00_5e8f2ddd_Tx
        ComIPduSignalRef = CellVoltage16_oBattVoltage04_oCAN00_286a14e0_Tx
        ComPduIdRef = BattVoltage04_oCAN00_9276010b_Tx
        ComTxIPdu: ComMinimumDelayTime=0, ComTxIPduUnusedAreasDefault=0
          ComTxModeTrue
            ComTxMode: ComTxModeMode=PERIODIC, ComTxModeTimeOffset=0, ComTxModeTimePeriod=0.1
          ComTxModeFalse
            ComTxMode: ComTxModeMode=PERIODIC, ComTxModeTimeOffset=0, ComTxModeTimePeriod=0.1
      BodyStatus_oCAN00_b72f18b8_Rx (ComIPdu):
        ComIPduDirection = RECEIVE
        ComIPduType = NORMAL
        ComIPduHandleId = 1
        ComIPduSignalProcessing = DEFERRED
        ComIPduCancellationSupport = false
        ComIPduGroupRef = MyECU_oCAN00_Rx_4cbf71f7
        ComIPduSignalRef = AccPedalPosition_oBodyStatus_oCAN00_c6d350a8_Rx
        ComIPduSignalRef = BrakePedalPosition_oBodyStatus_oCAN00_a54a2792_Rx
        ComIPduSignalRef = DoorStatus_oBodyStatus_oCAN00_ae48aece_Rx
        ComIPduSignalRef = HeadLampStatus_oBodyStatus_oCAN00_201d252f_Rx
        ComIPduSignalRef = SteeringWheelAngle_oBodyStatus_oCAN00_fc8e2fc0_Rx
        ComIPduSignalRef = WindowStatus_oBodyStatus_oCAN00_a8a3dd45_Rx
        ComPduIdRef = BodyStatus_oCAN00_b72f18b8_Rx
      CellVoltage04_oBattVoltage01_oCAN00_0c39ac4a_Tx (ComSignal):
        ComBitPosition = 32
        ComBitSize = 13
        ComSignalEndianness = BIG_ENDIAN
        ComSignalInitValue = 0
        ComSignalType = UINT16
        ComTransferProperty = PENDING
        ComSignalAccess = ACCESS_UNCLEAR
        ComHandleId = 3
        ComSystemTemplateSystemSignalRef = CellVoltage04
      DoorStatus_oBodyStatus_oCAN00_ae48aece_Rx (ComSignal):
        ComBitPosition = 3
        ComBitSize = 4
        ComSignalEndianness = BIG_ENDIAN
        ComSignalInitValue = 0
        ComSignalType = UINT8
        ComTimeout = 0
        ComSignalAccess = ACCESS_UNCLEAR
        ComHandleId = 2
        ComSystemTemplateSystemSignalRef = DoorStatus
      BattVoltage01_oCAN00_da960f6f_Tx (ComIPdu):
        ComIPduDirection = SEND
        ComIPduType = NORMAL
        ComIPduHandleId = 0
        ComIPduSignalProcessing = DEFERRED
        ComIPduCancellationSupport = false
        ComIPduGroupRef = MyECU_oCAN00_Tx_1ae5d671
        ComIPduSignalRef = CellVoltage01_oBattVoltage01_oCAN00_9716e70d_Tx
        ComIPduSignalRef = CellVoltage02_oBattVoltage01_oCAN00_e1f3de30_Tx
        ComIPduSignalRef = CellVoltage03_oBattVoltage01_oCAN00_7a8034e4_Tx
        ComIPduSignalRef = CellVoltage04_oBattVoltage01_oCAN00_0c39ac4a_Tx
        ComPduIdRef = BattVoltage01_oCAN00_da960f6f_Tx
        ComTxIPdu: ComMinimumDelayTime=0, ComTxIPduUnusedAreasDefault=0
          ComTxModeTrue
            ComTxMode: ComTxModeMode=PERIODIC, ComTxModeTimeOffset=0, ComTxModeTimePeriod=0.1
          ComTxModeFalse
            ComTxMode: ComTxModeMode=PERIODIC, ComTxModeTimeOffset=0, ComTxModeTimePeriod=0.1
      5 x ComSignal, all with ComSignalEndianness=BIG_ENDIAN, ComSignalInitValue=0, ComTransferProperty=PENDING, ComSignalAccess=ACCESS_UNCLEAR:
        CellVoltage01_oBattVoltage01_oCAN00_9716e70d_Tx: ComBitPosition=7, ComBitSize=13, ComSignalType=UINT16, ComHandleId=0, ComSystemTemplateSystemSignalRef=CellVoltage01
        CellVoltage12_oBattVoltage03_oCAN00_22f3bc6a_Tx: ComBitPosition=32, ComBitSize=13, ComSignalType=UINT16, ComHandleId=11, ComSystemTemplateSystemSignalRef=CellVoltage12
        CellVoltage02_oBattVoltage01_oCAN00_e1f3de30_Tx: ComBitPosition=10, ComBitSize=13, ComSignalType=UINT16, ComHandleId=1, ComSystemTemplateSystemSignalRef=CellVoltage02
        CellVoltage09_oBattVoltage03_oCAN00_d58aa356_Tx: ComBitPosition=7, ComBitSize=13, ComSignalType=UINT16, ComHandleId=8, ComSystemTemplateSystemSignalRef=CellVoltage09
        DriverSeatHeatStatus_oSeatStatus_oCAN00_3348deb2_Tx: ComBitPosition=23, ComBitSize=4, ComSignalType=UINT8, ComHandleId=16, ComSystemTemplateSystemSignalRef=DriverSeatHeatStatus
      SeatStatus_oCAN00_57163e7a_Tx (ComIPdu):
        ComIPduDirection = SEND
        ComIPduType = NORMAL
        ComIPduHandleId = 4
        ComIPduSignalProcessing = DEFERRED
        ComIPduCancellationSupport = false
        ComIPduGroupRef = MyECU_oCAN00_Tx_1ae5d671
        ComIPduSignalRef = DriverSeatHeatStatus_oSeatStatus_oCAN00_3348deb2_Tx
        ComIPduSignalRef = DriverSeatVentilationStatus_oSeatStatus_oCAN00_bad12d43_Tx
        ComIPduSignalRef = PassengerSeatHeatStatus_oSeatStatus_oCAN00_3fdf4506_Tx
        ComIPduSignalRef = PassengerSeatVentilationStatus_oSeatStatus_oCAN00_30bae4c8_Tx
        ComIPduSignalRef = RearLeftSeatHeatStatus_oSeatStatus_oCAN00_8ea8ef6d_Tx
        ComIPduSignalRef = RearLeftSeatVentilationStatus_oSeatStatus_oCAN00_efb0db7f_Tx
        ComIPduSignalRef = RearRightSeatHeatStatus_oSeatStatus_oCAN00_fe77aadb_Tx
        ComIPduSignalRef = RearRightSeatVentilationStatus_oSeatStatus_oCAN00_931a722e_Tx
        ComPduIdRef = SeatStatus_oCAN00_57163e7a_Tx
        ComTxIPdu: ComMinimumDelayTime=0, ComTxIPduUnusedAreasDefault=0
          ComTxModeTrue
            ComTxMode: ComTxModeMode=PERIODIC, ComTxModeTimeOffset=0, ComTxModeTimePeriod=0.1
          ComTxModeFalse
            ComTxMode: ComTxModeMode=PERIODIC, ComTxModeTimeOffset=0, ComTxModeTimePeriod=0.1
      8 x ComSignal, all with ComSignalEndianness=BIG_ENDIAN, ComSignalAccess=ACCESS_UNCLEAR:
        RearRightSeatHeatStatus_oSeatStatus_oCAN00_fe77aadb_Tx: ComBitPosition=27, ComBitSize=4, ComSignalInitValue=0, ComSignalType=UINT8, ComTransferProperty=PENDING, ComHandleId=22, ComSystemTemplateSystemSignalRef=RearRightSeatHeatStatus
        RearRightSeatVentilationStatus_oSeatStatus_oCAN00_931a722e_Tx: ComBitPosition=11, ComBitSize=4, ComSignalInitValue=0, ComSignalType=UINT8, ComTransferProperty=PENDING, ComHandleId=23, ComSystemTemplateSystemSignalRef=RearRightSeatVentilationStatus
        PassengerSeatVentilationStatus_oSeatStatus_oCAN00_30bae4c8_Tx: ComBitPosition=3, ComBitSize=4, ComSignalInitValue=0, ComSignalType=UINT8, ComTransferProperty=PENDING, ComHandleId=19, ComSystemTemplateSystemSignalRef=PassengerSeatVentilationStatus
        PassengerSeatHeatStatus_oSeatStatus_oCAN00_3fdf4506_Tx: ComBitPosition=19, ComBitSize=4, ComSignalInitValue=0, ComSignalType=UINT8, ComTransferProperty=PENDING, ComHandleId=18, ComSystemTemplateSystemSignalRef=PassengerSeatHeatStatus
        RearLeftSeatVentilationStatus_oSeatStatus_oCAN00_efb0db7f_Tx: ComBitPosition=15, ComBitSize=4, ComSignalInitValue=0, ComSignalType=UINT8, ComTransferProperty=PENDING, ComHandleId=21, ComSystemTemplateSystemSignalRef=RearLeftSeatVentilationStatus
        RearLeftSeatHeatStatus_oSeatStatus_oCAN00_8ea8ef6d_Tx: ComBitPosition=31, ComBitSize=4, ComSignalInitValue=0, ComSignalType=UINT8, ComTransferProperty=PENDING, ComHandleId=20, ComSystemTemplateSystemSignalRef=RearLeftSeatHeatStatus
        DriverSeatVentilationStatus_oSeatStatus_oCAN00_bad12d43_Tx: ComBitPosition=7, ComBitSize=4, ComSignalInitValue=0, ComSignalType=UINT8, ComTransferProperty=PENDING, ComHandleId=17, ComSystemTemplateSystemSignalRef=DriverSeatVentilationStatus
        rawCurrentData_oBatteryStatus_oCAN00_e9e83638_Rx: ComBitPosition=7, ComBitSize=16, ComSignalInitValue=32768, ComSignalType=UINT16, ComTimeout=0.3, ComHandleId=6, ComNotification=Rte_COMCbk_rawCurrentData_oBatteryStatus_oCAN00_e9e83638_Rx, ComTimeoutNotification=Rte_COMCbkRxTOut_rawCurrentData_oBatteryStatus_oCAN00_e9e83638_Rx, ComFirstTimeout=0.3, ComSystemTemplateSystemSignalRef=rawCurrentData
      BatteryStatus_oCAN00_dde93530_Rx (ComIPdu):
        ComIPduDirection = RECEIVE
        ComIPduType = NORMAL
        ComIPduHandleId = 0
        ComIPduSignalProcessing = DEFERRED
        ComIPduCancellationSupport = false
        ComIPduGroupRef = MyECU_oCAN00_Rx_4cbf71f7
        ComIPduSignalRef = rawCurrentData_oBatteryStatus_oCAN00_e9e83638_Rx
        ComPduIdRef = BatteryStatus_oCAN00_dde93530_Rx
    ComGeneral:
      ComConfigurationUseDet = true
      ComEnableSignalGroupArrayApi = false
      ComRetryFailedTransmitRequests = false
      ComSupportedIPduGroups = 2
      ComVersionInfoApi = false
      ComAdvancedIPduCallouts = true
      ComOptimizedIPduGroupHandling = false
      ComMetaDataSupport = false
      ComReceiveSignalMacroAPI = false
      ComDeferredEventCacheSupport = false
      ComMainfunctionTimingDomainSupport = false
      ComDescriptionRoutingCodeGeneration = false
      ComSafeBswChecks = false
