AUTOSAR XML (schema 4-2-1)
package /ActiveEcuC
  module config PduR: implementation-config-variant=VARIANT-PRE-COMPILE, module-description=PduR_Impl
    PduRGeneral:
      PduRDevErrorDetect = true
      PduRVersionInfoApi = false
      PduRMetaDataSupport = false
      PduRPduCallback = false
      PduRSwitching = false
      PduRSafeBswChecks = false
      PduREnableDeferredTransmission = false
      PduREnableDeferredReception = false
      PduRSupportMulticore = false
      PduRGeneration:
        PduROutOfBoundsWriteProtectionStrategy = NONE
        PduROutOfBoundsWriteSanitizer = false
        PduROutOfBoundsReadSanitizer = false
        PduRNumericalDataTypeMinimizationStrategy = WITH_CAST
        PduRReduceConstantData2Define = false
        PduRBoolDataInArrayOfStructStrategy = BITMASKING
        PduRDeduplicateIndirectedData = true
        PduRDataDeduplicationStrategy = WITH_CAST
        PduRReduceBoolDataByNegationThreshold = 2
        PduRReduceBoolDataByNumericalComparisonThreshold = 2
        PduRReduceBoolDataByNumericalRelationThreshold = 2
        PduRReduceBoolDataByNumericalOperandStrategy = WITH_ANY_VALUE
        PduRReduceNumericalDataByOffsetThreshold = 2
        PduRReduceNumericalDataByArraySubtractionThreshold = 2
        PduRReduceDataByStreaming = false
        PduRShortSymbols = false
        PduRInterfacesForDeactivatedData = false
        PduRReferringKeysInComments = false
    PduRRoutingTables: PduRConfigurationId=0
      PduRRoutingTable
        7 x PduRRoutingPath, all with PduRRoutingPathCommunicationType=COMMUNICATION_INTERFACE, PduRLockRef=(unset):
          BattVoltage03_oCAN00_98b30812_Tx
            BattVoltage03_oCAN00_81b865ef_Tx (PduRDestPdu):
              PduRDestPduHandleId = 2
              PduRDestPduDirection = TRANSMIT
              PduRDestPduRoutingType = API_FORWARDING
              PduRDestPduDataProcessing = IMMEDIATE
              PduRPduLengthHandlingStrategy = UNUSED
              PduRDestPduRef = BattVoltage03_oCAN00_81b865ef_Tx
              PduRDestPduPduRBswModulesRef = CanIf
            PduRSrcPdu_ccefb638 (PduRSrcPdu): PduRSourcePduHandleId=2, PduRSrcPduDirection=TRANSMIT, PduRSrcPduRef=BattVoltage03_oCAN00_98b30812_Tx, PduRSrcPduPduRBswModulesRef=Com
          BattVoltage01_oCAN00_da960f6f_Tx
            PduRSrcPdu_882601b8 (PduRSrcPdu): PduRSourcePduHandleId=0, PduRSrcPduDirection=TRANSMIT, PduRSrcPduRef=BattVoltage01_oCAN00_da960f6f_Tx, PduRSrcPduPduRBswModulesRef=Com
            BattVoltage01_oCAN00_6c2eb606_Tx (PduRDestPdu):
              PduRDestPduHandleId = 0
              PduRDestPduDirection = TRANSMIT
              PduRDestPduRoutingType = API_FORWARDING
              PduRDestPduDataProcessing = IMMEDIATE
              PduRPduLengthHandlingStrategy = UNUSED
              PduRDestPduRef = BattVoltage01_oCAN00_6c2eb606_Tx
              PduRDestPduPduRBswModulesRef = CanIf
          BattVoltage02_oCAN00_5419088c_Tx
            PduRSrcPdu_1d1094fa (PduRSrcPdu): PduRSourcePduHandleId=1, PduRSrcPduDirection=TRANSMIT, PduRSrcPduRef=BattVoltage02_oCAN00_5419088c_Tx, PduRSrcPduPduRBswModulesRef=Com
            BattVoltage02_oCAN00_1acb8f3b_Tx (PduRDestPdu):
              PduRDestPduHandleId = 1
              PduRDestPduDirection = TRANSMIT
              PduRDestPduRoutingType = API_FORWARDING
              PduRDestPduDataProcessing = IMMEDIATE
              PduRPduLengthHandlingStrategy = UNUSED
              PduRDestPduRef = BattVoltage02_oCAN00_1acb8f3b_Tx
              PduRDestPduPduRBswModulesRef = CanIf
          BattVoltage04_oCAN00_9276010b_Tx
            PduRSrcPdu_9bcefde5 (PduRSrcPdu): PduRSourcePduHandleId=3, PduRSrcPduDirection=TRANSMIT, PduRSrcPduRef=BattVoltage04_oCAN00_9276010b_Tx, PduRSrcPduPduRBswModulesRef=Com
            BattVoltage04_oCAN00_f701fd41_Tx (PduRDestPdu):
              PduRDestPduHandleId = 3
              PduRDestPduDirection = TRANSMIT
              PduRDestPduRoutingType = API_FORWARDING
              PduRDestPduDataProcessing = IMMEDIATE
              PduRPduLengthHandlingStrategy = UNUSED
              PduRDestPduRef = BattVoltage04_oCAN00_f701fd41_Tx
              PduRDestPduPduRBswModulesRef = CanIf
          BodyStatus_oCAN00_a235940f_Rx
            BodyStatus_oCAN00_a235940f_Rx_5b31d4cf_Rx (PduRDestPdu):
              PduRDestPduHandleId = 1
              PduRDestPduDirection = RECEIVE
              PduRDestPduRoutingType = API_FORWARDING
              PduRDestPduDataProcessing = IMMEDIATE
              PduRPduLengthHandlingStrategy = UNUSED
              PduRDestPduRef = BodyStatus_oCAN00_b72f18b8_Rx
              PduRDestPduPduRBswModulesRef = Com
            PduRSrcPdu_5b31d4cf (PduRSrcPdu): PduRSourcePduHandleId=1, PduRSrcPduDirection=RECEIVE, PduRSrcPduRef=BodyStatus_oCAN00_a235940f_Rx, PduRSrcPduPduRBswModulesRef=CanIf
          SeatStatus_oCAN00_57163e7a_Tx
            SeatStatus_oCAN00_73107919_Tx (PduRDestPdu):
              PduRDestPduHandleId = 4
              PduRDestPduDirection = TRANSMIT
              PduRDestPduRoutingType = API_FORWARDING
              PduRDestPduDataProcessing = IMMEDIATE
              PduRPduLengthHandlingStrategy = UNUSED
              PduRDestPduRef = SeatStatus_oCAN00_73107919_Tx
              PduRDestPduPduRBswModulesRef = CanIf
            PduRSrcPdu_b36f7279 (PduRSrcPdu): PduRSourcePduHandleId=4, PduRSrcPduDirection=TRANSMIT, PduRSrcPduRef=SeatStatus_oCAN00_57163e7a_Tx, PduRSrcPduPduRBswModulesRef=Com
          BatteryStatus_oCAN00_26c24fb8_Rx
            BatteryStatus_oCAN00_26c24fb8_Rx_838eb9ca_Rx (PduRDestPdu):
              PduRDestPduHandleId = 0
              PduRDestPduDirection = RECEIVE
              PduRDestPduRoutingType = API_FORWARDING
              PduRDestPduDataProcessing = IMMEDIATE
              PduRPduLengthHandlingStrategy = UNUSED
              PduRDestPduRef = BatteryStatus_oCAN00_dde93530_Rx
              PduRDestPduPduRBswModulesRef = Com
            PduRSrcPdu_838eb9ca (PduRSrcPdu): PduRSourcePduHandleId=0, PduRSrcPduDirection=RECEIVE, PduRSrcPduRef=BatteryStatus_oCAN00_26c24fb8_Rx, PduRSrcPduPduRBswModulesRef=CanIf
      PduRLock_PduRExclusiveArea (PduRLock)
        PduRExclusiveArea: PduRExclusiveAreaId=0
    4 x PduRBswModules, all with PduRCancelReceive=false, PduRCancelTransmit=false, PduRChangeParameterRequestApi=false, PduRTriggertransmit=false:
      CanIf: PduRCommunicationInterface=true, PduRLowerModule=true, PduRTransportProtocol=false, PduRTxConfirmation=true, PduRUpperModule=false, PduRUseTag=false, PduRBswModuleRef=CanIf
      CanTp: PduRCommunicationInterface=false, PduRLowerModule=true, PduRTransportProtocol=true, PduRTxConfirmation=false, PduRUpperModule=false, PduRUseTag=false, PduRBswModuleRef=CanTp
      Com: PduRCommunicationInterface=true, PduRLowerModule=false, PduRTransportProtocol=false, PduRTxConfirmation=true, PduRUpperModule=true, PduRUseTag=false, PduRBswModuleRef=Com
      Dcm: PduRCommunicationInterface=false, PduRLowerModule=false, PduRTransportProtocol=true, PduRTxConfirmation=false, PduRUpperModule=true, PduRUseTag=true, PduRBswModuleRef=Dcm
