AUTOSAR XML (schema 4-2-1)
package /COM/VECTOR/CFG/WORKFLOW/SYSDESC/SYNC
  flat map FLATMAP
    6 x flat instance descriptor:
      rawCurrentData: upstream-reference=EcuSwComposition.rawCurrentData.rawCurrentData, ecu-extract-reference=COMPOSITIONTYPE.rawCurrentData.rawCurrentData
      rawCurrentData_001: upstream-reference=EcuSwComposition.rawCurrentData, ecu-extract-reference=COMPOSITIONTYPE.rawCurrentData
      DoorStatus: upstream-reference=EcuSwComposition.DoorStatus.DoorStatus, ecu-extract-reference=COMPOSITIONTYPE.DoorStatus.DoorStatus
      DoorStatus_001: upstream-reference=EcuSwComposition.DoorStatus, ecu-extract-reference=COMPOSITIONTYPE.DoorStatus
      CurrentProcess: upstream-reference=EcuSwComposition.CurrentProcess, ecu-extract-reference=COMPOSITIONTYPE.CurrentProcess
      CurrentProcess2: upstream-reference=EcuSwComposition.CurrentProcess2, ecu-extract-reference=COMPOSITIONTYPE.CurrentProcess2
