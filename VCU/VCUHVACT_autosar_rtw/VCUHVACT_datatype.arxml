AUTOSAR XML (schema 4-3-1)
package /AUTOSAR_Platform/ImplementationDataTypes/Units
  unit NoUnit: factor-si-to-unit=1, offset-si-to-unit=0
