AUTOSAR XML (schema 4-3-1)
package /ComponentTypes
  swc implementation VCUHVACT_Implementation: programming-language=C, sw-version=1.17.1, used-code-generator=Embedded Coder 24.2 (R2024b) 21-Jun-2024, vendor-id=0, behavior=VCUHVACT_InternalBehavior
    code-descriptors:
      code Code
        artifact-descriptors:
          short-label=VCUHVACT_c, category=SWSRC
          short-label=VCUHVACT_h, category=SWHDR
          short-label=VCUHVACT_private_h, category=SWHDR
          short-label=VCUHVACT_types_h, category=SWHDR
  swc implementation VCUHVACT_imp: programming-language=C, sw-version=1.17.1, used-code-generator=Embedded Coder 24.2 (R2024b) 21-Jun-2024, vendor-id=0, behavior=VCUHVACT_InternalBehavior
    code-descriptors:
      code Code
        artifact-descriptors:
          short-label=VCUHVACT_c, category=SWSRC
          short-label=VCUHVACT_h, category=SWHDR
          short-label=VCUHVACT_private_h, category=SWHDR
          short-label=VCUHVACT_types_h, category=SWHDR
    resource consumption RsrcCons_VCUHVACT
