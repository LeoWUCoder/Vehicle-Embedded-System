AUTOSAR XML (schema 4-3-0)
standard types defined: boolean, uint16, uint32, uint8
package /DataType/Semantics
  compu method CM_AC_AIUStsCmd: 0..1=RANGE, 0=Cx0_Off, 1=Cx1_On
  compu method CM_ACAirInlet: 0..3=RANGE, 0=Cx0_Recirculation_, 1=Cx1_Fresh_Air_ (Fresh Air), 2=Cx2_Auto_recirculation_ (Auto recirculation), 3=Cx3_Ini_
  compu method CM_ACAmbtTemp: 0=Cx00_Valid_value_ (Valid value), 254=CxFE_Init_, 255=CxFF_Failure_, phys=raw*0.5-40 for raw 0..255; unit ��C  # Source signal range: [0,253]
  compu method CM_ACAutoMode: 0..1=RANGE, 0=Cx0_Inactive_, 1=Cx1_Active_
  compu method CM_ACC_AEB_ON_OFF: 0..1=RANGE, 0=Cx0_AEB_ON_ (AEB ON), 1=Cx1_AEB_OFF_ (AEB OFF)
  compu method CM_ACC_FCW_ON_OFF: 0..1=RANGE, 0=Cx0_FCW_ON_ (FCW ON), 1=Cx1_FCW_OFF_ (FCW OFF)
  compu method CM_ACClimateSwErrorSts: 0..1=RANGE, 0=Cx0_No_Error_ (No Error), 1=Cx1_Error_
  compu method CM_ACClimateSwReq: 0..1=RANGE, 0=Cx0_No_request_ (No request), 1=Cx1_Request_
  compu method CM_ACCmprOnOffIconCmd: 0..1=RANGE, 0=Cx0_Off_, 1=Cx1_On_
  compu method CM_ACDispCmd: 0..3=RANGE, 0=Cx0_No_Display_ (No Display), 1=Cx1_No_Display_AC_status_changed_in_Auto_mode_ATC_ (No Display,AC status changed in Auto mode��ATC��), 2=Cx2_Display_, 3=Cx3_Reserved_
  compu method CM_ACDispSts: 0..1=RANGE, 0=Cx0_Inactive_no_display_ (Inactive (no display)), 1=Cx1_Active_Display_ (Active (Display))
  compu method CM_ACDrvAirDistriMode: 0..7=RANGE, 0=Cx0_Face_, 1=Cx1_Face_Foot_ (Face & Foot), 2=Cx2_Foot_, 3=Cx3_Foot_Defrost_ (Foot & Defrost), 4=Cx4_Defrost_, 5=Cx5_Reserved_, 7=Cx7_Auto_air_distribution_mode_ (Auto air distribution mode)
  compu method CM_ACDrvSetTemp: 0=Cx00_Low_, 1=Cx01_Valid_value_ (Valid value), 32=Cx20_High_, 33=Cx21_Ini_, 34=Cx22_Reserved_ (Reserved.), phys=raw*0.5+16 for raw 0..63; unit ��C  # Source signal range: [0,32]
  compu method CM_ACFrntDefrost: 0..1=RANGE, 0=Cx0_Inactive_, 1=Cx1_Active_
  compu method CM_ACFrntPassSetTemp: 0=Cx00_Low_, 1=Cx01_Valid_value_ (Valid value), 32=Cx20_High_, 33=Cx21_Ini_, 34=Cx22_Reserved_ (Reserved.), phys=raw*0.5+16 for raw 0..63; unit ��C  # Source signal range: [0,32]
  compu method CM_ACFrtBlwSpd: phys=raw for raw 0..15
  compu method CM_ACOnOffIconCmd: 0..1=RANGE, 0=Cx0_Off_, 1=Cx1_On_
  compu method CM_ACPowerReq_VR: 0..3=RANGE, 0=Cx0_no_action_ (no action), 1=Cx1_power_off_ (power off), 2=Cx2_power_on_ (power on), 3=Cx3_reserved_
  compu method CM_ACRearSetTemp: 0=Cx00_Low_, 1=Cx01_Valid_value_ (Valid value), 32=Cx20_High_, 33=Cx21_Ini_, 34=Cx22_Reserved_ (Reserved.), phys=raw*0.5+16 for raw 0..63; unit ��C  # Source signal range: [0,32]
  compu method CM_AdjustvolSwSts: phys=raw for raw 0..63
  compu method CM_AdjustvolSwSync: 0..1=RANGE, 0=Cx0_Synchronization_Off_ (Synchronization Off), 1=Cx1_Synchronization_On_ (Synchronization On)
  compu method CM_AdjVolDowSwSts: 0..3=RANGE, 0=Cx0_Released_, 1=Cx1_Short_Pressed_ (Short Pressed), 2=Cx2_Long_Pressed_ (Long Pressed), 3=Cx3_Invalidation_
  compu method CM_AdjVolUpSwSts: 0..3=RANGE, 0=Cx0_Released_, 1=Cx1_Short_Pressed_ (Short Pressed), 2=Cx2_Long_Pressed_ (Long Pressed), 3=Cx3_Invalidation_
  compu method CM_AEBSwSts_Ped: 0..1=RANGE, 0=Cx0_AEB_ON_ (AEB ON), 1=Cx1_AEB_OFF_ (AEB OFF)
  compu method CM_AEBSwSts_Veh: 0..1=RANGE, 0=Cx0_AEB_ON_ (AEB ON), 1=Cx1_AEB_OFF_ (AEB OFF)
  compu method CM_AirInletReq_TC: 0..3=RANGE, 0=Cx0_No_action_ (No action), 1=Cx1_Pressed_, 2=Cx2_Reserved_, 3=Cx3_Reserved_
  compu method CM_AirInletReq_VR: 0..3=RANGE, 0=Cx0_no_action_ (no action), 1=Cx1_Fresh_, 2=Cx2_Recirculation_, 3=Cx3_Reserved_
  compu method CM_AIUReq_TC: 0..1=RANGE, 0=Cx0_No_action_ (No action), 1=Cx1_Press
  compu method CM_ALCMLightLvlSet: 0..15=RANGE, 0=Cx0_0_, 1=Cx1_10_, 2=Cx2_20_, 3=Cx3_30_, 4=Cx4_40_, 5=Cx5_50_, 6=Cx6_60_, 7=Cx7_70_, 8=Cx8_80_, 9=Cx9_90_, 10=CxA_100_, 11=CxB_Reserved_
  compu method CM_AQSReq_TC: 0..3=RANGE, 0=Cx0_No_action_ (No action), 1=Cx1_Pressed_, 2=Cx2_Reserved_, 3=Cx3_Reserved_
  compu method CM_AutoModReq_TC: 0..3=RANGE, 0=Cx0_No_action_ (No action), 1=Cx1_Pressed_, 2=Cx2_Reserved_, 3=Cx3_Reserved_
  compu method CM_AutoModReq_VR: 0..3=RANGE, 0=Cx0_no_action_ (no action), 1=Cx1_inactive_reserved_ (inactive(reserved)), 2=Cx2_active_, 3=Cx3_reserved_
  compu method CM_Avm_Hmi_Index: 0..15=RANGE, 0=Cx0_Reserved_, 1=Cx1_Main_Screen_ (Main Screen), 2=Cx2_Reserved_, 3=Cx3_Reserved_, 4=Cx4_EOL_Test_ (EOL/Test), 5=Cx5_Reserved_, 6=Cx6_Reserved_, 7=Cx7_Reserved_, 8=Cx8_Reserved_, 10=CxA_Reserved_
  compu method CM_Avm_Op_State: 0..15=RANGE, 0=Cx0_STANDBY_State_ (STANDBY State), 1=Cx1_NORMAL_State_ (NORMAL State), 2=Cx2_Reserved_
  compu method CM_BackgroundLightLvl: 0..255=RANGE, 0=Cx00_Valid_Value_ (Valid Value)
  compu method CM_BaroPressure: phys=raw*0.59 for raw 0..255; unit kPa
  compu method CM_Bat_Volt_Out_Of_Range: 0..1=RANGE, 0=Cx0_False_, 1=Cx1_True_
  compu method CM_BattSaveDelayTimeSet: 0..3=RANGE, 0=Cx0_3minutes_, 1=Cx1_5minutes_, 2=Cx2_8minutes_, 3=Cx3_Reserved_
  compu method CM_BlwrSpdReq_VR: phys=raw for raw 0..15
  compu method CM_BrakePedalFeelReq: 0..3=RANGE, 0=Cx0_Normal_, 1=Cx1_Comfort_, 2=Cx2_Sport_, 3=Cx3_Reserved_
  compu method CM_BT_AnswerSwSts: 0..3=RANGE, 0=Cx0_Released_, 1=Cx1_Pressed_, 2=Cx2_error_, 3=Cx3_invalidation_
  compu method CM_BT_RejectSwSts: 0..3=RANGE, 0=Cx0_Released_, 1=Cx1_Pressed_, 2=Cx2_error_, 3=Cx3_invalidation_
  compu method CM_Can_Com_Failed: 0..1=RANGE, 0=Cx0_False_, 1=Cx1_True_
  compu method CM_ChairMemoPosEnable: 0..1=RANGE, 0=Cx0_Disable_, 1=Cx1_Enable_
  compu method CM_CmprReq_TC: 0..3=RANGE, 0=Cx0_No_action_ (No action), 1=Cx1_Pressed_, 2=Cx2_Reserved_, 3=Cx3_Reserved_
  compu method CM_CmprReq_VR: 0..3=RANGE, 0=Cx0_no_action_ (no action), 1=Cx1_inactive_, 2=Cx2_active_, 3=Cx3_reserved_
  compu method CM_Controller_Op_Failed: 0..1=RANGE, 0=Cx0_False_, 1=Cx1_True_
  compu method CM_DDDSet: 0..1=RANGE, 0=Cx0_OFF_, 1=Cx1_ON_
  compu method CM_DeepSlpCmd: 0..3=RANGE, 0=Cx0_Normal_, 1=Cx1_Sleep_Commend_ (Sleep Commend), 2=Cx2_Deep_Sleep_Commend_ (Deep Sleep Commend)  # Source signal range: [0,1]
  compu method CM_DomeLampDelayTimeSet: 0..7=RANGE, 0=Cx0_3seconds_, 1=Cx1_10seconds_, 2=Cx2_20seconds_, 3=Cx3_30seconds_, 4=Cx4_60seconds, 5=Cx5_180seconds, 6=Cx6_Reserved, 7=Cx7_Reserved
  compu method CM_DriverDoorSts: 0..1=RANGE, 0=Cx0_Closed_, 1=Cx1_Open_
  compu method CM_DrvAirDistribModReq_TC: 0..7=RANGE, 0=Cx0_No_action_ (No action), 1=Cx1_Face_, 2=Cx2_Face_Foot_ (Face+Foot), 3=Cx3_Foot_, 4=Cx4_Foot_Defrost_ (Foot+Defrost), 5=Cx5_Reserved_, 6=Cx6_Reserved_, 7=Cx7_Reserved_  # Source signal range: [0,3]
  compu method CM_DrvAirDistribModReq_VR: 0..7=RANGE, 0=Cx0_No_action_ (No action), 1=Cx1_Face_, 2=Cx2_Face_Foot_ (Face+Foot), 3=Cx3_Foot_, 4=Cx4_Foot_Defrost_ (Foot+Defrost), 5=Cx5_Reserved_, 6=Cx6_Reserved_, 7=Cx7_Reserved_
  compu method CM_DrvSeatHeatLvlSet: 0..3=RANGE, 0=Cx0_OFF_, 1=Cx1_Level_1_ (Level 1), 2=Cx2_Level_2_ (Level 2), 3=Cx3_Level_3_ (Level 3)
  compu method CM_DrvSeatMassgLvlSet: 0..3=RANGE, 0=Cx0_No_action_ (No action), 1=Cx1_Level_1_ (Level 1), 2=Cx2_Level_2_ (Level 2), 3=Cx3_Reserved_  # Source signal range: [0,2]
  compu method CM_DrvSeatSupportLvlSet: 0..5=RANGE, 0=Cx0_OFF_, 1=Cx1_Level_1_ (Level 1), 2=Cx2_Level_2_ (Level 2), 3=Cx3_Reserved_
  compu method CM_DrvSeatVentnLvlSet: 0..3=RANGE, 0=Cx0_OFF_, 1=Cx1_Level_1_ (Level 1), 2=Cx2_Level_2_ (Level 2), 3=Cx3_Level_3_ (Level 3)
  compu method CM_DrvTempDecReq_TC: 0..3=RANGE, 0=Cx0_No_action_ (No action), 1=Cx1_Pressed_, 2=Cx2_Reserved_, 3=Cx3_Reserved_
  compu method CM_DrvTempIncReq_TC: 0..3=RANGE, 0=Cx0_No_action_ (No action), 1=Cx1_Pressed_, 2=Cx2_Reserved_, 3=Cx3_Reserved_
  compu method CM_DrvTempReq_VR: phys=raw*0.5+15.5 for raw 1..33; unit ��C
  compu method CM_DualReq_TC: 0..3=RANGE, 0=Cx0_No_action_ (No action), 1=Cx1_Pressed_, 2=Cx2_Reserved_, 3=Cx3_Reserved_
  compu method CM_EEM_ActvSts: 0..1=RANGE, 0=Cx0_EEM_function_OFF_ (EEM function OFF), 1=Cx1_EEM_function_OFF_ (EEM function OFF); unit 0
  compu method CM_EngCoolantTemp: 0=Cx00_Valid_value_ (Valid value), phys=raw*0.75-48 for raw 0..255; unit Deg C
  compu method CM_EngCoolTmpValidity: 0..2=RANGE, 0=Cx0_Invalid_, 1=Cx1_Valid_, 2=Cx2_Init_value_ (Init value)
  compu method CM_EngState: 0..3=RANGE, 0=Cx0_Stopped_, 1=Cx1_Cranking_, 2=Cx2_Running_, 3=Cx3_DFCO_
  compu method CM_Eol_Not_Completed: 0..1=RANGE, 0=Cx0_False_, 1=Cx1_True_
  compu method CM_EPS_CurrMod: 0..7=RANGE, 0=Cx0_Normal_Mode_ (Normal Mode), 1=Cx1_Sport_Mode_ (Sport Mode), 2=Cx2_Comfort_Mode_ (Comfort Mode), 3=Cx3_ModeSelectionNotPossible_, 4=Cx4_No_Display_ (No Display), 5=Cx5_ConditionNotMeet_, 6=Cx6_Reserved_
  compu method CM_FCWSwSts: 0..1=RANGE, 0=Cx0_FCW_ON_ (FCW ON), 1=Cx1_FCW_OFF_ (FCW OFF)
  compu method CM_Fold_UnfoldSts: 0..1=RANGE, 0=Cx0_Unfold_, 1=Cx1_Fold_
  compu method CM_FolwMeHomeDelayTimeSet: 0..7=RANGE, 0=Cx0_30seconds_, 1=Cx1_1minutes_, 2=Cx2_2minutes_, 3=Cx3_3minutes, 4=Cx4_Reserved_, 5=Cx5_Reserved_, 6=Cx6_Reserved_, 7=Cx7_Reserved_
  compu method CM_FPAS_SensorFaultStsFLC: 0..1=RANGE, 0=Cx0_Sensor_normal_ (Sensor normal), 1=Cx1_Sensor_fault_ (Sensor fault)
  compu method CM_FPAS_SensorFaultStsFLM: 0..1=RANGE, 0=Cx0_Sensor_normal_ (Sensor normal), 1=Cx1_Sensor_fault_ (Sensor fault)
  compu method CM_FPAS_SensorFaultStsFRC: 0..1=RANGE, 0=Cx0_Sensor_normal_ (Sensor normal), 1=Cx1_Sensor_fault_ (Sensor fault)
  compu method CM_FPAS_SensorFaultStsFRM: 0..1=RANGE, 0=Cx0_Sensor_normal_ (Sensor normal), 1=Cx1_Sensor_fault_ (Sensor fault)
  compu method CM_FPAS_WorkSts: 0..3=RANGE, 0=Cx0_Disable_, 1=Cx1_Enable_, 2=Cx2_Active_, 3=Cx3_Failed_
  compu method CM_FRBlindSpotVisionSwErrorSts: 0..1=RANGE, 0=Cx0_No_Error_ (No Error), 1=Cx1_Error_
  compu method CM_FRBlindSpotVisionSwReq: 0..1=RANGE, 0=Cx0_No_request_ (No request), 1=Cx1_Request_
  compu method CM_FrntBlwrSpdDecReq_TC: 0..3=RANGE, 0=Cx0_No_action_ (No action), 1=Cx1_Pressed_, 2=Cx2_Reserved_, 3=Cx3_Reserved_
  compu method CM_FrntBlwrSpdIncReq_TC: 0..3=RANGE, 0=Cx0_No_action_ (No action), 1=Cx1_Pressed_, 2=Cx2_Reserved_, 3=Cx3_Reserved_
  compu method CM_FrntDefrostReq_VR: 0..3=RANGE, 0=Cx0_no_action_ (no action), 1=Cx1_inactive_, 2=Cx2_active_, 3=Cx3_reserved_
  compu method CM_FrntDefrstReq_TC: 0..3=RANGE, 0=Cx0_No_action_ (No action), 1=Cx1_Pressed_, 2=Cx2_Reserved_, 3=Cx3_Reserved_
  compu method CM_FrntHMIDis_TC: 0..1=RANGE, 0=Cx0_No_action_ (No action), 1=Cx1_Pressed_
  compu method CM_FrntPassTempDecReq_TC: 0..3=RANGE, 0=Cx0_No_action_ (No action), 1=Cx1_Pressed_, 2=Cx2_Reserved_, 3=Cx3_Reserved_
  compu method CM_FrntPassTempIncReq_TC: 0..3=RANGE, 0=Cx0_No_action_ (No action), 1=Cx1_Pressed_, 2=Cx2_Reserved_, 3=Cx3_Reserved_
  compu method CM_Front_Camera_Input_Failed: 0..1=RANGE, 0=Cx0_False_, 1=Cx1_True_
  compu method CM_Guid_Overlay_Status: 0..3=RANGE, 0=Cx0_Both_Around_View_and_Single_View_Guidance_Overlay_Display_ (Both Around View and Single View Guidance Overlay Display), 1=Cx1_Only_Around_View_Guidance_Overlay_Display_ (Only Around View Guidance Overlay Display), 2=Cx2_Only_Single_View_Guidance_Overlay_Display_ (Only Single View Guidance Overlay Display), 3=Cx3_No_Guidance_Overlay_Display_ (No Guidance Overlay Display)
  compu method CM_Guid_Ovl_Display_Cmd: 0..1=RANGE, 0=Cx0_No_Commands_ (No Commands), 1=Cx1_Request_to_Change_Guidance_Overlay_Display_ (Request to Change Guidance Overlay Display)
  compu method CM_HCU_DrvMod: 0..15=RANGE, 0=Cx0_Auto_Normal_Mode_started (Auto/Normal Mode started), 1=Cx1_EV_Mode_started (EV Mode started), 2=Cx2_Save_Mode_started (Save Mode started), 3=Cx3_SPORT_Mode_started (SPORT Mode started), 4=Cx4_AWD_Normal_Mode_started (AWD Normal Mode started), 5=Cx5_Snow_Mode_started (Snow Mode started), 6=Cx6_Muddy_Mode_started (Muddy Mode started), 7=Cx7_Sand_Mode_started (Sand Mode started), 8=Cx8_ECO, 9=Cx9_Reserved, 10=CxA_Reserved, 11=CxB_Reserved, 12=CxC_Reserved, 13=CxD_Reserved, 14=CxE_Reserved, 15=CxF_Reserved
  compu method CM_HCU_EgyRecFB: 0..3=RANGE, 0=Cx0_Standard, 1=Cx1_Enhanced, 2=Cx2_Low, 3=Cx3_Not_Avaliable (Not Avaliable)
  compu method CM_HCU_EgyUsed: phys=raw*0.01 for raw 0..1023; unit KWh
  compu method CM_HCU_EnerSavePowerMod: 0..3=RANGE, 0=Cx0_No_action (No action), 1=Cx1_Close_blower (Close blower), 2=Cx2_Close_seat_heat (Close seat heat), 3=Cx3_Close_both_blower_and_seat_heat (Close both blower and seat heat)
  compu method CM_HCU_EnrgFlowInd: 0..31=RANGE, 0=Cx00_Mode_0 (Mode 0), 1=Cx01_Mode_1 (Mode 1), 2=Cx02_Mode_2 (Mode 2), 3=Cx03_Mode_3 (Mode 3), 4=Cx04_Mode_4 (Mode 4), 5=Cx05_Mode_5 (Mode 5), 6=Cx06_Mode_6 (Mode 6), 7=Cx07_Mode_7 (Mode 7), 8=Cx08_Mode_8 (Mode 8), 9=Cx09_Mode_9 (Mode 9), 10=Cx0A_Mode_10 (Mode 10), 11=Cx0B_Mode_11 (Mode 11), 12=Cx0C_Mode_12 (Mode 12), 13=Cx0D_Mode_13 (Mode 13), 14=Cx0E_Mode_14 (Mode 14), 15=Cx0F_Reserved, 16=Cx10_Reserved, 17=Cx11_Reserved, 18=Cx12_Reserved, 19=Cx13_Reserved, 20=Cx14_Reserved, 21=Cx15_Reserved, 22=Cx16_Reserved, 23=Cx17_Reserved, 24=Cx18_Reserved, 25=Cx19_Reserved, 26=Cx1A_Reserved, 27=Cx1B_Reserved, 28=Cx1C_Reserved, 29=Cx1D_Reserved, 30=Cx1E_Reserved, 31=Cx1F_Reserved
  compu method CM_HCU_PowertrainSts: 0..15=RANGE, 0=Cx0_Sleep, 1=Cx1_Initialize_Mode (Initialize Mode), 2=Cx2_power_up (power up), 3=Cx3_Cellphone_APP (Cellphone APP), 4=Cx4_run, 5=Cx5_Reserved, 6=Cx6_Error_Mode (Error Mode), 7=Cx7_Limphome, 8=Cx8_Emergency_Mode (Emergency Mode), 9=Cx9_Service_Mode (Service Mode), 10=CxA_Prepare_Sleep (Prepare Sleep), 11=CxB_Reserved, 12=CxC_Reserved, 13=CxD_Reserved, 14=CxE_Reserved
  compu method CM_HCU_RecupPwr: phys=raw*10 for raw 0..1023
  compu method CM_HCU_TotalScore: 0..7=RANGE, 0=Cx0_Score_0 (Score 0), 1=Cx1_Score_1 (Score 1), 2=Cx2_Score_2 (Score 2), 3=Cx3_Score_3 (Score 3), 4=Cx4_Score_4 (Score 4), 5=Cx5_Score_5 (Score 5), 6=Cx6_Reserved, 7=Cx7_Reserved  # Source signal range: [0,5]
  compu method CM_HUT_AvailInputCur: 0..7=RANGE, 0=Cx0_10A_, 1=Cx1_8A_, 2=Cx2_13A_, 3=Cx3_16A_, 4=Cx4_No_action_ (No action), 5=Cx5_Reserved_
  compu method CM_HUT_BattSOCLim: 0..7=RANGE, 0=Cx0_100_ (100%), 1=Cx1_50_ (50%), 2=Cx2_60_ (60%), 3=Cx3_70_ (70%), 4=Cx4_80_ (80%), 5=Cx5_90_ (90%), 6=Cx6_No_action_ (No action), 7=Cx7_Reserved_
  compu method CM_HUT_ChrgnMode: 0..3=RANGE, 0=Cx0_Immediate_Charging_ (Immediate Charging), 1=Cx1_Delay_Charging_ (Delay Charging), 2=Cx2_Invalid_, 3=Cx3_No_action_ (No action)
  compu method CM_HUT_Chrgnset: 0..3=RANGE, 0=Cx0_Init_, 1=Cx1_End_Charging_ (End Charging), 2=Cx2_Start_Charging_ (Start Charging), 3=Cx3_No_action_ (No action)
  compu method CM_HUT_CTA_ON_OFF: 0..1=RANGE, 0=Cx0_CTA_OFF_ (CTA OFF), 1=Cx1_CTA_ON_ (CTA ON)
  compu method CM_HUT_CTABrake_ON_OFF: 0..1=RANGE, 0=Cx0_CTABrake_OFF_ (CTABrake OFF), 1=Cx1_CTABrake_ON_ (CTABrake ON)
  compu method CM_HUT_DOW_ON_OFF: 0..1=RANGE, 0=Cx0_DOW_OFF_ (DOW OFF), 1=Cx1_DOW_ON_ (DOW ON)
  compu method CM_HUT_EgyRecSet: 0..3=RANGE, 0=Cx0_Standard_, 1=Cx1_Enhance_, 2=Cx2_Low_, 3=Cx3_Reserved_
  compu method CM_HUT_LCA_ON_OFF: 0..1=RANGE, 0=Cx0_LCA_OFF_ (LCA OFF), 1=Cx1_LCA_ON_ (LCA ON)
  compu method CM_HUT_RCW_ON_OFF: 0..1=RANGE, 0=Cx0_RCW_OFF_ (RCW OFF), 1=Cx1_RCW_ON_ (RCW ON)
  compu method CM_HUT_RSDS_ON_OFF: 0..1=RANGE, 0=Cx0_RSDS_OFF_ (RSDS OFF), 1=Cx1_RSDS_ON_ (RSDS ON)
  compu method CM_Ibooster_BrkPedalFeelSts: 0..3=RANGE, 0=Cx0_Normal, 1=Cx1_Comfort, 2=Cx2_Sport, 3=Cx3_Description_for_the_value_0x3_ (Description for the value '0x3')
  compu method CM_IFC_SnvtySet: 0..3=RANGE, 0=Cx0_Normal_, 1=Cx1_High_sensitivity_ (High sensitivity), 2=Cx2_Low_sensitivity_ (Low sensitivity), 3=Cx3_Reserved_
  compu method CM_InputVoltForBCM: 0=Cx00_Valid_Value_ (Valid Value), 127=Cx7F_Invalid_Value_ (Invalid Value), phys=raw*0.25 for raw 0..127; unit V  # Source signal range: [0,126]
  compu method CM_IP_CurrTheme: 0..7=RANGE, 0=Cx0_Modern_Theme_good_ (Modern Theme-good), 1=Cx1_Classis_Theme_blue_ (Classis Theme-blue), 2=Cx2_Dynamic_Theme_red_ (Dynamic Theme-red), 3=Cx3_Initial_value_ (Initial value), 4=Cx4_Reserved_
  compu method CM_Left_Camera_Input_Failed: 0..1=RANGE, 0=Cx0_False_, 1=Cx1_True_
  compu method CM_ModeSwSts: 0..3=RANGE, 0=Cx0_Released_, 1=Cx1_Pressed_, 2=Cx2_error_, 3=Cx3_invalidation_
  compu method CM_NmUd_MyECU_16bit: phys=raw for raw 0..65535
  compu method CM_NmUd_MyECU_32bit: phys=raw for raw 0..4294967295
  compu method CM_OffReq_TC: 0..3=RANGE, 0=Cx0_No_action_ (No action), 1=Cx1_Pressed_, 2=Cx2_Reserved_, 3=Cx3_Reserved_
  compu method CM_Overlay_Op_Failed: 0..1=RANGE, 0=Cx0_False_, 1=Cx1_True_
  compu method CM_PAS_ObjectSts_FLC: phys=raw for raw 0..15
  compu method CM_PAS_ObjectSts_FLM: phys=raw for raw 0..15
  compu method CM_PAS_ObjectSts_FRC: phys=raw for raw 0..15
  compu method CM_PAS_ObjectSts_FRM: phys=raw for raw 0..15
  compu method CM_PAS_ObjectSts_RLC: phys=raw for raw 0..15
  compu method CM_PAS_ObjectSts_RLM: phys=raw for raw 0..15
  compu method CM_PAS_ObjectSts_RRC: phys=raw for raw 0..15
  compu method CM_PAS_ObjectSts_RRM: phys=raw for raw 0..15
  compu method CM_PassengerDoorSts: 0..1=RANGE, 0=Cx0_Closed_, 1=Cx1_Open_
  compu method CM_PassSeatHeatLvlSet: 0..3=RANGE, 0=Cx0_OFF_, 1=Cx1_Level_1_ (Level 1), 2=Cx2_Level_2_ (Level 2), 3=Cx3_Level_3_ (Level 3)
  compu method CM_PassSeatMassgLvlSet: 0..3=RANGE, 0=Cx0_No_action_ (No action), 1=Cx1_Level_1_ (Level 1), 2=Cx2_Level_2_ (Level 2), 3=Cx3_Reserved_  # Source signal range: [0,2]
  compu method CM_PassSeatSupportLvlSet: 0..7=RANGE, 0=Cx0_No_action_ (No action), 1=Cx1_Level_1_ (Level 1), 2=Cx2_Level_2_ (Level 2), 3=Cx3_Level_3_ (Level 3), 4=Cx4_Level_4_ (Level 4), 5=Cx5_Level_5_ (Level 5), 6=Cx6_Reserved_  # Source signal range: [0,5]
  compu method CM_PassSeatVentnLvlSet: 0..3=RANGE, 0=Cx0_OFF_, 1=Cx1_Level_1_ (Level 1), 2=Cx2_Level_2_ (Level 2), 3=Cx3_Level_3_ (Level 3)
  compu method CM_PASWorkCmd: 0..1=RANGE, 0=Cx0_OFF_, 1=Cx1_ON_
  compu method CM_PosLmpOutputSts: 0..1=RANGE, 0=Cx0_OFF_, 1=Cx1_ON_
  compu method CM_Rear_Camera_Input_Failed: 0..1=RANGE, 0=Cx0_False_, 1=Cx1_True_
  compu method CM_RearBlwrSpdDecReq_TC: 0..1=RANGE, 0=Cx0_No_action_ (No action), 1=Cx1_Pressed_
  compu method CM_RearBlwrSpdIncReq_TC: 0..1=RANGE, 0=Cx0_No_action_ (No action), 1=Cx1_Pressed_
  compu method CM_RearHMIDis_TC: 0..1=RANGE, 0=Cx0_No_action_ (No action), 1=Cx1_Pressed_
  compu method CM_RearTempDecReq_TC: 0..1=RANGE, 0=Cx0_No_action_ (No action), 1=Cx1_Pressed_
  compu method CM_RearTempIncReq_TC: 0..1=RANGE, 0=Cx0_No_action_ (No action), 1=Cx1_Pressed_
  compu method CM_RearviewFoldModSet: 0..1=RANGE, 0=Cx0_Automatical_, 1=Cx1_Manual_
  compu method CM_Right_Camera_Input_Failed: 0..1=RANGE, 0=Cx0_False_, 1=Cx1_True_
  compu method CM_RLDoorSts: 0..1=RANGE, 0=Cx0_Closed_, 1=Cx1_Open_
  compu method CM_RPAS_SensorFaultStsRLC: 0..1=RANGE, 0=Cx0_Sensor_normal_ (Sensor normal), 1=Cx1_Sensor_fault_ (Sensor fault)
  compu method CM_RPAS_SensorFaultStsRLM: 0..1=RANGE, 0=Cx0_Sensor_normal_ (Sensor normal), 1=Cx1_Sensor_fault_ (Sensor fault)
  compu method CM_RPAS_SensorFaultStsRRC: 0..1=RANGE, 0=Cx0_Sensor_normal_ (Sensor normal), 1=Cx1_Sensor_fault_ (Sensor fault)
  compu method CM_RPAS_SensorFaultStsRRM: 0..1=RANGE, 0=Cx0_Sensor_normal_ (Sensor normal), 1=Cx1_Sensor_fault_ (Sensor fault)
  compu method CM_RPAS_WorkSts: 0..3=RANGE, 0=Cx0_Disable_, 1=Cx1_Enable_, 2=Cx2_Active_, 3=Cx3_Failed_
  compu method CM_RRDoorSts: 0..1=RANGE, 0=Cx0_Closed_, 1=Cx1_Open_
  compu method CM_RSDS_CTA_Brake_ON_OFF: 0..1=RANGE, 0=Cx0_CTA_Brake_ON_ (CTA _Brake ON), 1=Cx1_CTA_Brake_OFF_ (CTA _Brake OFF)
  compu method CM_RSDS_CTA_ON_OFF: 0..1=RANGE, 0=Cx0_CTA_ON_ (CTA ON), 1=Cx1_CTA_OFF_ (CTA OFF)
  compu method CM_RSDS_DOW_ErrorSts: 0..3=RANGE, 0=Cx0_No_Error_ (No Error), 1=Cx1_Error_, 2=Cx2_Function_Limited_ (Function Limited), 3=Cx3_Reserved_
  compu method CM_RSDS_DOW_ON_OFF: 0..1=RANGE, 0=Cx0_DOW_ON_ (DOW ON), 1=Cx1_DOW_OFF_ (DOW OFF)
  compu method CM_RSDS_LCA_ON_OFF: 0..1=RANGE, 0=Cx0_LCA_ON_ (LCA ON), 1=Cx1_LCA_OFF_ (LCA OFF)
  compu method CM_RSDS_LCACTARCW_ErrorSts: 0..1=RANGE, 0=Cx0_No_Error_ (No Error), 1=Cx1_Error_
  compu method CM_RSDS_ON_OFF: 0..1=RANGE, 0=Cx0_RSDS_ON_ (RSDS ON), 1=Cx1_RSDS_OFF_ (RSDS OFF)
  compu method CM_RSDS_RCW_ON_OFF: 0..1=RANGE, 0=Cx0_RCW_ON_ (RCW ON), 1=Cx1_RCW_OFF_ (RCW OFF)
  compu method CM_RSDSBlindnessSts: 0..1=RANGE, 0=Cx0_No_Blindness_ (No Blindness), 1=Cx1_Blindness_
  compu method CM_RSDSTrailerSts: 0..1=RANGE, 0=Cx0_None_, 1=Cx1_Trailer_
  compu method CM_SeatSwErrorSts: 0..1=RANGE, 0=Cx0_No_Error_ (No Error), 1=Cx1_Error_
  compu method CM_SeatSwSts: 0..1=RANGE, 0=Cx0_OFF_, 1=Cx1_ON_
  compu method CM_SeekDownSwSts: 0..3=RANGE, 0=Cx0_Released_, 1=Cx1_Pressed_, 2=Cx2_error_, 3=Cx3_invalidation_
  compu method CM_SeekUpSwSts: 0..3=RANGE, 0=Cx0_Released_, 1=Cx1_Pressed_, 2=Cx2_error_, 3=Cx3_invalidation_
  compu method CM_Sgl_View_Ind: 0..7=RANGE, 0=Cx0_Front_View_ (Front View), 1=Cx1_Rear_View_ (Rear View), 2=Cx2_Left_View_ (Left View), 3=Cx3_Right_View_ (Right View), 4=Cx4_Reserved_, 5=Cx5_Reserved_, 6=Cx6_Reserved_
  compu method CM_Sgl_View_Sel: 0..15=RANGE, 0=Cx0_No_Commands_ (No Commands), 1=Cx1_Front_View_ (Front View), 2=Cx2_Rear_View_ (Rear View), 3=Cx3_Left_View_ (Left View), 4=Cx4_Right_View_ (Right View), 5=Cx5_Front_Zoom_In_View_ (Front Zoom-In View), 6=Cx6_Rear_Zoom_In_View_ (Rear Zoom-In View), 7=Cx7_Reserved_
  compu method CM_Signal_RearInteriorLight: phys=raw for raw 0..1
  compu method CM_Signal_RearLeftDoor: phys=raw for raw 0..1
  compu method CM_Signal_RearRightDoor: phys=raw for raw 0..1
  compu method CM_Signal_Rx11bit_OnWrite: phys=raw for raw 0..2047
  compu method CM_Signal_Rx15bit_OnWrite: phys=raw for raw 0..32767
  compu method CM_Signal_Rx16bit_Cyclic: phys=raw for raw 0..65535
  compu method CM_Signal_Rx20bit_Cyclic: phys=raw for raw 0..1048575
  compu method CM_Signal_Rx8bit_Cyclic: phys=raw for raw 0..255
  compu method CM_Signal_StartAppl_RxCtrl_MyECU: phys=raw for raw 0..255
  compu method CM_Signal_StartAppl_RxData_MyECU: phys=raw for raw 0..255
  compu method CM_Signal_StartAppl_TxCtrl_MyECU: phys=raw for raw 0..255
  compu method CM_Signal_StartAppl_TxData_MyECU: phys=raw for raw 0..255
  compu method CM_Signal_Tx10bit_Cyclic: phys=raw for raw 0..1023
  compu method CM_Signal_Tx24bit_Cyclic: phys=raw for raw 0..16777215
  compu method CM_Signal_Tx24bit_OnWrite: phys=raw for raw 0..16777215
  compu method CM_Signal_Tx32bit_Cyclic: phys=raw for raw 0..4294967295
  compu method CM_Signal_Tx32bit_OnWrite: phys=raw for raw 0..4294967295
  compu method CM_Signal_Tx4bit_Cyclic: phys=raw for raw 0..15
  compu method CM_SigRx_Prof1C_CRC: phys=raw for raw 0..255
  compu method CM_SigRx_Prof1C_DataId_HiByte_LoNib: phys=raw for raw 0..15
  compu method CM_SigRx_Prof1C_Sig32Bit: phys=raw for raw 0..4294967295
  compu method CM_SigRx_Prof1C_Sig3Bit: phys=raw for raw 0..7
  compu method CM_SigRx_Prof1C_Sig4Bit: phys=raw for raw 0..15
  compu method CM_SigRx_Prof1C_SQ: phys=raw for raw 0..15
  compu method CM_SigTx_Prof1C_CRC: phys=raw for raw 0..255
  compu method CM_SigTx_Prof1C_DataId_HiByte_LoNib: phys=raw for raw 0..15
  compu method CM_SigTx_Prof1C_Sig16Bit: phys=raw for raw 0..65535
  compu method CM_SigTx_Prof1C_Sig2Bit: phys=raw for raw 0..3
  compu method CM_SigTx_Prof1C_Sig4Bit: phys=raw for raw 0..15
  compu method CM_SigTx_Prof1C_Sig8Bit: phys=raw for raw 0..255
  compu method CM_SigTx_Prof1C_SQ: phys=raw for raw 0..15
  compu method CM_SOC: 0..127=RANGE, 0=Cx00_valid_value_ (valid value), 101=Cx65_Reserved_, 127=Cx7F_Invalid_; unit %  # Source signal range: [0,100]
  compu method CM_SOH_SUL: 0..255=RANGE, 0=Cx00_valid_value_ (valid value), 101=Cx65_Reserved_, 255=CxFF_Invalid_; unit %  # Source signal range: [0,100]
  compu method CM_SpdLockSet: 0..1=RANGE, 0=Cx0_on_, 1=Cx1_off_
  compu method CM_SSSSet: 0..1=RANGE, 0=Cx0_OFF_, 1=Cx1_ON_
  compu method CM_Stat_PwrSv_Lvl: 0..7=RANGE, 0=Cx0_Normal_, 1=Cx1_Level_1_ (Level 1), 2=Cx2_Level_2_ (Level 2), 3=Cx3_Reserved_  # Source signal range: [0,1]
  compu method CM_SteerWheelAngle: 0=Cx0000_Valid_, 7801=Cx1E79_Reserved_, 32767=Cx7FFF_Invalid_, phys=raw*0.1 for raw 0..32767  # Source signal range: [0,7800]
  compu method CM_SteerWheelAngleSign: 0..1=RANGE, 0=Cx0_Left_Positive_ (Left (Positive)), 1=Cx1_Right_Negative_ (Right (Negative))
  compu method CM_SystemPowerMode: 0..3=RANGE, 0=Cx0_OFF_, 1=Cx1_ACC_, 2=Cx2_ON_, 3=Cx3_Crank_
  compu method CM_SystemPowerModeValid: 0..1=RANGE, 0=Cx0_Invalid_, 1=Cx1_Valid_
  compu method CM_TGS_LEVER: 0..15=RANGE, 0=Cx0_Select_lever_in_position_P_ (Select lever in position P), 1=Cx1_Reserved_, 2=Cx2_Reserved_, 3=Cx3_Reserved_, 4=Cx4_Reserved_, 5=Cx5_Select_lever_in_position_D_ (Select lever in position D), 6=Cx6_Select_lever_in_position_N_ (Select lever in position N), 7=Cx7_Select_lever_in_position_R_ (Select lever in position R), 8=Cx8_Select_lever_in_position_M_ (Select lever in position M), 9=Cx9_Reserved_, 14=CxE_Intermediate_position_ (Intermediate position), 15=CxF_Invalid_
  compu method CM_TimeMod: 0..1=RANGE, 0=Cx0_24_, 1=Cx1_12_
  compu method CM_TimeSet_Day: 0..31=RANGE, 0=Cx00_Invalid_, 1=Cx01_Valid_day_ (Valid day)
  compu method CM_TimeSet_Hour: 0..31=RANGE, 0=Cx00_Valid_hour_ (Valid hour), 24=Cx18_Invalid_
  compu method CM_TimeSet_Minutes: 0..63=RANGE, 0=Cx00_Valid_min_ (Valid min), 60=Cx3C_Invalid_
  compu method CM_TimeSet_Month: 0..15=RANGE, 0=Cx0_Invalid_, 1=Cx1_Valid_month_ (Valid month), 13=CxD_Reserved_
  compu method CM_TimeSet_Second: 0..63=RANGE, 0=Cx00_Valid_second_ (Valid second), 60=Cx3C_Invalid_
  compu method CM_TimeSet_Year_Left: 0..15=RANGE, 0=Cx0_Valid_, 10=CxA_Invalid_
  compu method CM_TimeSet_Year_Right: 0..15=RANGE, 0=Cx0_Valid_year_ (Valid year), 10=CxA_Invalid_
  compu method CM_TimIndcn: 0..1=RANGE, 0=Cx0_am, 1=Cx1_pm
  compu method CM_TranPMode_Req: 0..1=RANGE, 0=Cx0_Transport_Mode_OFF_ (Transport Mode OFF), 1=Cx1_Transport_Mode_ON_ (Transport Mode ON)
  compu method CM_TranPMode_Sts: 0..1=RANGE, 0=Cx0_Normal_Mode_ (Normal Mode), 1=Cx1_Transport_Mode_ (Transport Mode)
  compu method CM_TRANS_OIL_TEMP: 0=Cx00_Valid_values_ (Valid values), 255=CxFF_Invalid_, phys=raw-40 for raw 0..255  # Source signal range: [0,254]
  compu method CM_TrunkSts: 0..1=RANGE, 0=Cx0_Closed_ (Closed��), 1=Cx1_Open_
  compu method CM_UnlockModSet: 0..1=RANGE, 0=Cx0_unlock_door_by_single_door_ (unlock door by single door), 1=Cx1_unlock_door_by_four_door_ (unlock door by four door)
  compu method CM_VehicleSpd: 0=Cx0000_Valid_, 5334=Cx14D6_Reserved_, phys=raw*0.05625 for raw 0..8191; unit kph  # Source signal range: [0,5333]
  compu method CM_VehicleSpdValid: 0..1=RANGE, 0=Cx0_Invalid_, 1=Cx1_Valid_
  compu method CM_VehTotDistance: phys=raw for raw 0..999999; unit Km
  compu method CM_VehTotDistanceValid: 0..1=RANGE, 0=Cx0_Invalid_, 1=Cx1_Valid_
  compu method CM_VolSwErrorSts: 0..1=RANGE, 0=Cx0_No_Error_ (No Error), 1=Cx1_Error_
  compu method CM_VolSwReq: 0..1=RANGE, 0=Cx0_No_request_ (No request), 1=Cx1_Request_
  compu method CM_VRSwSts: 0..3=RANGE, 0=Cx0_Released_, 1=Cx1_Pressed_, 2=Cx2_error_, 3=Cx3_invalidation_
  compu method CM_VSGSwSet: 0..1=RANGE, 0=Cx0_VSG_ON_ (VSG ON), 1=Cx1_VSG_OFF_ (VSG OFF)
  compu method CM_WirlsChrg: 0..1=RANGE, 0=Cx0_ON, 1=Cx1_OFF
  compu method CM_ZoonReq_TC: 0..1=RANGE, 0=Cx0_No_action_ (No action), 1=Cx1_Pressed_
package /DataType/Unit
  9 x unit, all with factor-si-to-unit=1, offset-si-to-unit=0:
    U_0: display-name=0
    U_C: display-name=��C
    U_Deg_C: display-name=Deg C
    U_Km: display-name=Km
    U_kPa: display-name=kPa
    U_kph: display-name=kph
    U_KWh: display-name=KWh
    U_p: display-name=%
    U_V: display-name=V
package /Predefined_DEV/ImplementationDataTypes
  impl type Dem_UdsStatusByteType: compu {mask 1: 1=DEM_UDS_STATUS_TF, mask 2: 2=DEM_UDS_STATUS_TFTOC, mask 4: 4=DEM_UDS_STATUS_PDTC, mask 8: 8=DEM_UDS_STATUS_CDTC, mask 16: 16=DEM_UDS_STATUS_TNCSLC, mask 32: 32=DEM_UDS_STATUS_TFSLC, mask 64: 64=DEM_UDS_STATUS_TNCTOC, mask 128: 128=DEM_UDS_STATUS_WIR}, range raw 0..255, implementation-data-type=uint8
  impl type NvM_RequestResultType: compu {0=NVM_REQ_OK, 1=NVM_REQ_NOT_OK, 2=NVM_REQ_PENDING, 3=NVM_REQ_INTEGRITY_FAILED, 4=NVM_REQ_BLOCK_SKIPPED, 5=NVM_REQ_NV_INVALIDATED, 6=NVM_REQ_CANCELED, 7=NVM_REQ_REDUNDANCY_FAILED, 8=NVM_REQ_RESTORED_FROM_ROM}, implementation-data-type=uint8
  impl type NvM_ServiceIdType: compu {6=NVM_READ_BLOCK, 7=NVM_WRITE_BLOCK, 8=NVM_RESTORE_BLOCK_DEFAULTS, 9=NVM_ERASE_BLOCK, 11=NVM_INVALIDATE_NV_BLOCK, 12=NVM_READ_ALL}, implementation-data-type=uint8
