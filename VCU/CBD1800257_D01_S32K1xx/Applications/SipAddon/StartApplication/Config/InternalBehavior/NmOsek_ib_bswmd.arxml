AUTOSAR XML (schema 4-2-1)
package /MICROSAR/NmOsek_ib_bswmd/BswModuleDescriptions
  bsw module description NmOsek: provided-entrys=NmOsek_MainFunction
    bsw internal behavior NmOsekBehavior
      6 x exclusive area:
        NMOSEK_EXCLUSIVE_AREA_0  # No interruption by any interrupt is allowed. Therefore this section must always lock global interrupts.
        NMOSEK_EXCLUSIVE_AREA_1  # No interruption of NmOsek_NetworkRelease(), NmOsek_DisableCommunication() and NmOsek_EnableCommunication() by NmOsek_MainFunction() allowed. Global interrupts must be locked if the interruption might happen.
        NMOSEK_EXCLUSIVE_AREA_2  # No interruption of NmOsek_PassiveStartUp() by NmOsek_MainFunction() allowed. Global interrupts must be locked if the interruption might happen.
        NMOSEK_EXCLUSIVE_AREA_3  # No interruption of NmOsek_SetUserData() by NmOsek_MainFunction() allowed. Global interrupts must be locked if the interruption might happen.
        NMOSEK_EXCLUSIVE_AREA_4  # No interruption of NmOsek_GetUserData() by NmOsek_RxIndication() or NmOsek_GetPduData() allowed. Global interrupts must be locked if the interruption might happen.
        NMOSEK_EXCLUSIVE_AREA_5  # No interruption of NmOsek_GetPduData() by NmOsek_RxIndication() or NmOsek_GetUserData() allowed. Global interrupts must be locked if the interruption might happen.
      bsw schedulable entity NmOsek_MainFunction: implemented-entry=NmOsek_MainFunction
      bsw timing event NmOsek_MainFunctionTimingEvent0: starts-on-event=NmOsek_MainFunction, period=0.01
  bsw module entry NmOsek_MainFunction: call-type=SCHEDULED, execution-context=TASK
