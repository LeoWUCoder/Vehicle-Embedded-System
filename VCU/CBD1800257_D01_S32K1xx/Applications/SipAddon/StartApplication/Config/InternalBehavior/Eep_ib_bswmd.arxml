AUTOSAR XML (schema 4-2-1)
package /TS_T40D2M10I0R0/Eep_ib_bswmd/BswModuleDescriptions
  bsw module description Eep: provided-entrys=Eep_MainFunction
    bsw internal behavior EepBehavior
      31 x exclusive area:
        EEP_EXCLUSIVE_AREA_{00..30}
      bsw schedulable entity Eep_MainFunction: implemented-entry=Eep_MainFunction
      bsw timing event Eep_MainFunctionTimingEvent0: starts-on-event=Eep_MainFunction, period=0.005
  bsw module entry Eep_MainFunction: call-type=SCHEDULED, execution-context=TASK
