AUTOSAR XML (schema 4-2-1)
package /TS_T40D2M10I0R0/Wdg_ib_bswmd/BswModuleDescriptions
  bsw module description Wdg
    bsw internal behavior WdgBehavior
      31 x exclusive area:
        WDG_EXCLUSIVE_AREA_{00..30}
