AUTOSAR XML (schema 4-2-1)
package /MICROSAR
  bsw implementation Nm_Impl: programming-language=C, sw-version=11.00.01, used-code-generator=DaVinci Configurator, vendor-id=30, ar-release-version=4.00.03
package /MICROSAR/Nm_ib_bswmd/BswModuleDescriptions
  bsw module description Nm: provided-entrys=Nm_MainFunction
    bsw internal behavior NmBehavior
      exclusive area NM_EXCLUSIVE_AREA_0  # No interruption by any interrupt allowed
      exclusive area NM_EXCLUSIVE_AREA_1  # Interrupt locks are required if any of these functions are executed in an interrupt context: Nm_NetworkMode, Nm_PrepareBusSleepMode, Nm_BusSleepMode, Nm_RemoteSleepIndication, Nm_RemoteSleepCancellation, Nm_CoordReadyToSleepIndication, Nm_CoordReadyToSleepCancellation
  bsw module entry Nm_MainFunction: call-type=SCHEDULED, execution-context=TASK
