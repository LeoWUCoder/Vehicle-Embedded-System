AUTOSAR XML (schema 4-2-1)
package /TS_T40D2M10I0R0/Csec_ib_bswmd/BswModuleDescriptions
  bsw module description Csec
    bsw internal behavior CsecBehavior
