AUTOSAR XML (schema 4-2-1)
package /MICROSAR/Can_ImxFlexcan3_ib_bswmd/BswModuleDescriptions
  bsw module description Can: provided-entrys=[Can_MainFunction_BusOff, Can_MainFunction_Wakeup, Can_MainFunction_Mode, Can_MainFunction_Write]
    bsw internal behavior Can_ImxFlexcan3_Behavior
      7 x exclusive area:
        CAN_EXCLUSIVE_AREA_{0..6}
      4 x bsw schedulable entity:
        Can_MainFunction_BusOff: implemented-entry=Can_MainFunction_BusOff
        Can_MainFunction_Wakeup: implemented-entry=Can_MainFunction_Wakeup
        Can_MainFunction_Mode: implemented-entry=Can_MainFunction_Mode
        Can_MainFunction_Write: implemented-entry=Can_MainFunction_Write
      4 x bsw timing event, all with period=0.01:
        Can_MainFunction_BusOffTimingEvent0: starts-on-event=Can_MainFunction_BusOff
        Can_MainFunction_WakeupTimingEvent0: starts-on-event=Can_MainFunction_Wakeup
        Can_MainFunction_ModeTimingEvent0: starts-on-event=Can_MainFunction_Mode
        Can_MainFunction_WriteTimingEvent0: starts-on-event=Can_MainFunction_Write
  4 x bsw module entry, all with call-type=SCHEDULED, execution-context=TASK:
    Can_MainFunction_BusOff
    Can_MainFunction_Wakeup
    Can_MainFunction_Mode
    Can_MainFunction_Write
