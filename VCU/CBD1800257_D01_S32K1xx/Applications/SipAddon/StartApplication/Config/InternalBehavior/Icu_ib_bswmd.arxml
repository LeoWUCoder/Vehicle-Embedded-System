AUTOSAR XML (schema 4-2-1)
package /TS_T40D2M10I0R0/Icu_ib_bswmd/BswModuleDescriptions
  bsw module description Icu
    bsw internal behavior IcuBehavior
      31 x exclusive area:
        ICU_EXCLUSIVE_AREA_{00..30}
