AUTOSAR XML (schema 4-2-1)
package /TS_T40D2M10I0R0/Mcl_ib_bswmd/BswModuleDescriptions
  bsw module description Mcl
    bsw internal behavior MclBehavior
      65 x exclusive area:
        MCL_EXCLUSIVE_AREA_{00..64}
