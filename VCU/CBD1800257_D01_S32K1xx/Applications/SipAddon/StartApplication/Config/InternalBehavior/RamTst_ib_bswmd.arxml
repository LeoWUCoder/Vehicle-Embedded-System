AUTOSAR XML (schema 4-2-1)
package /MICROSAR/RamTst_ib_bswmd/BswModuleDescriptions
  bsw module description RamTst: provided-entrys=RamTst_MainFunction
    bsw internal behavior RamTstBehavior
      exclusive area RAMTST_EXCLUSIVE_AREA_0
      bsw schedulable entity RamTst_MainFunction: implemented-entry=RamTst_MainFunction
      bsw timing event RamTst_MainFunctionTimingEvent0: starts-on-event=RamTst_MainFunction, period=0.01
  bsw module entry RamTst_MainFunction: call-type=SCHEDULED, execution-context=TASK
