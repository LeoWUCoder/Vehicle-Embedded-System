AUTOSAR XML (schema 4-2-1)
package /TS_T40D2M10I0R0/Fls_ib_bswmd/BswModuleDescriptions
  bsw module description Fls: provided-entrys=Fls_MainFunction
    bsw internal behavior FlsBehavior
      31 x exclusive area:
        FLS_EXCLUSIVE_AREA_{00..30}
      bsw schedulable entity Fls_MainFunction: implemented-entry=Fls_MainFunction
      bsw timing event Fls_MainFunctionTimingEvent0: starts-on-event=Fls_MainFunction, period=0.01
  bsw module entry Fls_MainFunction: call-type=SCHEDULED, execution-context=TASK
