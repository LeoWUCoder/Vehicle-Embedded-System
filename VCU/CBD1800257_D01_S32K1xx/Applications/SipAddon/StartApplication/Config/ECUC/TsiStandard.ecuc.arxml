[part 3 of 5: package /ActiveEcuC]
AUTOSAR XML (schema 4-2-1)
package /ActiveEcuC  (continued)
  module config Rte: implementation-config-variant=VARIANT-PRE-COMPILE, module-description=Rte_Impl  (continued)
    7 x RteSwComponentInstance:  (continued)
      ComM_EcuSwComposition: RteSoftwareComponentInstanceRef=ComM
        13 x RteEventToTaskMapping, all with RteImmediateRestart=false:
          Timer_ComM_MainFunction_0: RtePositionInTask=6, RteEventRef=Timer_ComM_MainFunction_0, RteMappedToTaskRef=Os/Default_BSW_Async_Task, RteUsedOsEventRef=Rte_Ev_Cyclic2_Default_BSW_Async_Task_0_20ms, RteUsedOsAlarmRef=Os/Rte_Al_TE2_Default_BSW_Async_Task_0_20ms
          OpEventLimitECUToNoComMode_LimitECUToNoComMode_modeLimitation: RteEventRef=OpEventLimitECUToNoComMode_LimitECUToNoComMode_modeLimitation
          OpEventReadInhibitCounter_ReadInhibitCounter_modeLimitation: RteEventRef=OpEventReadInhibitCounter_ReadInhibitCounter_modeLimitation
          OpEventResetInhibitCounter_ResetInhibitCounter_modeLimitation: RteEventRef=OpEventResetInhibitCounter_ResetInhibitCounter_modeLimitation
          OpEventSetECUGroupClassification_SetECUGroupClassification_modeLimitation: RteEventRef=OpEventSetECUGroupClassification_SetECUGroupClassification_modeLimitation
          OpEventGetRequestedComMode_GetRequestedComMode_UR_CN_CAN_52ce3533: RteEventRef=OpEventGetRequestedComMode_GetRequestedComMode_UR_CN_CAN_52ce3533
          OpEventRequestComMode_RequestComMode_UR_CN_CAN_52ce3533: RteEventRef=OpEventRequestComMode_RequestComMode_UR_CN_CAN_52ce3533
          OpEventGetMaxComMode_GetMaxComMode_UR_CN_CAN_52ce3533: RteEventRef=OpEventGetMaxComMode_GetMaxComMode_UR_CN_CAN_52ce3533
          OpEventPreventWakeUp_PreventWakeUp_CW_CN_CAN_fe6ecc87: RteEventRef=OpEventPreventWakeUp_PreventWakeUp_CW_CN_CAN_fe6ecc87
          OpEventGetInhibitionStatus_GetInhibitionStatus_CL_CN_CAN_fe6ecc87: RteEventRef=OpEventGetInhibitionStatus_GetInhibitionStatus_CL_CN_CAN_fe6ecc87
          OpEventGetInhibitionStatus_GetInhibitionStatus_CW_CN_CAN_fe6ecc87: RteEventRef=OpEventGetInhibitionStatus_GetInhibitionStatus_CW_CN_CAN_fe6ecc87
          OpEventGetCurrentComMode_GetCurrentComMode_UR_CN_CAN_52ce3533: RteEventRef=OpEventGetCurrentComMode_GetCurrentComMode_UR_CN_CAN_52ce3533
          OpEventLimitChannelToNoComMode_LimitChannelToNoComMode_CL_CN_CAN_fe6ecc87: RteEventRef=OpEventLimitChannelToNoComMode_LimitChannelToNoComMode_CL_CN_CAN_fe6ecc87
      DemMaster_0_EcuSwComposition: RteSoftwareComponentInstanceRef=DemMaster_0
        46 x RteEventToTaskMapping, all with RteImmediateRestart=false:
          Timer_Dem_MasterMainFunction: RtePositionInTask=10, RteEventRef=Timer_Dem_MasterMainFunction, RteMappedToTaskRef=Os/Default_BSW_Async_Task, RteUsedOsEventRef=Rte_Ev_Cyclic2_Default_BSW_Async_Task_0_10ms, RteUsedOsAlarmRef=Os/Rte_Al_TE2_Default_BSW_Async_Task_0_10ms
          OpEventPostRunRequested_GetPostRunRequested_DemServices: RteEventRef=OpEventPostRunRequested_GetPostRunRequested_DemServices
          OpEventGetDTCStatusAvailabilityMask_GetDTCStatusAvailabilityMask_DemServices: RteEventRef=OpEventGetDTCStatusAvailabilityMask_GetDTCStatusAvailabilityMask_DemServices
          OpEventSetEnableCondition_SetEnableCondition_EnableCond_V51: RteEventRef=OpEventSetEnableCondition_SetEnableCondition_EnableCond_V51
          OpEventSetEnableCondition_SetEnableCondition_EnableCond_supply: RteEventRef=OpEventSetEnableCondition_SetEnableCondition_EnableCond_supply
          OpEventSetEnableCondition_SetEnableCondition_EnableCond_power: RteEventRef=OpEventSetEnableCondition_SetEnableCondition_EnableCond_power
          OpEventSetEnableCondition_SetEnableCondition_EnableCond_STATE_NORMAL: RteEventRef=OpEventSetEnableCondition_SetEnableCondition_EnableCond_STATE_NORMAL
          OpEventSetEnableCondition_SetEnableCondition_EnableCond_HUT: RteEventRef=OpEventSetEnableCondition_SetEnableCondition_EnableCond_HUT
          OpEventSetEnableCondition_SetEnableCondition_EnableCond_sequence: RteEventRef=OpEventSetEnableCondition_SetEnableCondition_EnableCond_sequence
          OpEventSetEnableCondition_SetEnableCondition_EnableCond_Vechile: RteEventRef=OpEventSetEnableCondition_SetEnableCondition_EnableCond_Vechile
          OpEventSetEnableCondition_SetEnableCondition_EnableCond_No: RteEventRef=OpEventSetEnableCondition_SetEnableCondition_EnableCond_No
          OpEventSetEnableCondition_SetEnableCondition_EnableCond_fault: RteEventRef=OpEventSetEnableCondition_SetEnableCondition_EnableCond_fault
          OpEventSetEnableCondition_SetEnableCondition_EnableCond_up: RteEventRef=OpEventSetEnableCondition_SetEnableCondition_EnableCond_up
          OpEventSetEnableCondition_SetEnableCondition_EnableCond_voltage: RteEventRef=OpEventSetEnableCondition_SetEnableCondition_EnableCond_voltage
          OpEventSetEnableCondition_SetEnableCondition_EnableCond_IP: RteEventRef=OpEventSetEnableCondition_SetEnableCondition_EnableCond_IP
          OpEventSetEnableCondition_SetEnableCondition_EnableCond_in: RteEventRef=OpEventSetEnableCondition_SetEnableCondition_EnableCond_in
          OpEventSetEnableCondition_SetEnableCondition_EnableCond_or: RteEventRef=OpEventSetEnableCondition_SetEnableCondition_EnableCond_or
          OpEventSetEnableCondition_SetEnableCondition_EnableCond_H9: RteEventRef=OpEventSetEnableCondition_SetEnableCondition_EnableCond_H9
          OpEventSetEnableCondition_SetEnableCondition_EnableCond_variant: RteEventRef=OpEventSetEnableCondition_SetEnableCondition_EnableCond_variant
          OpEventSetEnableCondition_SetEnableCondition_EnableCond_diagnostic: RteEventRef=OpEventSetEnableCondition_SetEnableCondition_EnableCond_diagnostic
          OpEventSetEnableCondition_SetEnableCondition_EnableCond_is: RteEventRef=OpEventSetEnableCondition_SetEnableCondition_EnableCond_is
          OpEventSetEnableCondition_SetEnableCondition_EnableCond_camer: RteEventRef=OpEventSetEnableCondition_SetEnableCondition_EnableCond_camer
          OpEventSetEnableCondition_SetEnableCondition_EnableCond_display: RteEventRef=OpEventSetEnableCondition_SetEnableCondition_EnableCond_display
          OpEventSetEnableCondition_SetEnableCondition_EnableCond_completed: RteEventRef=OpEventSetEnableCondition_SetEnableCondition_EnableCond_completed
          OpEventSetEnableCondition_SetEnableCondition_EnableCond_Start: RteEventRef=OpEventSetEnableCondition_SetEnableCondition_EnableCond_Start
          OpEventSetEnableCondition_SetEnableCondition_EnableCond_China: RteEventRef=OpEventSetEnableCondition_SetEnableCondition_EnableCond_China
          OpEventSetEnableCondition_SetEnableCondition_EnableCond_online: RteEventRef=OpEventSetEnableCondition_SetEnableCondition_EnableCond_online
          OpEventGetOperationCycleState_GetOperationCycleState_OpCycle_IgnitionCycle: RteEventRef=OpEventGetOperationCycleState_GetOperationCycleState_OpCycle_IgnitionCycle
          OpEventGetOperationCycleState_GetOperationCycleState_OpCycle_PowerCycle: RteEventRef=OpEventGetOperationCycleState_GetOperationCycleState_OpCycle_PowerCycle
          OpEventSetOperationCycleState_SetOperationCycleState_OpCycle_IgnitionCycle: RteEventRef=OpEventSetOperationCycleState_SetOperationCycleState_OpCycle_IgnitionCycle
          OpEventSetOperationCycleState_SetOperationCycleState_OpCycle_PowerCycle: RteEventRef=OpEventSetOperationCycleState_SetOperationCycleState_OpCycle_PowerCycle
          OpEventGetNumberOfEventMemoryEntries_GetNumberOfEventMemoryEntries_OverflowIndPrimaryMemory_DemClient: RteEventRef=OpEventGetNumberOfEventMemoryEntries_GetNumberOfEventMemoryEntries_OverflowIndPrimaryMemory_DemClient
          OpEventClearDTC_ClearDTC_ClearDTC_DemClient: RteEventRef=OpEventClearDTC_ClearDTC_ClearDTC_DemClient
          OpEventGetEventMemoryOverflow_GetEventMemoryOverflow_OverflowIndPrimaryMemory_DemClient: RteEventRef=OpEventGetEventMemoryOverflow_GetEventMemoryOverflow_OverflowIndPrimaryMemory_DemClient
          OpEventSelectDTC_SelectDTC_ClearDTC_DemClient: RteEventRef=OpEventSelectDTC_SelectDTC_ClearDTC_DemClient
          OpEventGetEventFreezeFrameDataEx_GetEventFreezeFrameDataEx_GeneralEvtInfo: RteEventRef=OpEventGetEventFreezeFrameDataEx_GetEventFreezeFrameDataEx_GeneralEvtInfo
          OpEventGetDTCOfEvent_GetDTCOfEvent_GeneralEvtInfo: RteEventRef=OpEventGetDTCOfEvent_GetDTCOfEvent_GeneralEvtInfo
          OpEventGetEventExtendedDataRecordEx_GetEventExtendedDataRecordEx_GeneralEvtInfo: RteEventRef=OpEventGetEventExtendedDataRecordEx_GetEventExtendedDataRecordEx_GeneralEvtInfo
          OpEventGetEventEnableCondition_GetEventEnableCondition_GeneralEvtInfo: RteEventRef=OpEventGetEventEnableCondition_GetEventEnableCondition_GeneralEvtInfo
          OpEventGetEventFailed_GetEventFailed_GeneralEvtInfo: RteEventRef=OpEventGetEventFailed_GetEventFailed_GeneralEvtInfo
          OpEventGetDebouncingOfEvent_GetDebouncingOfEvent_GeneralEvtInfo: RteEventRef=OpEventGetDebouncingOfEvent_GetDebouncingOfEvent_GeneralEvtInfo
          OpEventGetFaultDetectionCounter_GetFaultDetectionCounter_GeneralEvtInfo: RteEventRef=OpEventGetFaultDetectionCounter_GetFaultDetectionCounter_GeneralEvtInfo
          OpEventGetMonitorStatus_GetMonitorStatus_GeneralEvtInfo: RteEventRef=OpEventGetMonitorStatus_GetMonitorStatus_GeneralEvtInfo
          OpEventGetEventUdsStatus_GetEventUdsStatus_GeneralEvtInfo: RteEventRef=OpEventGetEventUdsStatus_GetEventUdsStatus_GeneralEvtInfo
          OpEventGetEventTested_GetEventTested_GeneralEvtInfo: RteEventRef=OpEventGetEventTested_GetEventTested_GeneralEvtInfo
          OpEventGetEventStatus_GetEventStatus_GeneralEvtInfo: RteEventRef=OpEventGetEventStatus_GetEventStatus_GeneralEvtInfo
      Det_EcuSwComposition: RteSoftwareComponentInstanceRef=Det
      Os_OsCore0_swc_EcuSwComposition: RteSoftwareComponentInstanceRef=Os_OsCore0_swc
        OpEventGetCounterValue_GetCounterValue_OsService_SystemTimer (RteEventToTaskMapping): RteImmediateRestart=false, RteEventRef=OpEventGetCounterValue_GetCounterValue_OsService_SystemTimer
        OpEventGetElapsedValue_GetElapsedValue_OsService_SystemTimer (RteEventToTaskMapping): RteImmediateRestart=false, RteEventRef=OpEventGetElapsedValue_GetElapsedValue_OsService_SystemTimer
    15 x RteBswModuleInstance:
      Adc: RteBswImplementationRef=Adc_Impl, RteBswModuleConfigurationRef=Adc
        31 x RteBswExclusiveAreaImpl, all with RteExclusiveAreaImplMechanism=ALL_INTERRUPT_BLOCKING:
          ADC_EXCLUSIVE_AREA_{00..30}: RteBswExclusiveAreaRef=ADC_EXCLUSIVE_AREA_{00..30}
      Gpt: RteBswImplementationRef=Gpt_Impl, RteBswModuleConfigurationRef=Gpt
        65 x RteBswExclusiveAreaImpl, all with RteExclusiveAreaImplMechanism=ALL_INTERRUPT_BLOCKING:
          GPT_EXCLUSIVE_AREA_{00..64}: RteBswExclusiveAreaRef=GPT_EXCLUSIVE_AREA_{00..64}
      Fls: RteBswImplementationRef=Fls_Impl, RteBswModuleConfigurationRef=Fls
        31 x RteBswExclusiveAreaImpl, all with RteExclusiveAreaImplMechanism=ALL_INTERRUPT_BLOCKING:
          FLS_EXCLUSIVE_AREA_{00..30}: RteBswExclusiveAreaRef=FLS_EXCLUSIVE_AREA_{00..30}
        Fls_MainFunctionTimingEvent0 (RteBswEventToTaskMapping): RteBswImmediateRestart=false, RteBswEventRef=Fls_MainFunctionTimingEvent0
      Port: RteBswImplementationRef=Port_Impl, RteBswModuleConfigurationRef=Port
        31 x RteBswExclusiveAreaImpl, all with RteExclusiveAreaImplMechanism=ALL_INTERRUPT_BLOCKING:
          PORT_EXCLUSIVE_AREA_{00..30}: RteBswExclusiveAreaRef=PORT_EXCLUSIVE_AREA_{00..30}
      Wdg: RteBswImplementationRef=Wdg_Impl, RteBswModuleConfigurationRef=Wdg
        31 x RteBswExclusiveAreaImpl, all with RteExclusiveAreaImplMechanism=ALL_INTERRUPT_BLOCKING:
          WDG_EXCLUSIVE_AREA_{00..30}: RteBswExclusiveAreaRef=WDG_EXCLUSIVE_AREA_{00..30}
      Dio: RteBswImplementationRef=Dio_Impl, RteBswModuleConfigurationRef=Dio
        31 x RteBswExclusiveAreaImpl, all with RteExclusiveAreaImplMechanism=ALL_INTERRUPT_BLOCKING:
          DIO_EXCLUSIVE_AREA_{00..30}: RteBswExclusiveAreaRef=DIO_EXCLUSIVE_AREA_{00..30}
      Mcu: RteBswImplementationRef=Mcu_Impl, RteBswModuleConfigurationRef=Mcu
        31 x RteBswExclusiveAreaImpl, all with RteExclusiveAreaImplMechanism=ALL_INTERRUPT_BLOCKING:
          MCU_EXCLUSIVE_AREA_{00..30}: RteBswExclusiveAreaRef=MCU_EXCLUSIVE_AREA_{00..30}
      Eep: RteBswImplementationRef=Eep_Impl, RteBswModuleConfigurationRef=Eep
        Eep_MainFunctionTimingEvent0 (RteBswEventToTaskMapping):
          RteBswImmediateRestart = false
          RteBswPositionInTask = 16
          RteBswEventRef = Eep_MainFunctionTimingEvent0
          RteBswMappedToTaskRef = Os/Default_BSW_Async_Task
          RteBswUsedOsEventRef = Rte_Ev_Cyclic2_Default_BSW_Async_Task_0_5ms
          RteBswUsedOsAlarmRef = Os/Rte_Al_TE2_Default_BSW_Async_Task_0_5ms
        31 x RteBswExclusiveAreaImpl, all with RteExclusiveAreaImplMechanism=ALL_INTERRUPT_BLOCKING:
          EEP_EXCLUSIVE_AREA_{00..30}: RteBswExclusiveAreaRef=EEP_EXCLUSIVE_AREA_{00..30}
      Spi: RteBswImplementationRef=Spi_Impl, RteBswModuleConfigurationRef=Spi
        Spi_MainFunction_HandlingTimingEvent0 (RteBswEventToTaskMapping):
          RteBswImmediateRestart = false
          RteBswPositionInTask = 18
          RteBswEventRef = Spi_MainFunction_HandlingTimingEvent0
          RteBswMappedToTaskRef = Os/Default_BSW_Async_Task
          RteBswUsedOsEventRef = Rte_Ev_Cyclic2_Default_BSW_Async_Task_0_5ms
          RteBswUsedOsAlarmRef = Os/Rte_Al_TE2_Default_BSW_Async_Task_0_5ms
        31 x RteBswExclusiveAreaImpl, all with RteExclusiveAreaImplMechanism=ALL_INTERRUPT_BLOCKING:
          SPI_EXCLUSIVE_AREA_{00..30}: RteBswExclusiveAreaRef=SPI_EXCLUSIVE_AREA_{00..30}
      Pwm: RteBswImplementationRef=Pwm_Impl, RteBswModuleConfigurationRef=Pwm
        65 x RteBswExclusiveAreaImpl, all with RteExclusiveAreaImplMechanism=ALL_INTERRUPT_BLOCKING:
          PWM_EXCLUSIVE_AREA_{00..64}: RteBswExclusiveAreaRef=PWM_EXCLUSIVE_AREA_{00..64}
      Icu: RteBswImplementationRef=Icu_Impl, RteBswModuleConfigurationRef=Icu
        31 x RteBswExclusiveAreaImpl, all with RteExclusiveAreaImplMechanism=ALL_INTERRUPT_BLOCKING:
          ICU_EXCLUSIVE_AREA_{00..30}: RteBswExclusiveAreaRef=ICU_EXCLUSIVE_AREA_{00..30}
      Csec: RteBswImplementationRef=Csec_Impl, RteBswModuleConfigurationRef=Csec
      Mcl: RteBswImplementationRef=Mcl_Impl, RteBswModuleConfigurationRef=Mcl
        65 x RteBswExclusiveAreaImpl, all with RteExclusiveAreaImplMechanism=ALL_INTERRUPT_BLOCKING:
          MCL_EXCLUSIVE_AREA_{00..64}: RteBswExclusiveAreaRef=MCL_EXCLUSIVE_AREA_{00..64}
      Ea: RteBswImplementationRef=Ea_Impl, RteBswModuleConfigurationRef=Ea
        Ea_MainFunctionTimingEvent0 (RteBswEventToTaskMapping):
          RteBswImmediateRestart = false
          RteBswPositionInTask = 15
          RteBswEventRef = Ea_MainFunctionTimingEvent0
          RteBswMappedToTaskRef = Os/Default_BSW_Async_Task
          RteBswUsedOsEventRef = Rte_Ev_Cyclic2_Default_BSW_Async_Task_0_5ms
          RteBswUsedOsAlarmRef = Os/Rte_Al_TE2_Default_BSW_Async_Task_0_5ms
      NvM: RteBswImplementationRef=NvM_Impl, RteBswModuleConfigurationRef=NvM
        NvM_MainFunctionTimingEvent0 (RteBswEventToTaskMapping):
          RteBswImmediateRestart = false
          RteBswPositionInTask = 13
          RteBswEventRef = NvM_MainFunctionTimingEvent0
          RteBswMappedToTaskRef = Os/Default_BSW_Async_Task
          RteBswUsedOsEventRef = Rte_Ev_Cyclic2_Default_BSW_Async_Task_0_10ms
          RteBswUsedOsAlarmRef = Os/Rte_Al_TE2_Default_BSW_Async_Task_0_10ms
        NVM_EXCLUSIVE_AREA_0 (RteBswExclusiveAreaImpl): RteExclusiveAreaImplMechanism=ALL_INTERRUPT_BLOCKING, RteBswExclusiveAreaRef=NVM_EXCLUSIVE_AREA_0
    NvM_EcuSwComposition (RteSwComponentInstance): RteSoftwareComponentInstanceRef=NvM
      15 x RteEventToTaskMapping, all with RteImmediateRestart=false:
        Timer_NvM_MainFunction: RtePositionInTask=13, RteEventRef=Timer_NvM_MainFunction, RteMappedToTaskRef=Os/Default_BSW_Async_Task, RteUsedOsEventRef=Rte_Ev_Cyclic2_Default_BSW_Async_Task_0_10ms, RteUsedOsAlarmRef=Os/Rte_Al_TE2_Default_BSW_Async_Task_0_10ms
        OpEventInvalidateNvBlock_InvalidateNvBlock_PS_StartApplication_NvMBlock1: RteEventRef=OpEventInvalidateNvBlock_InvalidateNvBlock_PS_StartApplication_NvMBlock1
        OpEventSetRamBlockStatus_SetRamBlockStatus_PS_StartApplication_NvMBlock1: RteEventRef=OpEventSetRamBlockStatus_SetRamBlockStatus_PS_StartApplication_NvMBlock1
        OpEventSetBlockProtection_SetBlockProtection_PAdmin_StartApplication_NvMBlock1: RteEventRef=OpEventSetBlockProtection_SetBlockProtection_PAdmin_StartApplication_NvMBlock1
        OpEventGetErrorStatus_GetErrorStatus_PS_StartApplication_NvMBlock1: RteEventRef=OpEventGetErrorStatus_GetErrorStatus_PS_StartApplication_NvMBlock1
        OpEventReadBlock_ReadBlock_PS_StartApplication_NvMBlock1: RteEventRef=OpEventReadBlock_ReadBlock_PS_StartApplication_NvMBlock1
        OpEventWriteBlock_WriteBlock_PS_StartApplication_NvMBlock1: RteEventRef=OpEventWriteBlock_WriteBlock_PS_StartApplication_NvMBlock1
        OpEventEraseBlock_EraseBlock_PS_StartApplication_NvMBlock1: RteEventRef=OpEventEraseBlock_EraseBlock_PS_StartApplication_NvMBlock1
        OpEventGetErrorStatus_GetErrorStatus_PS_StartApplication_NvMBlock2: RteEventRef=OpEventGetErrorStatus_GetErrorStatus_PS_StartApplication_NvMBlock2
        OpEventWriteBlock_WriteBlock_PS_StartApplication_NvMBlock2: RteEventRef=OpEventWriteBlock_WriteBlock_PS_StartApplication_NvMBlock2
        OpEventEraseBlock_EraseBlock_PS_StartApplication_NvMBlock2: RteEventRef=OpEventEraseBlock_EraseBlock_PS_StartApplication_NvMBlock2
        OpEventReadBlock_ReadBlock_PS_StartApplication_NvMBlock2: RteEventRef=OpEventReadBlock_ReadBlock_PS_StartApplication_NvMBlock2
        OpEventInvalidateNvBlock_InvalidateNvBlock_PS_StartApplication_NvMBlock2: RteEventRef=OpEventInvalidateNvBlock_InvalidateNvBlock_PS_StartApplication_NvMBlock2
        OpEventSetRamBlockStatus_SetRamBlockStatus_PS_StartApplication_NvMBlock2: RteEventRef=OpEventSetRamBlockStatus_SetRamBlockStatus_PS_StartApplication_NvMBlock2
        OpEventSetBlockProtection_SetBlockProtection_PAdmin_StartApplication_NvMBlock2: RteEventRef=OpEventSetBlockProtection_SetBlockProtection_PAdmin_StartApplication_NvMBlock2
    Dcm_EcuSwComposition (RteSwComponentInstance): RteSoftwareComponentInstanceRef=Dcm
      7 x RteEventToTaskMapping, all with RteImmediateRestart=false:
        Timer_Dcm_MainFunction: RtePositionInTask=9, RteEventRef=Timer_Dcm_MainFunction, RteMappedToTaskRef=Os/Default_BSW_Async_Task, RteUsedOsEventRef=Rte_Ev_Cyclic2_Default_BSW_Async_Task_0_10ms, RteUsedOsAlarmRef=Os/Rte_Al_TE2_Default_BSW_Async_Task_0_10ms
        OpEventGetActiveProtocol_GetActiveProtocol_DCMServices: RteEventRef=OpEventGetActiveProtocol_GetActiveProtocol_DCMServices
        OpEventGetSesCtrlType_GetSesCtrlType_DCMServices: RteEventRef=OpEventGetSesCtrlType_GetSesCtrlType_DCMServices
        OpEventResetToDefaultSession_ResetToDefaultSession_DCMServices: RteEventRef=OpEventResetToDefaultSession_ResetToDefaultSession_DCMServices
        OpEventGetSecurityLevel_GetSecurityLevel_DCMServices: RteEventRef=OpEventGetSecurityLevel_GetSecurityLevel_DCMServices
        OpEventSetActiveDiagnostic_SetActiveDiagnostic_DCMServices: RteEventRef=OpEventSetActiveDiagnostic_SetActiveDiagnostic_DCMServices
        OpEventGetRequestKind_GetRequestKind_DCMServices: RteEventRef=OpEventGetRequestKind_GetRequestKind_DCMServices
    WdgM (RteBswModuleInstance): RteBswImplementationRef=WdgM_Impl, RteBswModuleConfigurationRef=WdgM
      WDGM_EXCLUSIVE_AREA_0 (RteBswExclusiveAreaImpl): RteExclusiveAreaImplMechanism=ALL_INTERRUPT_BLOCKING, RteBswExclusiveAreaRef=WDGM_EXCLUSIVE_AREA_0
      WdgM_MainFunctionTimingEvent0 (RteBswEventToTaskMapping):
        RteBswImmediateRestart = false
        RteBswPositionInTask = 0
        RteBswEventRef = WdgM_MainFunctionTimingEvent0
        RteBswMappedToTaskRef = OsTask_WdgM_Cyclic
        RteBswUsedOsAlarmRef = Os/Rte_Al_TE2_OsTask_WdgM_Cyclic_0_10ms
    RamTst (RteBswModuleInstance): RteBswImplementationRef=RamTst_Impl, RteBswModuleConfigurationRef=RamTst
      RamTst_MainFunctionTimingEvent0 (RteBswEventToTaskMapping):
        RteBswImmediateRestart = false
        RteBswPositionInTask = 19
        RteBswEventRef = RamTst_MainFunctionTimingEvent0
        RteBswMappedToTaskRef = Os/Default_BSW_Async_Task
        RteBswUsedOsEventRef = Rte_Ev_Cyclic2_Default_BSW_Async_Task_0_10ms
        RteBswUsedOsAlarmRef = Os/Rte_Al_TE2_Default_BSW_Async_Task_0_10ms
      RAMTST_EXCLUSIVE_AREA_0 (RteBswExclusiveAreaImpl): RteExclusiveAreaImplMechanism=ALL_INTERRUPT_BLOCKING, RteBswExclusiveAreaRef=RAMTST_EXCLUSIVE_AREA_0
    StartApplication (RteSwComponentType): RteComponentTypeRef=StartApplication, RteImplementationRef=StartApplicationImplementation
      ComponentTypeCalibration (RteComponentTypeCalibration): RteCalibrationSupportEnabled=false
    StartApplication_EcuSwComposition (RteSwComponentInstance): RteSoftwareComponentInstanceRef=StartApplication
      14 x RteEventToTaskMapping, all with RteImmediateRestart=false:
        Timer_StartApplication_Cyclic1ms: RtePositionInTask=2, RteEventRef=Timer_StartApplication_Cyclic1ms, RteMappedToTaskRef=Os/Default_Appl_Task, RteUsedOsEventRef=Rte_Ev_Run_StartApplication_StartApplication_Cyclic1ms, RteUsedOsAlarmRef=Os/Rte_Al_TE_StartApplication_StartApplication_Cyclic1ms
        Timer_StartApplication_Cyclic10ms: RtePositionInTask=1, RteEventRef=Timer_StartApplication_Cyclic10ms, RteMappedToTaskRef=Os/Default_Appl_Task, RteUsedOsEventRef=Rte_Ev_Run_StartApplication_StartApplication_Cyclic10ms, RteUsedOsAlarmRef=Os/Rte_Al_TE_StartApplication_StartApplication_Cyclic10ms
        Timer_StartApplication_Cyclic250ms: RtePositionInTask=3, RteEventRef=Timer_StartApplication_Cyclic250ms, RteMappedToTaskRef=Os/Default_Appl_Task, RteUsedOsEventRef=Rte_Ev_Run_StartApplication_StartApplication_Cyclic250ms, RteUsedOsAlarmRef=Os/Rte_Al_TE_StartApplication_StartApplication_Cyclic250ms
        Timer_StartApplication_Cyclic1000ms: RtePositionInTask=0, RteEventRef=Timer_StartApplication_Cyclic1000ms, RteMappedToTaskRef=Os/Default_Appl_Task, RteUsedOsEventRef=Rte_Ev_Run_StartApplication_StartApplication_Cyclic1000ms, RteUsedOsAlarmRef=Os/Rte_Al_TE_StartApplication_StartApplication_Cyclic1000ms
        Timer_StartApplication_Init: RtePositionInTask=0, RteEventRef=Timer_StartApplication_Init, RteMappedToTaskRef=Default_Appl_Init_Task
        OpEventStartApplication_MEM_JobFinished_StartApplication_NvMBlock1_JobFinished_PpNvM_RpNotifyJobEnd_StartApplication_NvMBlock1: RteEventRef=OpEventStartApplication_MEM_JobFinished_StartApplication_NvMBlock1_JobFinished_PpNvM_RpNotifyJobEnd_StartApplication_NvMBlock1
        OpEventStartApplication_MEM_JobFinished_StartApplication_NvMBlock2_JobFinished_PpNvM_RpNotifyJobEnd_StartApplication_NvMBlock2: RteEventRef=OpEventStartApplication_MEM_JobFinished_StartApplication_NvMBlock2_JobFinished_PpNvM_RpNotifyJobEnd_StartApplication_NvMBlock2
        OpEventStartApplication_DIAG_DcmReadData_ReadData_PpDcmDataService_DID_StartApplication: RteEventRef=OpEventStartApplication_DIAG_DcmReadData_ReadData_PpDcmDataService_DID_StartApplication
        OpEventStartApplication_DIAG_DemReadData_ReadData_PpDemDataService_DemDataElementClass_StartApplication: RteEventRef=OpEventStartApplication_DIAG_DemReadData_ReadData_PpDemDataService_DemDataElementClass_StartApplication
        OpEventStartApplication_DIAG_DcmWriteData_WriteData_PpDcmDataService_DID_StartApplication: RteEventRef=OpEventStartApplication_DIAG_DcmWriteData_WriteData_PpDcmDataService_DID_StartApplication
        OpEventStartApplication_DIAG_ConditionCheckRead_ConditionCheckRead_PpDcmDataService_DID_StartApplication: RteEventRef=OpEventStartApplication_DIAG_ConditionCheckRead_ConditionCheckRead_PpDcmDataService_DID_StartApplication
        DataReceivedEvent_StartApplication_OnDataRec_RxData_PpSignal_StartAppl_RxData_MyECU_omsg_StartAppl_Rx_MyECU_oCAN_315f94_d6cb9e1e: RtePositionInTask=5, RteEventRef=DataReceivedEvent_StartApplication_OnDataRec_RxData_PpSignal_StartAppl_RxData_MyECU_omsg_StartAppl_Rx_MyECU_oCAN_315f94_d6cb9e1e, RteMappedToTaskRef=Os/Default_Appl_Task, RteUsedOsEventRef=Rte_Ev_Run_StartApplication_StartApplication_OnDataRec_RxData
        DataReceivedEvent_StartApplication_OnDataRec_RxCtrl_PpSignal_StartAppl_RxCtrl_MyECU_omsg_StartAppl_Rx_MyECU_oCAN_095910_3d48f4ff: RtePositionInTask=4, RteEventRef=DataReceivedEvent_StartApplication_OnDataRec_RxCtrl_PpSignal_StartAppl_RxCtrl_MyECU_omsg_StartAppl_Rx_MyECU_oCAN_095910_3d48f4ff, RteMappedToTaskRef=Os/Default_Appl_Task, RteUsedOsEventRef=Rte_Ev_Run_StartApplication_StartApplication_OnDataRec_RxCtrl
        Timer_StartApplication_MEMORYPROTECTION_Cyclic10ms: RtePositionInTask=0, RteEventRef=Timer_StartApplication_MEMORYPROTECTION_Cyclic10ms, RteMappedToTaskRef=StartApplication_MemoryViolation_Task, RteUsedOsAlarmRef=Os/Rte_Al_TE_StartApplication_StartApplication_MEMORYPROTECTION_Cyclic10ms
    NmOsek (RteBswModuleInstance): RteBswImplementationRef=NmOsek_Impl, RteBswModuleConfigurationRef=NmOsek
      NmOsek_MainFunctionTimingEvent0 (RteBswEventToTaskMapping):
        RteBswImmediateRestart = false
        RteBswPositionInTask = 20
        RteBswEventRef = NmOsek_MainFunctionTimingEvent0
        RteBswMappedToTaskRef = Os/Default_BSW_Async_Task
        RteBswUsedOsEventRef = Rte_Ev_Cyclic2_Default_BSW_Async_Task_0_10ms
        RteBswUsedOsAlarmRef = Os/Rte_Al_TE2_Default_BSW_Async_Task_0_10ms
      6 x RteBswExclusiveAreaImpl, all with RteExclusiveAreaImplMechanism=ALL_INTERRUPT_BLOCKING:
        NMOSEK_EXCLUSIVE_AREA_{0..5}: RteBswExclusiveAreaRef=NMOSEK_EXCLUSIVE_AREA_{0..5}
    WdgM_OsApplication_NonTrusted_Core0_EcuSwComposition (RteSwComponentInstance): RteSoftwareComponentInstanceRef=WdgM_OsApplication_NonTrusted_Core0
      OpEventCheckpointReached_CheckpointReached_alive_WdgMSupervisedEntity_StartApplication (RteEventToTaskMapping): RteImmediateRestart=false, RteEventRef=OpEventCheckpointReached_CheckpointReached_alive_WdgMSupervisedEntity_StartApplication
      OpEventGetLocalStatus_GetLocalStatus_localStatus_WdgMSupervisedEntity_StartApplication (RteEventToTaskMapping): RteImmediateRestart=false, RteEventRef=OpEventGetLocalStatus_GetLocalStatus_localStatus_WdgMSupervisedEntity_StartApplication
    WdgM_OsApplication_Trusted_Core0_EcuSwComposition (RteSwComponentInstance): RteSoftwareComponentInstanceRef=WdgM_OsApplication_Trusted_Core0
      9 x RteEventToTaskMapping, all with RteImmediateRestart=false:
        OpEventCheckpointReached_CheckpointReached_alive_WdgMSupervisedEntity_Dummy: RteEventRef=OpEventCheckpointReached_CheckpointReached_alive_WdgMSupervisedEntity_Dummy
        OpEventGetLocalStatus_GetLocalStatus_localStatus_WdgMSupervisedEntity_Dummy: RteEventRef=OpEventGetLocalStatus_GetLocalStatus_localStatus_WdgMSupervisedEntity_Dummy
        OpEventGetMode_GetMode_general_Core0: RteEventRef=OpEventGetMode_GetMode_general_Core0
        OpEventGetLocalStatus_GetLocalStatus_general_Core0: RteEventRef=OpEventGetLocalStatus_GetLocalStatus_general_Core0
        OpEventPerformReset_PerformReset_general_Core0: RteEventRef=OpEventPerformReset_PerformReset_general_Core0
        Timer_WdgM_MainFunction: RtePositionInTask=0, RteEventRef=Timer_WdgM_MainFunction, RteMappedToTaskRef=OsTask_WdgM_Cyclic, RteUsedOsAlarmRef=Os/Rte_Al_TE2_OsTask_WdgM_Cyclic_0_10ms
        OpEventGetGlobalStatus_GetGlobalStatus_general_Core0: RteEventRef=OpEventGetGlobalStatus_GetGlobalStatus_general_Core0
        OpEventGetFirstExpiredSEID_GetFirstExpiredSEID_general_Core0: RteEventRef=OpEventGetFirstExpiredSEID_GetFirstExpiredSEID_general_Core0
        OpEventSetMode_SetMode_general_Core0: RteEventRef=OpEventSetMode_SetMode_general_Core0
    StartApplicationMemoryAccessState (RteSwComponentType): RteComponentTypeRef=StartApplicationMemoryAccessState, RteImplementationRef=StartApplicationMemoryAccessStateImplementation
      ComponentTypeCalibration (RteComponentTypeCalibration): RteCalibrationSupportEnabled=false
    StartApplicationTrusted (RteSwComponentType): RteComponentTypeRef=StartApplicationTrusted, RteImplementationRef=StartApplicationTrustedImplementation
      ComponentTypeCalibration (RteComponentTypeCalibration): RteCalibrationSupportEnabled=false
    StartApplicationMemoryAccessState_EcuSwComposition (RteSwComponentInstance): RteSoftwareComponentInstanceRef=StartApplicationMemoryAccessState
      3 x RteEventToTaskMapping, all with RteImmediateRestart=false:
        OpEventStartApplicationMemoryAccessState_GetState_GetState_PpMemoryAccessViolationState: RtePositionInTask=6, RteEventRef=OpEventStartApplicationMemoryAccessState_GetState_GetState_PpMemoryAccessViolationState, RteMappedToTaskRef=Os/Default_Appl_Task
        OpEventStartApplicationMemoryAccessState_Reset_Reset_PpMemoryAccessViolationState: RtePositionInTask=7, RteEventRef=OpEventStartApplicationMemoryAccessState_Reset_Reset_PpMemoryAccessViolationState, RteMappedToTaskRef=Os/Default_Appl_Task
        Timer_StartApplicationMemoryAccessState_Init: RtePositionInTask=1, RteEventRef=Timer_StartApplicationMemoryAccessState_Init, RteMappedToTaskRef=Default_Appl_Init_Task
    StartApplicationTrusted_EcuSwComposition (RteSwComponentInstance): RteSoftwareComponentInstanceRef=StartApplicationTrusted
      DataReceivedEvent_StartApplicationTrusted_OnDataRec_TrustedData_PpTrustedData_DeValue (RteEventToTaskMapping):
        RteImmediateRestart = false
        RtePositionInTask = 0
        RteEventRef = DataReceivedEvent_StartApplicationTrusted_OnDataRec_TrustedData_PpTrustedData_DeValue
        RteMappedToTaskRef = StartApplication_Trusted_Task
      OpEventStartApplicationTrusted_TriggerMemoryAccesViolation_Write_PpTrustedDataInvalid (RteEventToTaskMapping): RteImmediateRestart=false, RteEventRef=OpEventStartApplicationTrusted_TriggerMemoryAccesViolation_Write_PpTrustedDataInvalid
  module config ComM: implementation-config-variant=VARIANT-PRE-COMPILE, module-description=ComM_Impl
    ComMGeneral:
      ComMPncIdCounting = COMM_PNC_ID_COUNT_FROM_NM_MESSAGE
      ComMPncSupport = false
      ComMDevErrorDetect = true
      ComMEcuGroupClassification = 3
      ComMModeLimitationEnabled = true
      ComMSynchronousWakeUp = true
      ComMTMinFullComModeDuration = 5
      ComMVersionInfoApi = false
      ComMWakeupInhibitionEnabled = false
      ComMSafeBswChecks = false
      ComMNmPassiveModeEnable = false
      ComMGlobalNvMBlockDescriptor = NvMBlockDescriptor_ComM
      ComMGeneration: ComMOutOfBoundsWriteSanitizer=false, ComMOutOfBoundsReadSanitizer=false
    ComMConfigSet: ComMPncEnabled=false
      CN_CAN_fe6ecc87 (ComMChannel):
        ComMBusType = COMM_BUS_TYPE_CAN
        ComMChannelId = 0
        ComMFullCommRequestNotificationEnabled = false
        ComMMainFunctionPeriod = 0.02
        ComMNoCom = true
        ComMNoWakeup = false
        ComMNetworkManagement: ComMNmVariant=FULL, ComMPncNmRequest=false, ComMTMinFullComModeDurationOfChannel=5
        CN_CAN_6e33c5a0 (ComMUserPerChannel): ComMUserChannel=CN_CAN_52ce3533
      CN_CAN_52ce3533 (ComMUser): ComMUserIdentifier=0, ComMUserModeNotification=false
  module config Dem: implementation-config-variant=VARIANT-PRE-COMPILE, module-description=Dem_Impl
    DemConfigSet
      DTCClass_DTC_0X93F612 (DemDTCClass): DemDTCSeverity=DEM_DTC_SEV_CHECK_AT_NEXT_HALT, DemUdsDTC=9696786, DemImmediateNvStorage=false
      DTC_0X9A0313 (DemEventParameter):
        DemEventKind = DEM_EVENT_KIND_SWC
        DemMaxNumberFreezeFrameRecords = 1
        DemEventTimeSeries = DEM_TIMESERIES_SNAPSHOT_NONE
        DemEventAvailable = true
        DemEventId = 18
        DemEventAvailableInVariant = true
        DemEventLatchTestFailed = false
        DemEventCreateInfoPort = true
        DemDTCClassRef = DTCClass_DTC_0X9A0313
        DemExtendedDataClassRef = ExtendedDataClass_83dcefb7
        DemFreezeFrameClassRef = FreezeFrameClass_fb82c988
        DemEventClass:
          DemAgingAllowed = true
          DemAgingCycleCounterThreshold = 80
          DemEventDestination = DEM_DTC_ORIGIN_PRIMARY_MEMORY
          DemEventPriority = 1
          DemEventFailureCycleCounterThreshold = 0
          DemConsiderPtoStatus = false
          DemFFPrestorageSupported = false
          DemAgingCycleRef = PowerCycle
          DemEnableConditionGroupRef = EnableConditionGroup_b30aa5c2
          DemOperationCycleRef = PowerCycle
          DemDebounceAlgorithmClass
            DemDebounceCounterBased:
              DemDebounceCounterDecrementStepSize = 1
              DemDebounceCounterIncrementStepSize = 1
              DemDebounceCounterJumpDown = false
              DemDebounceCounterJumpUp = false
              DemDebounceBehavior = DEM_DEBOUNCE_FREEZE
              DemDebounceCounterFailedThreshold = 127
              DemDebounceCounterJumpDownValue = 0
              DemDebounceCounterJumpUpValue = 0
              DemDebounceCounterPassedThreshold = -128
              DemDebounceCounterStorage = false
              DemDebounceContinuous = false
      5 x DemDTCClass, all with DemImmediateNvStorage=false:
        DTCClass_DTC_0X93F613: DemDTCSeverity=DEM_DTC_SEV_CHECK_AT_NEXT_HALT, DemUdsDTC=9696787
        DTCClass_DTC_0X925311: DemDTCSeverity=DEM_DTC_SEV_MAINTENANCE_ONLY, DemUdsDTC=9589506
        DTCClass_DTC_0X9A0325: DemDTCSeverity=DEM_DTC_SEV_MAINTENANCE_ONLY, DemUdsDTC=10093349
        DTCClass_DTC_0X909502: DemDTCSeverity=DEM_DTC_SEV_MAINTENANCE_ONLY, DemUdsDTC=9475330
        DTCClass_DTC_0X9A0201: DemDTCSeverity=DEM_DTC_SEV_MAINTENANCE_ONLY, DemUdsDTC=10093057
      DTC_0X9A0312 (DemEventParameter):
        DemEventKind = DEM_EVENT_KIND_SWC
        DemMaxNumberFreezeFrameRecords = 1
        DemEventTimeSeries = DEM_TIMESERIES_SNAPSHOT_NONE
        DemEventAvailable = true
        DemEventId = 17
        DemEventAvailableInVariant = true
        DemEventLatchTestFailed = false
        DemEventCreateInfoPort = true
        DemDTCClassRef = DTCClass_DTC_0X9A0312
        DemExtendedDataClassRef = ExtendedDataClass_83dcefb7
        DemFreezeFrameClassRef = FreezeFrameClass_fb82c988
        DemEventClass:
          DemAgingAllowed = true
          DemAgingCycleCounterThreshold = 80
          DemEventDestination = DEM_DTC_ORIGIN_PRIMARY_MEMORY
          DemEventPriority = 1
          DemEventFailureCycleCounterThreshold = 0
          DemConsiderPtoStatus = false
          DemFFPrestorageSupported = false
          DemAgingCycleRef = PowerCycle
          DemEnableConditionGroupRef = EnableConditionGroup_b30aa5c2
          DemOperationCycleRef = PowerCycle
          DemDebounceAlgorithmClass
            DemDebounceCounterBased:
              DemDebounceCounterDecrementStepSize = 1
              DemDebounceCounterIncrementStepSize = 1
              DemDebounceCounterJumpDown = false
              DemDebounceCounterJumpUp = false
              DemDebounceBehavior = DEM_DEBOUNCE_FREEZE
              DemDebounceCounterFailedThreshold = 127
              DemDebounceCounterJumpDownValue = 0
              DemDebounceCounterJumpUpValue = 0
              DemDebounceCounterPassedThreshold = -128
              DemDebounceCounterStorage = false
              DemDebounceContinuous = false
      DTC_0X9A0311 (DemEventParameter):
        DemEventKind = DEM_EVENT_KIND_SWC
        DemMaxNumberFreezeFrameRecords = 1
        DemEventTimeSeries = DEM_TIMESERIES_SNAPSHOT_NONE
        DemEventAvailable = true
        DemEventId = 16
        DemEventAvailableInVariant = true
        DemEventLatchTestFailed = false
        DemEventCreateInfoPort = true
        DemDTCClassRef = DTCClass_DTC_0X9A0311
        DemExtendedDataClassRef = ExtendedDataClass_83dcefb7
        DemFreezeFrameClassRef = FreezeFrameClass_fb82c988
        DemEventClass:
          DemAgingAllowed = true
          DemAgingCycleCounterThreshold = 80
          DemEventDestination = DEM_DTC_ORIGIN_PRIMARY_MEMORY
          DemEventPriority = 1
          DemEventFailureCycleCounterThreshold = 0
          DemConsiderPtoStatus = false
          DemFFPrestorageSupported = false
          DemAgingCycleRef = PowerCycle
          DemEnableConditionGroupRef = EnableConditionGroup_b30aa5c2
          DemOperationCycleRef = PowerCycle
          DemDebounceAlgorithmClass
            DemDebounceCounterBased:
              DemDebounceCounterDecrementStepSize = 1
              DemDebounceCounterIncrementStepSize = 1
              DemDebounceCounterJumpDown = false
              DemDebounceCounterJumpUp = false
              DemDebounceBehavior = DEM_DEBOUNCE_FREEZE
              DemDebounceCounterFailedThreshold = 127
              DemDebounceCounterJumpDownValue = 0
              DemDebounceCounterJumpUpValue = 0
              DemDebounceCounterPassedThreshold = -128
              DemDebounceCounterStorage = false
              DemDebounceContinuous = false
      6 x DemDTCClass, all with DemImmediateNvStorage=false:
        DTCClass_DTC_0X93F611: DemDTCSeverity=DEM_DTC_SEV_CHECK_AT_NEXT_HALT, DemUdsDTC=9696785
        DTCClass_DTC_0XC15582: DemDTCSeverity=DEM_DTC_SEV_IMMEDIATELY, DemUdsDTC=12670338
        DTCClass_DTC_0X923816: DemDTCSeverity=DEM_DTC_SEV_MAINTENANCE_ONLY, DemUdsDTC=9582614
        DTCClass_DTC_0X923817: DemDTCSeverity=DEM_DTC_SEV_MAINTENANCE_ONLY, DemUdsDTC=9582615
        DTCClass_DTC_0XC15502: DemDTCSeverity=DEM_DTC_SEV_CHECK_AT_NEXT_HALT, DemUdsDTC=12670210
        DTCClass_DTC_0X9A031E: DemDTCSeverity=DEM_DTC_SEV_MAINTENANCE_ONLY, DemUdsDTC=10093342
      DTC_0X9A0425 (DemEventParameter):
        DemEventKind = DEM_EVENT_KIND_SWC
        DemMaxNumberFreezeFrameRecords = 1
        DemEventTimeSeries = DEM_TIMESERIES_SNAPSHOT_NONE
        DemEventAvailable = true
        DemEventId = 24
        DemEventAvailableInVariant = true
        DemEventLatchTestFailed = false
        DemEventCreateInfoPort = true
        DemDTCClassRef = DTCClass_DTC_0X9A0425
        DemExtendedDataClassRef = ExtendedDataClass_83dcefb7
        DemFreezeFrameClassRef = FreezeFrameClass_fb82c988
        DemEventClass:
          DemAgingAllowed = true
          DemAgingCycleCounterThreshold = 80
          DemEventDestination = DEM_DTC_ORIGIN_PRIMARY_MEMORY
          DemEventPriority = 1
          DemEventFailureCycleCounterThreshold = 0
          DemConsiderPtoStatus = false
          DemFFPrestorageSupported = false
          DemAgingCycleRef = PowerCycle
          DemEnableConditionGroupRef = EnableConditionGroup_b30aa5c2
          DemOperationCycleRef = PowerCycle
          DemDebounceAlgorithmClass
            DemDebounceCounterBased:
              DemDebounceCounterDecrementStepSize = 1
              DemDebounceCounterIncrementStepSize = 1
              DemDebounceCounterJumpDown = false
              DemDebounceCounterJumpUp = false
              DemDebounceBehavior = DEM_DEBOUNCE_FREEZE
              DemDebounceCounterFailedThreshold = 127
              DemDebounceCounterJumpDownValue = 0
              DemDebounceCounterJumpUpValue = 0
              DemDebounceCounterPassedThreshold = -128
              DemDebounceCounterStorage = false
              DemDebounceContinuous = false
      3 x DemDTCClass, all with DemDTCSeverity=DEM_DTC_SEV_MAINTENANCE_ONLY, DemImmediateNvStorage=false:
        DTCClass_DTC_0X9A0313: DemUdsDTC=10093331
        DTCClass_DTC_0X9A0312: DemUdsDTC=10093330
        DTCClass_DTC_0X9A0311: DemUdsDTC=10093329
      8 x DemEventParameter, all with DemEventKind=DEM_EVENT_KIND_SWC, DemMaxNumberFreezeFrameRecords=1, DemEventTimeSeries=DEM_TIMESERIES_SNAPSHOT_NONE, DemEventAvailable=true, DemEventAvailableInVariant=true, DemEventLatchTestFailed=false, DemEventCreateInfoPort=true, DemExtendedDataClassRef=ExtendedDataClass_83dcefb7, DemFreezeFrameClassRef=FreezeFrameClass_fb82c988:
        DTC_0X925411: DemEventId=42, DemDTCClassRef=DTCClass_DTC_0X925411
          DemEventClass:
            DemAgingAllowed = true
            DemAgingCycleCounterThreshold = 80
            DemEventDestination = DEM_DTC_ORIGIN_PRIMARY_MEMORY
            DemEventPriority = 1
            DemEventFailureCycleCounterThreshold = 0
            DemConsiderPtoStatus = false
            DemFFPrestorageSupported = false
            DemAgingCycleRef = PowerCycle
            DemEnableConditionGroupRef = EnableConditionGroup_b30aa5c2
            DemOperationCycleRef = PowerCycle
            DemDebounceAlgorithmClass
              DemDebounceCounterBased:
                DemDebounceCounterDecrementStepSize = 1
                DemDebounceCounterIncrementStepSize = 1
                DemDebounceCounterJumpDown = false
                DemDebounceCounterJumpUp = false
                DemDebounceBehavior = DEM_DEBOUNCE_FREEZE
                DemDebounceCounterFailedThreshold = 127
                DemDebounceCounterJumpDownValue = 0
                DemDebounceCounterJumpUpValue = 0
                DemDebounceCounterPassedThreshold = -128
                DemDebounceCounterStorage = false
                DemDebounceContinuous = false
        DTC_0X909502: DemEventId=36, DemDTCClassRef=DTCClass_DTC_0X909502
          DemEventClass:
            DemAgingAllowed = true
            DemAgingCycleCounterThreshold = 80
            DemEventDestination = DEM_DTC_ORIGIN_PRIMARY_MEMORY
            DemEventPriority = 1
            DemEventFailureCycleCounterThreshold = 0
            DemConsiderPtoStatus = false
            DemFFPrestorageSupported = false
            DemAgingCycleRef = PowerCycle
            DemEnableConditionGroupRef = EnableConditionGroup_b30aa5c2
            DemOperationCycleRef = PowerCycle
            DemDebounceAlgorithmClass
              DemDebounceCounterBased:
                DemDebounceCounterDecrementStepSize = 1
                DemDebounceCounterIncrementStepSize = 1
                DemDebounceCounterJumpDown = false
                DemDebounceCounterJumpUp = false
                DemDebounceBehavior = DEM_DEBOUNCE_FREEZE
                DemDebounceCounterFailedThreshold = 127
                DemDebounceCounterJumpDownValue = 0
                DemDebounceCounterJumpUpValue = 0
                DemDebounceCounterPassedThreshold = -128
                DemDebounceCounterStorage = false
                DemDebounceContinuous = false
        DTC_0X9A0301: DemEventId=15, DemDTCClassRef=DTCClass_DTC_0X9A0301
          DemEventClass:
            DemAgingAllowed = true
            DemAgingCycleCounterThreshold = 80
            DemEventDestination = DEM_DTC_ORIGIN_PRIMARY_MEMORY
            DemEventPriority = 1
            DemEventFailureCycleCounterThreshold = 0
            DemConsiderPtoStatus = false
            DemFFPrestorageSupported = false
            DemAgingCycleRef = PowerCycle
            DemEnableConditionGroupRef = EnableConditionGroup_b30aa5c2
            DemOperationCycleRef = PowerCycle
            DemDebounceAlgorithmClass
              DemDebounceCounterBased:
                DemDebounceCounterDecrementStepSize = 1
                DemDebounceCounterIncrementStepSize = 1
                DemDebounceCounterJumpDown = false
                DemDebounceCounterJumpUp = false
                DemDebounceBehavior = DEM_DEBOUNCE_FREEZE
                DemDebounceCounterFailedThreshold = 127
                DemDebounceCounterJumpDownValue = 0
                DemDebounceCounterJumpUpValue = 0
                DemDebounceCounterPassedThreshold = -128
                DemDebounceCounterStorage = false
                DemDebounceContinuous = false
        DTC_0X9A041E: DemEventId=4, DemDTCClassRef=DTCClass_DTC_0X9A041E
          DemEventClass:
            DemAgingAllowed = true
            DemAgingCycleCounterThreshold = 80
            DemEventDestination = DEM_DTC_ORIGIN_PRIMARY_MEMORY
            DemEventPriority = 1
            DemEventFailureCycleCounterThreshold = 0
            DemConsiderPtoStatus = false
            DemFFPrestorageSupported = false
            DemAgingCycleRef = PowerCycle
            DemEnableConditionGroupRef = EnableConditionGroup_b30aa5c2
            DemOperationCycleRef = PowerCycle
            DemDebounceAlgorithmClass
              DemDebounceCounterBased:
                DemDebounceCounterDecrementStepSize = 1
                DemDebounceCounterIncrementStepSize = 1
                DemDebounceCounterJumpDown = false
                DemDebounceCounterJumpUp = false
                DemDebounceBehavior = DEM_DEBOUNCE_FREEZE
                DemDebounceCounterFailedThreshold = 127
                DemDebounceCounterJumpDownValue = 0
                DemDebounceCounterJumpUpValue = 0
                DemDebounceCounterPassedThreshold = -128
                DemDebounceCounterStorage = false
                DemDebounceContinuous = false
        DTC_0XC19887: DemEventId=50, DemDTCClassRef=DTCClass_DTC_0XC19887
          DemEventClass:
            DemAgingAllowed = true
            DemAgingCycleCounterThreshold = 80
            DemEventDestination = DEM_DTC_ORIGIN_PRIMARY_MEMORY
            DemEventPriority = 1
            DemEventFailureCycleCounterThreshold = 0
            DemConsiderPtoStatus = false
            DemFFPrestorageSupported = false
            DemAgingCycleRef = PowerCycle
            DemEnableConditionGroupRef = EnableConditionGroup_ce4d85f8
            DemOperationCycleRef = PowerCycle
            DemDebounceAlgorithmClass
              DemDebounceCounterBased:
                DemDebounceCounterDecrementStepSize = 1
                DemDebounceCounterIncrementStepSize = 1
                DemDebounceCounterJumpDown = false
                DemDebounceCounterJumpUp = false
                DemDebounceBehavior = DEM_DEBOUNCE_FREEZE
                DemDebounceCounterFailedThreshold = 127
                DemDebounceCounterJumpDownValue = 0
                DemDebounceCounterJumpUpValue = 0
                DemDebounceCounterPassedThreshold = -128
                DemDebounceCounterStorage = false
                DemDebounceContinuous = false
        DTC_0X9A0413: DemEventId=23, DemDTCClassRef=DTCClass_DTC_0X9A0413
          DemEventClass:
            DemAgingAllowed = true
            DemAgingCycleCounterThreshold = 80
            DemEventDestination = DEM_DTC_ORIGIN_PRIMARY_MEMORY
            DemEventPriority = 1
            DemEventFailureCycleCounterThreshold = 0
            DemConsiderPtoStatus = false
            DemFFPrestorageSupported = false
            DemAgingCycleRef = PowerCycle
            DemEnableConditionGroupRef = EnableConditionGroup_b30aa5c2
            DemOperationCycleRef = PowerCycle
            DemDebounceAlgorithmClass
              DemDebounceCounterBased:
                DemDebounceCounterDecrementStepSize = 1
                DemDebounceCounterIncrementStepSize = 1
                DemDebounceCounterJumpDown = false
                DemDebounceCounterJumpUp = false
                DemDebounceBehavior = DEM_DEBOUNCE_FREEZE
                DemDebounceCounterFailedThreshold = 127
                DemDebounceCounterJumpDownValue = 0
                DemDebounceCounterJumpUpValue = 0
                DemDebounceCounterPassedThreshold = -128
                DemDebounceCounterStorage = false
                DemDebounceContinuous = false
        DTC_0X9A0412: DemEventId=22, DemDTCClassRef=DTCClass_DTC_0X9A0412
          DemEventClass:
            DemAgingAllowed = true
            DemAgingCycleCounterThreshold = 80
            DemEventDestination = DEM_DTC_ORIGIN_PRIMARY_MEMORY
            DemEventPriority = 1
            DemEventFailureCycleCounterThreshold = 0
            DemConsiderPtoStatus = false
            DemFFPrestorageSupported = false
            DemAgingCycleRef = PowerCycle
            DemEnableConditionGroupRef = EnableConditionGroup_b30aa5c2
            DemOperationCycleRef = PowerCycle
            DemDebounceAlgorithmClass
              DemDebounceCounterBased:
                DemDebounceCounterDecrementStepSize = 1
                DemDebounceCounterIncrementStepSize = 1
                DemDebounceCounterJumpDown = false
                DemDebounceCounterJumpUp = false
                DemDebounceBehavior = DEM_DEBOUNCE_FREEZE
                DemDebounceCounterFailedThreshold = 127
                DemDebounceCounterJumpDownValue = 0
                DemDebounceCounterJumpUpValue = 0
                DemDebounceCounterPassedThreshold = -128
                DemDebounceCounterStorage = false
                DemDebounceContinuous = false
        DTC_0XC26402: DemEventId=52, DemDTCClassRef=DTCClass_DTC_0XC26402
          DemEventClass:
            DemAgingAllowed = true
            DemAgingCycleCounterThreshold = 80
            DemEventDestination = DEM_DTC_ORIGIN_PRIMARY_MEMORY
            DemEventPriority = 1
            DemEventFailureCycleCounterThreshold = 0
            DemConsiderPtoStatus = false
            DemFFPrestorageSupported = false
            DemAgingCycleRef = PowerCycle
            DemEnableConditionGroupRef = EnableConditionGroup_2d4cad61
            DemOperationCycleRef = PowerCycle
            DemDebounceAlgorithmClass
              DemDebounceCounterBased:
                DemDebounceCounterDecrementStepSize = 1
                DemDebounceCounterIncrementStepSize = 1
                DemDebounceCounterJumpDown = false
                DemDebounceCounterJumpUp = false
                DemDebounceBehavior = DEM_DEBOUNCE_FREEZE
                DemDebounceCounterFailedThreshold = 127
                DemDebounceCounterJumpDownValue = 0
                DemDebounceCounterJumpUpValue = 0
                DemDebounceCounterPassedThreshold = -128
                DemDebounceCounterStorage = false
                DemDebounceContinuous = false
      4 x DemDTCClass, all with DemDTCSeverity=DEM_DTC_SEV_MAINTENANCE_ONLY, DemImmediateNvStorage=false:
        DTCClass_DTC_0X9A0101: DemUdsDTC=10092801
        DTCClass_DTC_0X925411: DemUdsDTC=9589762
        DTCClass_DTC_0X9A0225: DemUdsDTC=10093093
        DTCClass_DTC_0X909602: DemUdsDTC=9475586
      DTC_0X9A0411 (DemEventParameter):
        DemEventKind = DEM_EVENT_KIND_SWC
        DemMaxNumberFreezeFrameRecords = 1
        DemEventTimeSeries = DEM_TIMESERIES_SNAPSHOT_NONE
        DemEventAvailable = true
        DemEventId = 21
        DemEventAvailableInVariant = true
        DemEventLatchTestFailed = false
        DemEventCreateInfoPort = true
        DemDTCClassRef = DTCClass_DTC_0X9A0411
        DemExtendedDataClassRef = ExtendedDataClass_83dcefb7
        DemFreezeFrameClassRef = FreezeFrameClass_fb82c988
        DemEventClass:
          DemAgingAllowed = true
          DemAgingCycleCounterThreshold = 80
          DemEventDestination = DEM_DTC_ORIGIN_PRIMARY_MEMORY
          DemEventPriority = 1
          DemEventFailureCycleCounterThreshold = 0
          DemConsiderPtoStatus = false
          DemFFPrestorageSupported = false
          DemAgingCycleRef = PowerCycle
          DemEnableConditionGroupRef = EnableConditionGroup_b30aa5c2
          DemOperationCycleRef = PowerCycle
          DemDebounceAlgorithmClass
            DemDebounceCounterBased:
              DemDebounceCounterDecrementStepSize = 1
              DemDebounceCounterIncrementStepSize = 1
              DemDebounceCounterJumpDown = false
              DemDebounceCounterJumpUp = false
              DemDebounceBehavior = DEM_DEBOUNCE_FREEZE
              DemDebounceCounterFailedThreshold = 127
              DemDebounceCounterJumpDownValue = 0
              DemDebounceCounterJumpUpValue = 0
              DemDebounceCounterPassedThreshold = -128
              DemDebounceCounterStorage = false
              DemDebounceContinuous = false
      DTCClass_DTC_0X9A021E (DemDTCClass): DemDTCSeverity=DEM_DTC_SEV_MAINTENANCE_ONLY, DemUdsDTC=10093086, DemImmediateNvStorage=false
      DTCClass_DTC_0XC19887 (DemDTCClass): DemDTCSeverity=DEM_DTC_SEV_IMMEDIATELY, DemUdsDTC=12687495, DemImmediateNvStorage=false
      DTC_0X9A0401 (DemEventParameter):
        DemEventKind = DEM_EVENT_KIND_SWC
        DemMaxNumberFreezeFrameRecords = 1
        DemEventTimeSeries = DEM_TIMESERIES_SNAPSHOT_NONE
        DemEventAvailable = true
        DemEventId = 20
        DemEventAvailableInVariant = true
        DemEventLatchTestFailed = false
        DemEventCreateInfoPort = true
        DemDTCClassRef = DTCClass_DTC_0X9A0401
        DemExtendedDataClassRef = ExtendedDataClass_83dcefb7
        DemFreezeFrameClassRef = FreezeFrameClass_fb82c988
        DemEventClass:
          DemAgingAllowed = true
          DemAgingCycleCounterThreshold = 80
          DemEventDestination = DEM_DTC_ORIGIN_PRIMARY_MEMORY
          DemEventPriority = 1
          DemEventFailureCycleCounterThreshold = 0
          DemConsiderPtoStatus = false
          DemFFPrestorageSupported = false
          DemAgingCycleRef = PowerCycle
          DemEnableConditionGroupRef = EnableConditionGroup_b30aa5c2
          DemOperationCycleRef = PowerCycle
          DemDebounceAlgorithmClass
            DemDebounceCounterBased:
              DemDebounceCounterDecrementStepSize = 1
              DemDebounceCounterIncrementStepSize = 1
              DemDebounceCounterJumpDown = false
              DemDebounceCounterJumpUp = false
              DemDebounceBehavior = DEM_DEBOUNCE_FREEZE
              DemDebounceCounterFailedThreshold = 127
              DemDebounceCounterJumpDownValue = 0
              DemDebounceCounterJumpUpValue = 0
              DemDebounceCounterPassedThreshold = -128
              DemDebounceCounterStorage = false
              DemDebounceContinuous = false
      DTCClass_DTC_0X9A0211 (DemDTCClass): DemDTCSeverity=DEM_DTC_SEV_MAINTENANCE_ONLY, DemUdsDTC=10093073, DemImmediateNvStorage=false
      3 x DemEventParameter, all with DemEventKind=DEM_EVENT_KIND_SWC, DemMaxNumberFreezeFrameRecords=1, DemEventTimeSeries=DEM_TIMESERIES_SNAPSHOT_NONE, DemEventAvailable=true, DemEventAvailableInVariant=true, DemEventLatchTestFailed=false, DemEventCreateInfoPort=true, DemExtendedDataClassRef=ExtendedDataClass_83dcefb7, DemFreezeFrameClassRef=FreezeFrameClass_fb82c988:
        DTC_0X93F611: DemEventId=29, DemDTCClassRef=DTCClass_DTC_0X93F611
          DemEventClass:
            DemAgingAllowed = true
            DemAgingCycleCounterThreshold = 80
            DemEventDestination = DEM_DTC_ORIGIN_PRIMARY_MEMORY
            DemEventPriority = 1
            DemEventFailureCycleCounterThreshold = 0
            DemConsiderPtoStatus = false
            DemFFPrestorageSupported = false
            DemAgingCycleRef = PowerCycle
            DemEnableConditionGroupRef = EnableConditionGroup_b30aa5c2
            DemOperationCycleRef = PowerCycle
            DemDebounceAlgorithmClass
              DemDebounceCounterBased:
                DemDebounceCounterDecrementStepSize = 1
                DemDebounceCounterIncrementStepSize = 1
                DemDebounceCounterJumpDown = false
                DemDebounceCounterJumpUp = false
                DemDebounceBehavior = DEM_DEBOUNCE_FREEZE
                DemDebounceCounterFailedThreshold = 127
                DemDebounceCounterJumpDownValue = 0
                DemDebounceCounterJumpUpValue = 0
                DemDebounceCounterPassedThreshold = -128
                DemDebounceCounterStorage = false
                DemDebounceContinuous = false
        DTC_0X923817: DemEventId=39, DemDTCClassRef=DTCClass_DTC_0X923817
          DemEventClass:
            DemAgingAllowed = true
            DemAgingCycleCounterThreshold = 80
            DemEventDestination = DEM_DTC_ORIGIN_PRIMARY_MEMORY
            DemEventPriority = 1
            DemEventFailureCycleCounterThreshold = 0
            DemConsiderPtoStatus = false
            DemFFPrestorageSupported = false
            DemAgingCycleRef = PowerCycle
            DemEnableConditionGroupRef = EnableConditionGroup_b30aa5c2
            DemOperationCycleRef = PowerCycle
            DemDebounceAlgorithmClass
              DemDebounceCounterBased:
                DemDebounceCounterDecrementStepSize = 1
                DemDebounceCounterIncrementStepSize = 1
                DemDebounceCounterJumpDown = false
                DemDebounceCounterJumpUp = false
                DemDebounceBehavior = DEM_DEBOUNCE_FREEZE
                DemDebounceCounterFailedThreshold = 127
                DemDebounceCounterJumpDownValue = 0
                DemDebounceCounterJumpUpValue = 0
                DemDebounceCounterPassedThreshold = -128
                DemDebounceCounterStorage = false
                DemDebounceContinuous = false
        DTC_0X923816: DemEventId=38, DemDTCClassRef=DTCClass_DTC_0X923816
          DemEventClass:
            DemAgingAllowed = true
            DemAgingCycleCounterThreshold = 80
            DemEventDestination = DEM_DTC_ORIGIN_PRIMARY_MEMORY
            DemEventPriority = 1
            DemEventFailureCycleCounterThreshold = 0
            DemConsiderPtoStatus = false
            DemFFPrestorageSupported = false
            DemAgingCycleRef = PowerCycle
            DemEnableConditionGroupRef = EnableConditionGroup_b30aa5c2
            DemOperationCycleRef = PowerCycle
            DemDebounceAlgorithmClass
              DemDebounceCounterBased:
                DemDebounceCounterDecrementStepSize = 1
                DemDebounceCounterIncrementStepSize = 1
                DemDebounceCounterJumpDown = false
                DemDebounceCounterJumpUp = false
                DemDebounceBehavior = DEM_DEBOUNCE_FREEZE
                DemDebounceCounterFailedThreshold = 127
                DemDebounceCounterJumpDownValue = 0
                DemDebounceCounterJumpUpValue = 0
                DemDebounceCounterPassedThreshold = -128
                DemDebounceCounterStorage = false
                DemDebounceContinuous = false
      DTCClass_DTC_0X9A0213 (DemDTCClass): DemDTCSeverity=DEM_DTC_SEV_MAINTENANCE_ONLY, DemUdsDTC=10093075, DemImmediateNvStorage=false
      DTC_0X93F613 (DemEventParameter):
        DemEventKind = DEM_EVENT_KIND_SWC
        DemMaxNumberFreezeFrameRecords = 1
        DemEventTimeSeries = DEM_TIMESERIES_SNAPSHOT_NONE
        DemEventAvailable = true
        DemEventId = 31
        DemEventAvailableInVariant = true
        DemEventLatchTestFailed = false
        DemEventCreateInfoPort = true
        DemDTCClassRef = DTCClass_DTC_0X93F613
        DemExtendedDataClassRef = ExtendedDataClass_83dcefb7
        DemFreezeFrameClassRef = FreezeFrameClass_fb82c988
        DemEventClass:
          DemAgingAllowed = true
          DemAgingCycleCounterThreshold = 80
          DemEventDestination = DEM_DTC_ORIGIN_PRIMARY_MEMORY
          DemEventPriority = 1
          DemEventFailureCycleCounterThreshold = 0
          DemConsiderPtoStatus = false
          DemFFPrestorageSupported = false
          DemAgingCycleRef = PowerCycle
          DemEnableConditionGroupRef = EnableConditionGroup_b30aa5c2
          DemOperationCycleRef = PowerCycle
          DemDebounceAlgorithmClass
            DemDebounceCounterBased:
              DemDebounceCounterDecrementStepSize = 1
              DemDebounceCounterIncrementStepSize = 1
              DemDebounceCounterJumpDown = false
              DemDebounceCounterJumpUp = false
              DemDebounceBehavior = DEM_DEBOUNCE_FREEZE
              DemDebounceCounterFailedThreshold = 127
              DemDebounceCounterJumpDownValue = 0
              DemDebounceCounterJumpUpValue = 0
              DemDebounceCounterPassedThreshold = -128
              DemDebounceCounterStorage = false
              DemDebounceContinuous = false
      DTC_0X925311 (DemEventParameter):
        DemEventKind = DEM_EVENT_KIND_SWC
        DemMaxNumberFreezeFrameRecords = 1
        DemEventTimeSeries = DEM_TIMESERIES_SNAPSHOT_NONE
        DemEventAvailable = true
        DemEventId = 41
        DemEventAvailableInVariant = true
        DemEventLatchTestFailed = false
        DemEventCreateInfoPort = true
        DemDTCClassRef = DTCClass_DTC_0X925311
        DemExtendedDataClassRef = ExtendedDataClass_83dcefb7
        DemFreezeFrameClassRef = FreezeFrameClass_fb82c988
        DemEventClass:
          DemAgingAllowed = true
          DemAgingCycleCounterThreshold = 80
          DemEventDestination = DEM_DTC_ORIGIN_PRIMARY_MEMORY
          DemEventPriority = 1
          DemEventFailureCycleCounterThreshold = 0
          DemConsiderPtoStatus = false
          DemFFPrestorageSupported = false
          DemAgingCycleRef = PowerCycle
          DemEnableConditionGroupRef = EnableConditionGroup_b30aa5c2
          DemOperationCycleRef = PowerCycle
          DemDebounceAlgorithmClass
            DemDebounceCounterBased:
              DemDebounceCounterDecrementStepSize = 1
              DemDebounceCounterIncrementStepSize = 1
              DemDebounceCounterJumpDown = false
              DemDebounceCounterJumpUp = false
              DemDebounceBehavior = DEM_DEBOUNCE_FREEZE
              DemDebounceCounterFailedThreshold = 127
              DemDebounceCounterJumpDownValue = 0
              DemDebounceCounterJumpUpValue = 0
              DemDebounceCounterPassedThreshold = -128
              DemDebounceCounterStorage = false
              DemDebounceContinuous = false
      DTCClass_DTC_0X9A0212 (DemDTCClass): DemDTCSeverity=DEM_DTC_SEV_MAINTENANCE_ONLY, DemUdsDTC=10093074, DemImmediateNvStorage=false
      4 x DemEventParameter, all with DemEventKind=DEM_EVENT_KIND_SWC, DemMaxNumberFreezeFrameRecords=1, DemEventTimeSeries=DEM_TIMESERIES_SNAPSHOT_NONE, DemEventAvailable=true, DemEventAvailableInVariant=true, DemEventLatchTestFailed=false, DemEventCreateInfoPort=true, DemExtendedDataClassRef=ExtendedDataClass_83dcefb7, DemFreezeFrameClassRef=FreezeFrameClass_fb82c988:
        DTC_0X93F612: DemEventId=30, DemDTCClassRef=DTCClass_DTC_0X93F612
          DemEventClass:
            DemAgingAllowed = true
            DemAgingCycleCounterThreshold = 80
            DemEventDestination = DEM_DTC_ORIGIN_PRIMARY_MEMORY
            DemEventPriority = 1
            DemEventFailureCycleCounterThreshold = 0
            DemConsiderPtoStatus = false
            DemFFPrestorageSupported = false
            DemAgingCycleRef = PowerCycle
            DemEnableConditionGroupRef = EnableConditionGroup_b30aa5c2
            DemOperationCycleRef = PowerCycle
            DemDebounceAlgorithmClass
              DemDebounceCounterBased:
                DemDebounceCounterDecrementStepSize = 1
                DemDebounceCounterIncrementStepSize = 1
                DemDebounceCounterJumpDown = false
                DemDebounceCounterJumpUp = false
                DemDebounceBehavior = DEM_DEBOUNCE_FREEZE
                DemDebounceCounterFailedThreshold = 127
                DemDebounceCounterJumpDownValue = 0
                DemDebounceCounterJumpUpValue = 0
                DemDebounceCounterPassedThreshold = -128
                DemDebounceCounterStorage = false
                DemDebounceContinuous = false
        DTC_0X9A0125: DemEventId=9, DemDTCClassRef=DTCClass_DTC_0X9A0125
          DemEventClass:
            DemAgingAllowed = true
            DemAgingCycleCounterThreshold = 80
            DemEventDestination = DEM_DTC_ORIGIN_PRIMARY_MEMORY
            DemEventPriority = 1
            DemEventFailureCycleCounterThreshold = 0
            DemConsiderPtoStatus = false
            DemFFPrestorageSupported = false
            DemAgingCycleRef = PowerCycle
            DemEnableConditionGroupRef = EnableConditionGroup_b30aa5c2
            DemOperationCycleRef = PowerCycle
            DemDebounceAlgorithmClass
              DemDebounceCounterBased:
                DemDebounceCounterDecrementStepSize = 1
                DemDebounceCounterIncrementStepSize = 1
                DemDebounceCounterJumpDown = false
                DemDebounceCounterJumpUp = false
                DemDebounceBehavior = DEM_DEBOUNCE_FREEZE
                DemDebounceCounterFailedThreshold = 127
                DemDebounceCounterJumpDownValue = 0
                DemDebounceCounterJumpUpValue = 0
                DemDebounceCounterPassedThreshold = -128
                DemDebounceCounterStorage = false
                DemDebounceContinuous = false
        DTC_0XC15502: DemEventId=48, DemDTCClassRef=DTCClass_DTC_0XC15502
          DemEventClass:
            DemAgingAllowed = true
            DemAgingCycleCounterThreshold = 80
            DemEventDestination = DEM_DTC_ORIGIN_PRIMARY_MEMORY
            DemEventPriority = 1
            DemEventFailureCycleCounterThreshold = 0
            DemConsiderPtoStatus = false
            DemFFPrestorageSupported = false
            DemAgingCycleRef = PowerCycle
            DemEnableConditionGroupRef = EnableConditionGroup_f70a9d46
            DemOperationCycleRef = PowerCycle
            DemDebounceAlgorithmClass
              DemDebounceCounterBased:
                DemDebounceCounterDecrementStepSize = 1
                DemDebounceCounterIncrementStepSize = 1
                DemDebounceCounterJumpDown = false
                DemDebounceCounterJumpUp = false
                DemDebounceBehavior = DEM_DEBOUNCE_FREEZE
                DemDebounceCounterFailedThreshold = 127
                DemDebounceCounterJumpDownValue = 0
                DemDebounceCounterJumpUpValue = 0
                DemDebounceCounterPassedThreshold = -128
                DemDebounceCounterStorage = false
                DemDebounceContinuous = false
        DTC_0X9A011E: DemEventId=1, DemDTCClassRef=DTCClass_DTC_0X9A011E
          DemEventClass:
            DemAgingAllowed = true
            DemAgingCycleCounterThreshold = 80
            DemEventDestination = DEM_DTC_ORIGIN_PRIMARY_MEMORY
            DemEventPriority = 1
            DemEventFailureCycleCounterThreshold = 0
            DemConsiderPtoStatus = false
            DemFFPrestorageSupported = false
            DemAgingCycleRef = PowerCycle
            DemEnableConditionGroupRef = EnableConditionGroup_b30aa5c2
            DemOperationCycleRef = PowerCycle
            DemDebounceAlgorithmClass
              DemDebounceCounterBased:
                DemDebounceCounterDecrementStepSize = 1
                DemDebounceCounterIncrementStepSize = 1
                DemDebounceCounterJumpDown = false
                DemDebounceCounterJumpUp = false
                DemDebounceBehavior = DEM_DEBOUNCE_FREEZE
                DemDebounceCounterFailedThreshold = 127
                DemDebounceCounterJumpDownValue = 0
                DemDebounceCounterJumpUpValue = 0
                DemDebounceCounterPassedThreshold = -128
                DemDebounceCounterStorage = false
                DemDebounceContinuous = false
      DTCClass_DTC_0XD10116 (DemDTCClass): DemDTCSeverity=DEM_DTC_SEV_IMMEDIATELY, DemUdsDTC=13697302, DemImmediateNvStorage=false
      DTC_0XC15582 (DemEventParameter):
        DemEventKind = DEM_EVENT_KIND_SWC
        DemMaxNumberFreezeFrameRecords = 1
        DemEventTimeSeries = DEM_TIMESERIES_SNAPSHOT_NONE
        DemEventAvailable = true
        DemEventId = 49
        DemEventAvailableInVariant = true
        DemEventLatchTestFailed = false
        DemEventCreateInfoPort = true
        DemDTCClassRef = DTCClass_DTC_0XC15582
        DemExtendedDataClassRef = ExtendedDataClass_83dcefb7
        DemFreezeFrameClassRef = FreezeFrameClass_fb82c988
        DemEventClass:
          DemAgingAllowed = true
          DemAgingCycleCounterThreshold = 80
          DemEventDestination = DEM_DTC_ORIGIN_PRIMARY_MEMORY
          DemEventPriority = 1
          DemEventFailureCycleCounterThreshold = 0
          DemConsiderPtoStatus = false
          DemFFPrestorageSupported = false
          DemAgingCycleRef = PowerCycle
          DemEnableConditionGroupRef = EnableConditionGroup_b30aa5c2
          DemOperationCycleRef = PowerCycle
          DemDebounceAlgorithmClass
            DemDebounceCounterBased:
              DemDebounceCounterDecrementStepSize = 1
              DemDebounceCounterIncrementStepSize = 1
              DemDebounceCounterJumpDown = false
              DemDebounceCounterJumpUp = false
              DemDebounceBehavior = DEM_DEBOUNCE_FREEZE
              DemDebounceCounterFailedThreshold = 127
              DemDebounceCounterJumpDownValue = 0
              DemDebounceCounterJumpUpValue = 0
              DemDebounceCounterPassedThreshold = -128
              DemDebounceCounterStorage = false
              DemDebounceContinuous = false
      DTC_0XC01988 (DemEventParameter):
        DemEventKind = DEM_EVENT_KIND_SWC
        DemMaxNumberFreezeFrameRecords = 1
        DemEventTimeSeries = DEM_TIMESERIES_SNAPSHOT_NONE
        DemEventAvailable = true
        DemEventId = 46
        DemEventAvailableInVariant = true
        DemEventLatchTestFailed = false
        DemEventCreateInfoPort = true
        DemDTCClassRef = DTCClass_DTC_0XC01988
        DemExtendedDataClassRef = ExtendedDataClass_83dcefb7
        DemFreezeFrameClassRef = FreezeFrameClass_fb82c988
        DemEventClass:
          DemAgingAllowed = true
          DemAgingCycleCounterThreshold = 80
          DemEventDestination = DEM_DTC_ORIGIN_PRIMARY_MEMORY
          DemEventPriority = 1
          DemEventFailureCycleCounterThreshold = 0
          DemConsiderPtoStatus = false
          DemFFPrestorageSupported = false
          DemAgingCycleRef = PowerCycle
          DemEnableConditionGroupRef = EnableConditionGroup_ce4d85f8
          DemOperationCycleRef = PowerCycle
          DemDebounceAlgorithmClass
            DemDebounceCounterBased:
              DemDebounceCounterDecrementStepSize = 1
              DemDebounceCounterIncrementStepSize = 1
              DemDebounceCounterJumpDown = false
              DemDebounceCounterJumpUp = false
              DemDebounceBehavior = DEM_DEBOUNCE_FREEZE
              DemDebounceCounterFailedThreshold = 127
              DemDebounceCounterJumpDownValue = 0
              DemDebounceCounterJumpUpValue = 0
              DemDebounceCounterPassedThreshold = -128
              DemDebounceCounterStorage = false
              DemDebounceContinuous = false
      3 x DemDTCClass, all with DemDTCSeverity=DEM_DTC_SEV_MAINTENANCE_ONLY, DemImmediateNvStorage=false:
        DTCClass_DTC_0XA11204: DemUdsDTC=10555908
        DTCClass_DTC_0X9A0401: DemUdsDTC=10093569
        DTCClass_DTC_0X9A0125: DemUdsDTC=10092837
      7 x DemEventParameter, all with DemEventKind=DEM_EVENT_KIND_SWC, DemMaxNumberFreezeFrameRecords=1, DemEventTimeSeries=DEM_TIMESERIES_SNAPSHOT_NONE, DemEventAvailable=true, DemEventAvailableInVariant=true, DemEventLatchTestFailed=false, DemEventCreateInfoPort=true, DemExtendedDataClassRef=ExtendedDataClass_83dcefb7, DemFreezeFrameClassRef=FreezeFrameClass_fb82c988:
        DTC_0X9A0112: DemEventId=7, DemDTCClassRef=DTCClass_DTC_0X9A0112
          DemEventClass:
            DemAgingAllowed = true
            DemAgingCycleCounterThreshold = 80
            DemEventDestination = DEM_DTC_ORIGIN_PRIMARY_MEMORY
            DemEventPriority = 1
            DemEventFailureCycleCounterThreshold = 0
            DemConsiderPtoStatus = false
            DemFFPrestorageSupported = false
            DemAgingCycleRef = PowerCycle
            DemEnableConditionGroupRef = EnableConditionGroup_b30aa5c2
            DemOperationCycleRef = PowerCycle
            DemDebounceAlgorithmClass
              DemDebounceCounterBased:
                DemDebounceCounterDecrementStepSize = 1
                DemDebounceCounterIncrementStepSize = 1
                DemDebounceCounterJumpDown = false
                DemDebounceCounterJumpUp = false
                DemDebounceBehavior = DEM_DEBOUNCE_FREEZE
                DemDebounceCounterFailedThreshold = 127
                DemDebounceCounterJumpDownValue = 0
                DemDebounceCounterJumpUpValue = 0
                DemDebounceCounterPassedThreshold = -128
                DemDebounceCounterStorage = false
                DemDebounceContinuous = false
        DTC_0X919F11: DemEventId=33, DemDTCClassRef=DTCClass_DTC_0X919F11
          DemEventClass:
            DemAgingAllowed = true
            DemAgingCycleCounterThreshold = 80
            DemEventDestination = DEM_DTC_ORIGIN_PRIMARY_MEMORY
            DemEventPriority = 1
            DemEventFailureCycleCounterThreshold = 0
            DemConsiderPtoStatus = false
            DemFFPrestorageSupported = false
            DemAgingCycleRef = PowerCycle
            DemEnableConditionGroupRef = EnableConditionGroup_b30aa5c2
            DemOperationCycleRef = PowerCycle
            DemDebounceAlgorithmClass
              DemDebounceCounterBased:
                DemDebounceCounterDecrementStepSize = 1
                DemDebounceCounterIncrementStepSize = 1
                DemDebounceCounterJumpDown = false
                DemDebounceCounterJumpUp = false
                DemDebounceBehavior = DEM_DEBOUNCE_FREEZE
                DemDebounceCounterFailedThreshold = 127
                DemDebounceCounterJumpDownValue = 0
                DemDebounceCounterJumpUpValue = 0
                DemDebounceCounterPassedThreshold = -128
                DemDebounceCounterStorage = false
                DemDebounceContinuous = false
        DTC_0X9A0111: DemEventId=6, DemDTCClassRef=DTCClass_DTC_0X9A0111
          DemEventClass:
            DemAgingAllowed = true
            DemAgingCycleCounterThreshold = 80
            DemEventDestination = DEM_DTC_ORIGIN_PRIMARY_MEMORY
            DemEventPriority = 1
            DemEventFailureCycleCounterThreshold = 0
            DemConsiderPtoStatus = false
            DemFFPrestorageSupported = false
            DemAgingCycleRef = PowerCycle
            DemEnableConditionGroupRef = EnableConditionGroup_b30aa5c2
            DemOperationCycleRef = PowerCycle
            DemDebounceAlgorithmClass
              DemDebounceCounterBased:
                DemDebounceCounterDecrementStepSize = 1
                DemDebounceCounterIncrementStepSize = 1
                DemDebounceCounterJumpDown = false
                DemDebounceCounterJumpUp = false
                DemDebounceBehavior = DEM_DEBOUNCE_FREEZE
                DemDebounceCounterFailedThreshold = 127
                DemDebounceCounterJumpDownValue = 0
                DemDebounceCounterJumpUpValue = 0
                DemDebounceCounterPassedThreshold = -128
                DemDebounceCounterStorage = false
                DemDebounceContinuous = false
        DTC_0X919F12: DemEventId=34, DemDTCClassRef=DTCClass_DTC_0X919F12
          DemEventClass:
            DemAgingAllowed = true
            DemAgingCycleCounterThreshold = 80
            DemEventDestination = DEM_DTC_ORIGIN_PRIMARY_MEMORY
            DemEventPriority = 1
            DemEventFailureCycleCounterThreshold = 0
            DemConsiderPtoStatus = false
            DemFFPrestorageSupported = false
            DemAgingCycleRef = PowerCycle
            DemEnableConditionGroupRef = EnableConditionGroup_b30aa5c2
            DemOperationCycleRef = PowerCycle
            DemDebounceAlgorithmClass
              DemDebounceCounterBased:
                DemDebounceCounterDecrementStepSize = 1
                DemDebounceCounterIncrementStepSize = 1
                DemDebounceCounterJumpDown = false
                DemDebounceCounterJumpUp = false
                DemDebounceBehavior = DEM_DEBOUNCE_FREEZE
                DemDebounceCounterFailedThreshold = 127
                DemDebounceCounterJumpDownValue = 0
                DemDebounceCounterJumpUpValue = 0
                DemDebounceCounterPassedThreshold = -128
                DemDebounceCounterStorage = false
                DemDebounceContinuous = false
        DTC_0X919F13: DemEventId=35, DemDTCClassRef=DTCClass_DTC_0X919F13
          DemEventClass:
            DemAgingAllowed = true
            DemAgingCycleCounterThreshold = 80
            DemEventDestination = DEM_DTC_ORIGIN_PRIMARY_MEMORY
            DemEventPriority = 1
            DemEventFailureCycleCounterThreshold = 0
            DemConsiderPtoStatus = false
            DemFFPrestorageSupported = false
            DemAgingCycleRef = PowerCycle
            DemEnableConditionGroupRef = EnableConditionGroup_b30aa5c2
            DemOperationCycleRef = PowerCycle
            DemDebounceAlgorithmClass
              DemDebounceCounterBased:
                DemDebounceCounterDecrementStepSize = 1
                DemDebounceCounterIncrementStepSize = 1
                DemDebounceCounterJumpDown = false
                DemDebounceCounterJumpUp = false
                DemDebounceBehavior = DEM_DEBOUNCE_FREEZE
                DemDebounceCounterFailedThreshold = 127
                DemDebounceCounterJumpDownValue = 0
                DemDebounceCounterJumpUpValue = 0
                DemDebounceCounterPassedThreshold = -128
                DemDebounceCounterStorage = false
                DemDebounceContinuous = false
        DTC_0X9A0113: DemEventId=8, DemDTCClassRef=DTCClass_DTC_0X9A0113
          DemEventClass:
            DemAgingAllowed = true
            DemAgingCycleCounterThreshold = 80
            DemEventDestination = DEM_DTC_ORIGIN_PRIMARY_MEMORY
            DemEventPriority = 1
            DemEventFailureCycleCounterThreshold = 0
            DemConsiderPtoStatus = false
            DemFFPrestorageSupported = false
            DemAgingCycleRef = PowerCycle
            DemEnableConditionGroupRef = EnableConditionGroup_b30aa5c2
            DemOperationCycleRef = PowerCycle
            DemDebounceAlgorithmClass
              DemDebounceCounterBased:
                DemDebounceCounterDecrementStepSize = 1
                DemDebounceCounterIncrementStepSize = 1
                DemDebounceCounterJumpDown = false
                DemDebounceCounterJumpUp = false
                DemDebounceBehavior = DEM_DEBOUNCE_FREEZE
                DemDebounceCounterFailedThreshold = 127
                DemDebounceCounterJumpDownValue = 0
                DemDebounceCounterJumpUpValue = 0
                DemDebounceCounterPassedThreshold = -128
                DemDebounceCounterStorage = false
                DemDebounceContinuous = false
        DTC_0XC14687: DemEventId=47, DemDTCClassRef=DTCClass_DTC_0XC14687
          DemEventClass:
            DemAgingAllowed = true
            DemAgingCycleCounterThreshold = 80
            DemEventDestination = DEM_DTC_ORIGIN_PRIMARY_MEMORY
            DemEventPriority = 1
            DemEventFailureCycleCounterThreshold = 0
            DemConsiderPtoStatus = false
            DemFFPrestorageSupported = false
            DemAgingCycleRef = PowerCycle
            DemEnableConditionGroupRef = EnableConditionGroup_ce4d85f8
            DemOperationCycleRef = PowerCycle
            DemDebounceAlgorithmClass
              DemDebounceCounterBased:
                DemDebounceCounterDecrementStepSize = 1
                DemDebounceCounterIncrementStepSize = 1
                DemDebounceCounterJumpDown = false
                DemDebounceCounterJumpUp = false
                DemDebounceBehavior = DEM_DEBOUNCE_FREEZE
                DemDebounceCounterFailedThreshold = 127
                DemDebounceCounterJumpDownValue = 0
                DemDebounceCounterJumpUpValue = 0
                DemDebounceCounterPassedThreshold = -128
                DemDebounceCounterStorage = false
                DemDebounceContinuous = false
      DTCClass_DTC_0X9A011E (DemDTCClass): DemDTCSeverity=DEM_DTC_SEV_MAINTENANCE_ONLY, DemUdsDTC=10092830, DemImmediateNvStorage=false
      DTCClass_DTC_0XC19988 (DemDTCClass): DemDTCSeverity=DEM_DTC_SEV_MAINTENANCE_ONLY, DemUdsDTC=12687752, DemImmediateNvStorage=false
      3 x DemEventParameter, all with DemEventKind=DEM_EVENT_KIND_SWC, DemMaxNumberFreezeFrameRecords=1, DemEventTimeSeries=DEM_TIMESERIES_SNAPSHOT_NONE, DemEventAvailable=true, DemEventAvailableInVariant=true, DemEventLatchTestFailed=false, DemEventCreateInfoPort=true, DemExtendedDataClassRef=ExtendedDataClass_83dcefb7, DemFreezeFrameClassRef=FreezeFrameClass_fb82c988:
        DTC_0X91BA63: DemEventId=25, DemDTCClassRef=DTCClass_DTC_0X91BA63
          DemEventClass:
            DemAgingAllowed = true
            DemAgingCycleCounterThreshold = 80
            DemEventDestination = DEM_DTC_ORIGIN_PRIMARY_MEMORY
            DemEventPriority = 1
            DemEventFailureCycleCounterThreshold = 0
            DemConsiderPtoStatus = false
            DemFFPrestorageSupported = false
            DemAgingCycleRef = PowerCycle
            DemEnableConditionGroupRef = EnableConditionGroup_5fbd712e
            DemOperationCycleRef = PowerCycle
            DemDebounceAlgorithmClass
              DemDebounceCounterBased:
                DemDebounceCounterDecrementStepSize = 1
                DemDebounceCounterIncrementStepSize = 1
                DemDebounceCounterJumpDown = false
                DemDebounceCounterJumpUp = false
                DemDebounceBehavior = DEM_DEBOUNCE_FREEZE
                DemDebounceCounterFailedThreshold = 127
                DemDebounceCounterJumpDownValue = 0
                DemDebounceCounterJumpUpValue = 0
                DemDebounceCounterPassedThreshold = -128
                DemDebounceCounterStorage = false
                DemDebounceContinuous = false
        DTC_0X9A0225: DemEventId=14, DemDTCClassRef=DTCClass_DTC_0X9A0225
          DemEventClass:
            DemAgingAllowed = true
            DemAgingCycleCounterThreshold = 80
            DemEventDestination = DEM_DTC_ORIGIN_PRIMARY_MEMORY
            DemEventPriority = 1
            DemEventFailureCycleCounterThreshold = 0
            DemConsiderPtoStatus = false
            DemFFPrestorageSupported = false
            DemAgingCycleRef = PowerCycle
            DemEnableConditionGroupRef = EnableConditionGroup_b30aa5c2
            DemOperationCycleRef = PowerCycle
            DemDebounceAlgorithmClass
              DemDebounceCounterBased:
                DemDebounceCounterDecrementStepSize = 1
                DemDebounceCounterIncrementStepSize = 1
                DemDebounceCounterJumpDown = false
                DemDebounceCounterJumpUp = false
                DemDebounceBehavior = DEM_DEBOUNCE_FREEZE
                DemDebounceCounterFailedThreshold = 127
                DemDebounceCounterJumpDownValue = 0
                DemDebounceCounterJumpUpValue = 0
                DemDebounceCounterPassedThreshold = -128
                DemDebounceCounterStorage = false
                DemDebounceContinuous = false
        DTC_0XD10017: DemEventId=53, DemDTCClassRef=DTCClass_DTC_0XD10017
          DemEventClass:
            DemAgingAllowed = true
            DemAgingCycleCounterThreshold = 80
            DemEventDestination = DEM_DTC_ORIGIN_PRIMARY_MEMORY
            DemEventPriority = 1
            DemEventFailureCycleCounterThreshold = 0
            DemConsiderPtoStatus = false
            DemFFPrestorageSupported = false
            DemAgingCycleRef = PowerCycle
            DemEnableConditionGroupRef = EnableConditionGroup_b30aa5c2
            DemOperationCycleRef = PowerCycle
            DemDebounceAlgorithmClass
              DemDebounceCounterBased:
                DemDebounceCounterDecrementStepSize = 1
                DemDebounceCounterIncrementStepSize = 1
                DemDebounceCounterJumpDown = false
                DemDebounceCounterJumpUp = false
                DemDebounceBehavior = DEM_DEBOUNCE_FREEZE
                DemDebounceCounterFailedThreshold = 127
                DemDebounceCounterJumpDownValue = 0
                DemDebounceCounterJumpUpValue = 0
                DemDebounceCounterPassedThreshold = -128
                DemDebounceCounterStorage = false
                DemDebounceContinuous = false
      DTCClass_DTC_0X9A0112 (DemDTCClass): DemDTCSeverity=DEM_DTC_SEV_MAINTENANCE_ONLY, DemUdsDTC=10092818, DemImmediateNvStorage=false
      DTCClass_DTC_0X9A0111 (DemDTCClass): DemDTCSeverity=DEM_DTC_SEV_MAINTENANCE_ONLY, DemUdsDTC=10092817, DemImmediateNvStorage=false
      3 x DemEventParameter, all with DemEventKind=DEM_EVENT_KIND_SWC, DemMaxNumberFreezeFrameRecords=1, DemEventTimeSeries=DEM_TIMESERIES_SNAPSHOT_NONE, DemEventAvailable=true, DemEventAvailableInVariant=true, DemEventLatchTestFailed=false, DemEventCreateInfoPort=true, DemExtendedDataClassRef=ExtendedDataClass_83dcefb7, DemFreezeFrameClassRef=FreezeFrameClass_fb82c988:
        DTC_0X93F512: DemEventId=27, DemDTCClassRef=DTCClass_DTC_0X93F512
          DemEventClass:
            DemAgingAllowed = true
            DemAgingCycleCounterThreshold = 80
            DemEventDestination = DEM_DTC_ORIGIN_PRIMARY_MEMORY
            DemEventPriority = 1
            DemEventFailureCycleCounterThreshold = 0
            DemConsiderPtoStatus = false
            DemFFPrestorageSupported = false
            DemAgingCycleRef = PowerCycle
            DemEnableConditionGroupRef = EnableConditionGroup_b30aa5c2
            DemOperationCycleRef = PowerCycle
            DemDebounceAlgorithmClass
              DemDebounceCounterBased:
                DemDebounceCounterDecrementStepSize = 1
                DemDebounceCounterIncrementStepSize = 1
                DemDebounceCounterJumpDown = false
                DemDebounceCounterJumpUp = false
                DemDebounceBehavior = DEM_DEBOUNCE_FREEZE
                DemDebounceCounterFailedThreshold = 127
                DemDebounceCounterJumpDownValue = 0
                DemDebounceCounterJumpUpValue = 0
                DemDebounceCounterPassedThreshold = -128
                DemDebounceCounterStorage = false
                DemDebounceContinuous = false
        DTC_0X93F511: DemEventId=26, DemDTCClassRef=DTCClass_DTC_0X93F511
          DemEventClass:
            DemAgingAllowed = true
            DemAgingCycleCounterThreshold = 80
            DemEventDestination = DEM_DTC_ORIGIN_PRIMARY_MEMORY
            DemEventPriority = 1
            DemEventFailureCycleCounterThreshold = 0
            DemConsiderPtoStatus = false
            DemFFPrestorageSupported = false
            DemAgingCycleRef = PowerCycle
            DemEnableConditionGroupRef = EnableConditionGroup_b30aa5c2
            DemOperationCycleRef = PowerCycle
            DemDebounceAlgorithmClass
              DemDebounceCounterBased:
                DemDebounceCounterDecrementStepSize = 1
                DemDebounceCounterIncrementStepSize = 1
                DemDebounceCounterJumpDown = false
                DemDebounceCounterJumpUp = false
                DemDebounceBehavior = DEM_DEBOUNCE_FREEZE
                DemDebounceCounterFailedThreshold = 127
                DemDebounceCounterJumpDownValue = 0
                DemDebounceCounterJumpUpValue = 0
                DemDebounceCounterPassedThreshold = -128
                DemDebounceCounterStorage = false
                DemDebounceContinuous = false
        DTC_0X925211: DemEventId=40, DemDTCClassRef=DTCClass_DTC_0X925211
          DemEventClass:
            DemAgingAllowed = true
            DemAgingCycleCounterThreshold = 80
            DemEventDestination = DEM_DTC_ORIGIN_PRIMARY_MEMORY
            DemEventPriority = 1
            DemEventFailureCycleCounterThreshold = 0
            DemConsiderPtoStatus = false
            DemFFPrestorageSupported = false
            DemAgingCycleRef = PowerCycle
            DemEnableConditionGroupRef = EnableConditionGroup_b30aa5c2
            DemOperationCycleRef = PowerCycle
            DemDebounceAlgorithmClass
              DemDebounceCounterBased:
                DemDebounceCounterDecrementStepSize = 1
                DemDebounceCounterIncrementStepSize = 1
                DemDebounceCounterJumpDown = false
                DemDebounceCounterJumpUp = false
                DemDebounceBehavior = DEM_DEBOUNCE_FREEZE
                DemDebounceCounterFailedThreshold = 127
                DemDebounceCounterJumpDownValue = 0
                DemDebounceCounterJumpUpValue = 0
                DemDebounceCounterPassedThreshold = -128
                DemDebounceCounterStorage = false
                DemDebounceContinuous = false
      DTCClass_DTC_0X9A0113 (DemDTCClass): DemDTCSeverity=DEM_DTC_SEV_MAINTENANCE_ONLY, DemUdsDTC=10092819, DemImmediateNvStorage=false
      3 x DemEventParameter, all with DemEventKind=DEM_EVENT_KIND_SWC, DemMaxNumberFreezeFrameRecords=1, DemEventTimeSeries=DEM_TIMESERIES_SNAPSHOT_NONE, DemEventAvailable=true, DemEventAvailableInVariant=true, DemEventLatchTestFailed=false, DemEventCreateInfoPort=true, DemExtendedDataClassRef=ExtendedDataClass_83dcefb7, DemFreezeFrameClassRef=FreezeFrameClass_fb82c988:
        DTC_0X93F513: DemEventId=28, DemDTCClassRef=DTCClass_DTC_0X93F513
          DemEventClass:
            DemAgingAllowed = true
            DemAgingCycleCounterThreshold = 80
            DemEventDestination = DEM_DTC_ORIGIN_PRIMARY_MEMORY
            DemEventPriority = 1
            DemEventFailureCycleCounterThreshold = 0
            DemConsiderPtoStatus = false
            DemFFPrestorageSupported = false
            DemAgingCycleRef = PowerCycle
            DemEnableConditionGroupRef = EnableConditionGroup_b30aa5c2
            DemOperationCycleRef = PowerCycle
            DemDebounceAlgorithmClass
              DemDebounceCounterBased:
                DemDebounceCounterDecrementStepSize = 1
                DemDebounceCounterIncrementStepSize = 1
                DemDebounceCounterJumpDown = false
                DemDebounceCounterJumpUp = false
                DemDebounceBehavior = DEM_DEBOUNCE_FREEZE
                DemDebounceCounterFailedThreshold = 127
                DemDebounceCounterJumpDownValue = 0
                DemDebounceCounterJumpUpValue = 0
                DemDebounceCounterPassedThreshold = -128
                DemDebounceCounterStorage = false
                DemDebounceContinuous = false
        DTC_0X9A0101: DemEventId=5, DemDTCClassRef=DTCClass_DTC_0X9A0101
          DemEventClass:
            DemAgingAllowed = true
            DemAgingCycleCounterThreshold = 80
            DemEventDestination = DEM_DTC_ORIGIN_PRIMARY_MEMORY
            DemEventPriority = 1
            DemEventFailureCycleCounterThreshold = 0
            DemConsiderPtoStatus = false
            DemFFPrestorageSupported = false
            DemAgingCycleRef = PowerCycle
            DemEnableConditionGroupRef = EnableConditionGroup_b30aa5c2
            DemOperationCycleRef = PowerCycle
            DemDebounceAlgorithmClass
              DemDebounceCounterBased:
                DemDebounceCounterDecrementStepSize = 1
                DemDebounceCounterIncrementStepSize = 1
                DemDebounceCounterJumpDown = false
                DemDebounceCounterJumpUp = false
                DemDebounceBehavior = DEM_DEBOUNCE_FREEZE
                DemDebounceCounterFailedThreshold = 127
                DemDebounceCounterJumpDownValue = 0
                DemDebounceCounterJumpUpValue = 0
                DemDebounceCounterPassedThreshold = -128
                DemDebounceCounterStorage = false
                DemDebounceContinuous = false
        DTC_0X9A021E: DemEventId=2, DemDTCClassRef=DTCClass_DTC_0X9A021E
          DemEventClass:
            DemAgingAllowed = true
            DemAgingCycleCounterThreshold = 80
            DemEventDestination = DEM_DTC_ORIGIN_PRIMARY_MEMORY
            DemEventPriority = 1
            DemEventFailureCycleCounterThreshold = 0
            DemConsiderPtoStatus = false
            DemFFPrestorageSupported = false
            DemAgingCycleRef = PowerCycle
            DemEnableConditionGroupRef = EnableConditionGroup_b30aa5c2
            DemOperationCycleRef = PowerCycle
            DemDebounceAlgorithmClass
              DemDebounceCounterBased:
                DemDebounceCounterDecrementStepSize = 1
                DemDebounceCounterIncrementStepSize = 1
                DemDebounceCounterJumpDown = false
                DemDebounceCounterJumpUp = false
                DemDebounceBehavior = DEM_DEBOUNCE_FREEZE
                DemDebounceCounterFailedThreshold = 127
                DemDebounceCounterJumpDownValue = 0
                DemDebounceCounterJumpUpValue = 0
                DemDebounceCounterPassedThreshold = -128
                DemDebounceCounterStorage = false
                DemDebounceContinuous = false
      3 x DemDTCClass, all with DemImmediateNvStorage=false:
        DTCClass_DTC_0XD10017: DemDTCSeverity=DEM_DTC_SEV_IMMEDIATELY, DemUdsDTC=13697047
        DTCClass_DTC_0XC14687: DemDTCSeverity=DEM_DTC_SEV_IMMEDIATELY, DemUdsDTC=12666503
        DTCClass_DTC_0X908E87: DemDTCSeverity=DEM_DTC_SEV_CHECK_AT_NEXT_HALT, DemUdsDTC=9473671
      DTC_0XA10604 (DemEventParameter):
        DemEventKind = DEM_EVENT_KIND_SWC
        DemMaxNumberFreezeFrameRecords = 1
        DemEventTimeSeries = DEM_TIMESERIES_SNAPSHOT_NONE
        DemEventAvailable = true
        DemEventId = 44
        DemEventAvailableInVariant = true
        DemEventLatchTestFailed = false
        DemEventCreateInfoPort = true
        DemDTCClassRef = DTCClass_DTC_0XA10604
        DemExtendedDataClassRef = ExtendedDataClass_83dcefb7
        DemFreezeFrameClassRef = FreezeFrameClass_fb82c988
        DemEventClass:
          DemAgingAllowed = true
          DemAgingCycleCounterThreshold = 80
          DemEventDestination = DEM_DTC_ORIGIN_PRIMARY_MEMORY
          DemEventPriority = 1
          DemEventFailureCycleCounterThreshold = 0
          DemConsiderPtoStatus = false
          DemFFPrestorageSupported = false
          DemAgingCycleRef = PowerCycle
          DemEnableConditionGroupRef = EnableConditionGroup_b30aa5c2
          DemOperationCycleRef = PowerCycle
          DemDebounceAlgorithmClass
            DemDebounceCounterBased:
              DemDebounceCounterDecrementStepSize = 1
              DemDebounceCounterIncrementStepSize = 1
              DemDebounceCounterJumpDown = false
              DemDebounceCounterJumpUp = false
              DemDebounceBehavior = DEM_DEBOUNCE_FREEZE
              DemDebounceCounterFailedThreshold = 127
              DemDebounceCounterJumpDownValue = 0
              DemDebounceCounterJumpUpValue = 0
              DemDebounceCounterPassedThreshold = -128
              DemDebounceCounterStorage = false
              DemDebounceContinuous = false
      DTCClass_DTC_0X91BA63 (DemDTCClass): DemDTCSeverity=DEM_DTC_SEV_CHECK_AT_NEXT_HALT, DemUdsDTC=9550435, DemImmediateNvStorage=false
      DTC_0XA10602 (DemEventParameter):
        DemEventKind = DEM_EVENT_KIND_SWC
        DemMaxNumberFreezeFrameRecords = 1
        DemEventTimeSeries = DEM_TIMESERIES_SNAPSHOT_NONE
        DemEventAvailable = true
        DemEventId = 43
        DemEventAvailableInVariant = true
        DemEventLatchTestFailed = false
        DemEventCreateInfoPort = true
        DemDTCClassRef = DTCClass_DTC_0XA10602
        DemExtendedDataClassRef = ExtendedDataClass_83dcefb7
        DemFreezeFrameClassRef = FreezeFrameClass_fb82c988
        DemEventClass:
          DemAgingAllowed = true
          DemAgingCycleCounterThreshold = 80
          DemEventDestination = DEM_DTC_ORIGIN_PRIMARY_MEMORY
          DemEventPriority = 1
          DemEventFailureCycleCounterThreshold = 0
          DemConsiderPtoStatus = false
          DemFFPrestorageSupported = false
          DemAgingCycleRef = PowerCycle
          DemEnableConditionGroupRef = EnableConditionGroup_b30aa5c2
          DemOperationCycleRef = PowerCycle
          DemDebounceAlgorithmClass
            DemDebounceCounterBased:
              DemDebounceCounterDecrementStepSize = 1
              DemDebounceCounterIncrementStepSize = 1
              DemDebounceCounterJumpDown = false
              DemDebounceCounterJumpUp = false
              DemDebounceBehavior = DEM_DEBOUNCE_FREEZE
              DemDebounceCounterFailedThreshold = 127
              DemDebounceCounterJumpDownValue = 0
              DemDebounceCounterJumpUpValue = 0
              DemDebounceCounterPassedThreshold = -128
              DemDebounceCounterStorage = false
              DemDebounceContinuous = false
      DTCClass_DTC_0X93F513 (DemDTCClass): DemDTCSeverity=DEM_DTC_SEV_CHECK_AT_NEXT_HALT, DemUdsDTC=9696531, DemImmediateNvStorage=false
      DTCClass_DTC_0X925211 (DemDTCClass): DemDTCSeverity=DEM_DTC_SEV_MAINTENANCE_ONLY, DemUdsDTC=9589250, DemImmediateNvStorage=false
      DTC_0X908E87 (DemEventParameter):
        DemEventKind = DEM_EVENT_KIND_SWC
        DemMaxNumberFreezeFrameRecords = 1
        DemEventTimeSeries = DEM_TIMESERIES_SNAPSHOT_NONE
        DemEventAvailable = true
        DemEventId = 32
        DemEventAvailableInVariant = true
        DemEventLatchTestFailed = false
        DemEventCreateInfoPort = true
        DemDTCClassRef = DTCClass_DTC_0X908E87
        DemExtendedDataClassRef = ExtendedDataClass_83dcefb7
        DemFreezeFrameClassRef = FreezeFrameClass_fb82c988
        DemEventClass:
          DemAgingAllowed = true
          DemAgingCycleCounterThreshold = 80
          DemEventDestination = DEM_DTC_ORIGIN_PRIMARY_MEMORY
          DemEventPriority = 1
          DemEventFailureCycleCounterThreshold = 0
          DemConsiderPtoStatus = false
          DemFFPrestorageSupported = false
          DemAgingCycleRef = PowerCycle
          DemEnableConditionGroupRef = EnableConditionGroup_3e8e3f33
          DemOperationCycleRef = PowerCycle
          DemDebounceAlgorithmClass
            DemDebounceCounterBased:
              DemDebounceCounterDecrementStepSize = 1
              DemDebounceCounterIncrementStepSize = 1
              DemDebounceCounterJumpDown = false
              DemDebounceCounterJumpUp = false
              DemDebounceBehavior = DEM_DEBOUNCE_FREEZE
              DemDebounceCounterFailedThreshold = 127
              DemDebounceCounterJumpDownValue = 0
              DemDebounceCounterJumpUpValue = 0
              DemDebounceCounterPassedThreshold = -128
              DemDebounceCounterStorage = false
              DemDebounceContinuous = false
      DTCClass_DTC_0X9A0301 (DemDTCClass): DemDTCSeverity=DEM_DTC_SEV_MAINTENANCE_ONLY, DemUdsDTC=10093313, DemImmediateNvStorage=false
      DTC_0X9A0211 (DemEventParameter):
        DemEventKind = DEM_EVENT_KIND_SWC
        DemMaxNumberFreezeFrameRecords = 1
        DemEventTimeSeries = DEM_TIMESERIES_SNAPSHOT_NONE
        DemEventAvailable = true
        DemEventId = 11
        DemEventAvailableInVariant = true
        DemEventLatchTestFailed = false
        DemEventCreateInfoPort = true
        DemDTCClassRef = DTCClass_DTC_0X9A0211
        DemExtendedDataClassRef = ExtendedDataClass_83dcefb7
        DemFreezeFrameClassRef = FreezeFrameClass_fb82c988
        DemEventClass:
          DemAgingAllowed = true
          DemAgingCycleCounterThreshold = 80
          DemEventDestination = DEM_DTC_ORIGIN_PRIMARY_MEMORY
          DemEventPriority = 1
          DemEventFailureCycleCounterThreshold = 0
          DemConsiderPtoStatus = false
          DemFFPrestorageSupported = false
          DemAgingCycleRef = PowerCycle
          DemEnableConditionGroupRef = EnableConditionGroup_b30aa5c2
          DemOperationCycleRef = PowerCycle
          DemDebounceAlgorithmClass
            DemDebounceCounterBased:
              DemDebounceCounterDecrementStepSize = 1
              DemDebounceCounterIncrementStepSize = 1
              DemDebounceCounterJumpDown = false
              DemDebounceCounterJumpUp = false
              DemDebounceBehavior = DEM_DEBOUNCE_FREEZE
              DemDebounceCounterFailedThreshold = 127
              DemDebounceCounterJumpDownValue = 0
              DemDebounceCounterJumpUpValue = 0
              DemDebounceCounterPassedThreshold = -128
              DemDebounceCounterStorage = false
              DemDebounceContinuous = false
      DTC_0X9A0213 (DemEventParameter):
        DemEventKind = DEM_EVENT_KIND_SWC
        DemMaxNumberFreezeFrameRecords = 1
        DemEventTimeSeries = DEM_TIMESERIES_SNAPSHOT_NONE
        DemEventAvailable = true
        DemEventId = 13
        DemEventAvailableInVariant = true
        DemEventLatchTestFailed = false
        DemEventCreateInfoPort = true
        DemDTCClassRef = DTCClass_DTC_0X9A0213
        DemExtendedDataClassRef = ExtendedDataClass_83dcefb7
        DemFreezeFrameClassRef = FreezeFrameClass_fb82c988
        DemEventClass:
          DemAgingAllowed = true
          DemAgingCycleCounterThreshold = 80
          DemEventDestination = DEM_DTC_ORIGIN_PRIMARY_MEMORY
          DemEventPriority = 1
          DemEventFailureCycleCounterThreshold = 0
          DemConsiderPtoStatus = false
          DemFFPrestorageSupported = false
          DemAgingCycleRef = PowerCycle
          DemEnableConditionGroupRef = EnableConditionGroup_b30aa5c2
          DemOperationCycleRef = PowerCycle
          DemDebounceAlgorithmClass
            DemDebounceCounterBased:
              DemDebounceCounterDecrementStepSize = 1
              DemDebounceCounterIncrementStepSize = 1
              DemDebounceCounterJumpDown = false
              DemDebounceCounterJumpUp = false
              DemDebounceBehavior = DEM_DEBOUNCE_FREEZE
              DemDebounceCounterFailedThreshold = 127
              DemDebounceCounterJumpDownValue = 0
              DemDebounceCounterJumpUpValue = 0
              DemDebounceCounterPassedThreshold = -128
              DemDebounceCounterStorage = false
              DemDebounceContinuous = false
      DTCClass_DTC_0X93F511 (DemDTCClass): DemDTCSeverity=DEM_DTC_SEV_CHECK_AT_NEXT_HALT, DemUdsDTC=9696529, DemImmediateNvStorage=false
      DTCClass_DTC_0X9A0425 (DemDTCClass): DemDTCSeverity=DEM_DTC_SEV_MAINTENANCE_ONLY, DemUdsDTC=10093605, DemImmediateNvStorage=false
      DTC_0X9A0212 (DemEventParameter):
        DemEventKind = DEM_EVENT_KIND_SWC
        DemMaxNumberFreezeFrameRecords = 1
        DemEventTimeSeries = DEM_TIMESERIES_SNAPSHOT_NONE
        DemEventAvailable = true
        DemEventId = 12
        DemEventAvailableInVariant = true
        DemEventLatchTestFailed = false
        DemEventCreateInfoPort = true
        DemDTCClassRef = DTCClass_DTC_0X9A0212
        DemExtendedDataClassRef = ExtendedDataClass_83dcefb7
        DemFreezeFrameClassRef = FreezeFrameClass_fb82c988
        DemEventClass:
          DemAgingAllowed = true
          DemAgingCycleCounterThreshold = 80
          DemEventDestination = DEM_DTC_ORIGIN_PRIMARY_MEMORY
          DemEventPriority = 1
          DemEventFailureCycleCounterThreshold = 0
          DemConsiderPtoStatus = false
          DemFFPrestorageSupported = false
          DemAgingCycleRef = PowerCycle
          DemEnableConditionGroupRef = EnableConditionGroup_b30aa5c2
          DemOperationCycleRef = PowerCycle
          DemDebounceAlgorithmClass
            DemDebounceCounterBased:
              DemDebounceCounterDecrementStepSize = 1
              DemDebounceCounterIncrementStepSize = 1
              DemDebounceCounterJumpDown = false
              DemDebounceCounterJumpUp = false
              DemDebounceBehavior = DEM_DEBOUNCE_FREEZE
              DemDebounceCounterFailedThreshold = 127
              DemDebounceCounterJumpDownValue = 0
              DemDebounceCounterJumpUpValue = 0
              DemDebounceCounterPassedThreshold = -128
              DemDebounceCounterStorage = false
              DemDebounceContinuous = false
      3 x DemDTCClass, all with DemImmediateNvStorage=false:
        DTCClass_DTC_0X93F512: DemDTCSeverity=DEM_DTC_SEV_CHECK_AT_NEXT_HALT, DemUdsDTC=9696530
        DTCClass_DTC_0XC01988: DemDTCSeverity=DEM_DTC_SEV_MAINTENANCE_ONLY, DemUdsDTC=12589448
        DTCClass_DTC_0XA10602: DemDTCSeverity=DEM_DTC_SEV_MAINTENANCE_ONLY, DemUdsDTC=10552834
      DTC_0XA11204 (DemEventParameter):
        DemEventKind = DEM_EVENT_KIND_SWC
        DemMaxNumberFreezeFrameRecords = 1
        DemEventTimeSeries = DEM_TIMESERIES_SNAPSHOT_NONE
        DemEventAvailable = true
        DemEventId = 45
        DemEventAvailableInVariant = true
        DemEventLatchTestFailed = false
        DemEventCreateInfoPort = true
        DemDTCClassRef = DTCClass_DTC_0XA11204
        DemExtendedDataClassRef = ExtendedDataClass_83dcefb7
        DemFreezeFrameClassRef = FreezeFrameClass_fb82c988
        DemEventClass:
          DemAgingAllowed = true
          DemAgingCycleCounterThreshold = 80
          DemEventDestination = DEM_DTC_ORIGIN_PRIMARY_MEMORY
          DemEventPriority = 1
          DemEventFailureCycleCounterThreshold = 0
          DemConsiderPtoStatus = false
          DemFFPrestorageSupported = false
          DemAgingCycleRef = PowerCycle
          DemEnableConditionGroupRef = EnableConditionGroup_ce4d85f8
          DemOperationCycleRef = PowerCycle
          DemDebounceAlgorithmClass
            DemDebounceCounterBased:
              DemDebounceCounterDecrementStepSize = 1
              DemDebounceCounterIncrementStepSize = 1
              DemDebounceCounterJumpDown = false
              DemDebounceCounterJumpUp = false
              DemDebounceBehavior = DEM_DEBOUNCE_FREEZE
              DemDebounceCounterFailedThreshold = 127
              DemDebounceCounterJumpDownValue = 0
              DemDebounceCounterJumpUpValue = 0
              DemDebounceCounterPassedThreshold = -128
              DemDebounceCounterStorage = false
              DemDebounceContinuous = false
      DTCClass_DTC_0XA10604 (DemDTCClass): DemDTCSeverity=DEM_DTC_SEV_MAINTENANCE_ONLY, DemUdsDTC=10552836, DemImmediateNvStorage=false
      DTCClass_DTC_0X9A041E (DemDTCClass): DemDTCSeverity=DEM_DTC_SEV_MAINTENANCE_ONLY, DemUdsDTC=10093598, DemImmediateNvStorage=false
      DTC_0X9A0325 (DemEventParameter):
        DemEventKind = DEM_EVENT_KIND_SWC
        DemMaxNumberFreezeFrameRecords = 1
        DemEventTimeSeries = DEM_TIMESERIES_SNAPSHOT_NONE
        DemEventAvailable = true
        DemEventId = 19
        DemEventAvailableInVariant = true
        DemEventLatchTestFailed = false
        DemEventCreateInfoPort = true
        DemDTCClassRef = DTCClass_DTC_0X9A0325
        DemExtendedDataClassRef = ExtendedDataClass_83dcefb7
        DemFreezeFrameClassRef = FreezeFrameClass_fb82c988
        DemEventClass:
          DemAgingAllowed = true
          DemAgingCycleCounterThreshold = 80
          DemEventDestination = DEM_DTC_ORIGIN_PRIMARY_MEMORY
          DemEventPriority = 1
          DemEventFailureCycleCounterThreshold = 0
          DemConsiderPtoStatus = false
          DemFFPrestorageSupported = false
          DemAgingCycleRef = PowerCycle
          DemEnableConditionGroupRef = EnableConditionGroup_b30aa5c2
          DemOperationCycleRef = PowerCycle
          DemDebounceAlgorithmClass
            DemDebounceCounterBased:
              DemDebounceCounterDecrementStepSize = 1
              DemDebounceCounterIncrementStepSize = 1
              DemDebounceCounterJumpDown = false
              DemDebounceCounterJumpUp = false
              DemDebounceBehavior = DEM_DEBOUNCE_FREEZE
              DemDebounceCounterFailedThreshold = 127
              DemDebounceCounterJumpDownValue = 0
              DemDebounceCounterJumpUpValue = 0
              DemDebounceCounterPassedThreshold = -128
              DemDebounceCounterStorage = false
              DemDebounceContinuous = false
      DTC_0XD10116 (DemEventParameter):
        DemEventKind = DEM_EVENT_KIND_SWC
        DemMaxNumberFreezeFrameRecords = 1
        DemEventTimeSeries = DEM_TIMESERIES_SNAPSHOT_NONE
        DemEventAvailable = true
        DemEventId = 54
        DemEventAvailableInVariant = true
        DemEventLatchTestFailed = false
        DemEventCreateInfoPort = true
        DemDTCClassRef = DTCClass_DTC_0XD10116
        DemExtendedDataClassRef = ExtendedDataClass_83dcefb7
        DemFreezeFrameClassRef = FreezeFrameClass_fb82c988
        DemEventClass:
          DemAgingAllowed = true
          DemAgingCycleCounterThreshold = 80
          DemEventDestination = DEM_DTC_ORIGIN_PRIMARY_MEMORY
          DemEventPriority = 1
          DemEventFailureCycleCounterThreshold = 0
          DemConsiderPtoStatus = false
          DemFFPrestorageSupported = false
          DemAgingCycleRef = PowerCycle
          DemEnableConditionGroupRef = EnableConditionGroup_b30aa5c2
          DemOperationCycleRef = PowerCycle
          DemDebounceAlgorithmClass
            DemDebounceCounterBased:
              DemDebounceCounterDecrementStepSize = 1
              DemDebounceCounterIncrementStepSize = 1
              DemDebounceCounterJumpDown = false
              DemDebounceCounterJumpUp = false
              DemDebounceBehavior = DEM_DEBOUNCE_FREEZE
              DemDebounceCounterFailedThreshold = 127
              DemDebounceCounterJumpDownValue = 0
              DemDebounceCounterJumpUpValue = 0
              DemDebounceCounterPassedThreshold = -128
              DemDebounceCounterStorage = false
              DemDebounceContinuous = false
      6 x DemDTCClass, all with DemImmediateNvStorage=false:
        DTCClass_DTC_0X919F13: DemDTCSeverity=DEM_DTC_SEV_CHECK_AT_NEXT_HALT, DemUdsDTC=9543443
        DTCClass_DTC_0X919F11: DemDTCSeverity=DEM_DTC_SEV_CHECK_AT_NEXT_HALT, DemUdsDTC=9543441
        DTCClass_DTC_0X919F12: DemDTCSeverity=DEM_DTC_SEV_CHECK_AT_NEXT_HALT, DemUdsDTC=9543442
        DTCClass_DTC_0X9A0413: DemDTCSeverity=DEM_DTC_SEV_MAINTENANCE_ONLY, DemUdsDTC=10093587
        DTCClass_DTC_0X9A0412: DemDTCSeverity=DEM_DTC_SEV_MAINTENANCE_ONLY, DemUdsDTC=10093586
        DTCClass_DTC_0X9A0411: DemDTCSeverity=DEM_DTC_SEV_MAINTENANCE_ONLY, DemUdsDTC=10093585
      DTC_0X909602 (DemEventParameter):
        DemEventKind = DEM_EVENT_KIND_SWC
        DemMaxNumberFreezeFrameRecords = 1
        DemEventTimeSeries = DEM_TIMESERIES_SNAPSHOT_NONE
        DemEventAvailable = true
        DemEventId = 37
        DemEventAvailableInVariant = true
        DemEventLatchTestFailed = false
        DemEventCreateInfoPort = true
        DemDTCClassRef = DTCClass_DTC_0X909602
        DemExtendedDataClassRef = ExtendedDataClass_83dcefb7
        DemFreezeFrameClassRef = FreezeFrameClass_fb82c988
        DemEventClass:
          DemAgingAllowed = true
          DemAgingCycleCounterThreshold = 80
          DemEventDestination = DEM_DTC_ORIGIN_PRIMARY_MEMORY
          DemEventPriority = 1
          DemEventFailureCycleCounterThreshold = 0
          DemConsiderPtoStatus = false
          DemFFPrestorageSupported = false
          DemAgingCycleRef = PowerCycle
          DemEnableConditionGroupRef = EnableConditionGroup_b30aa5c2
          DemOperationCycleRef = PowerCycle
          DemDebounceAlgorithmClass
            DemDebounceCounterBased:
              DemDebounceCounterDecrementStepSize = 1
              DemDebounceCounterIncrementStepSize = 1
              DemDebounceCounterJumpDown = false
              DemDebounceCounterJumpUp = false
              DemDebounceBehavior = DEM_DEBOUNCE_FREEZE
              DemDebounceCounterFailedThreshold = 127
              DemDebounceCounterJumpDownValue = 0
              DemDebounceCounterJumpUpValue = 0
              DemDebounceCounterPassedThreshold = -128
              DemDebounceCounterStorage = false
              DemDebounceContinuous = false
      DTCClass_DTC_0XC26402 (DemDTCClass): DemDTCSeverity=DEM_DTC_SEV_CHECK_AT_NEXT_HALT, DemUdsDTC=12739586, DemImmediateNvStorage=false
      4 x DemEventParameter, all with DemEventKind=DEM_EVENT_KIND_SWC, DemEventTimeSeries=DEM_TIMESERIES_SNAPSHOT_NONE, DemEventAvailable=true, DemEventAvailableInVariant=true, DemEventLatchTestFailed=false, DemEventCreateInfoPort=true:
        DTC_0X9A0201: DemMaxNumberFreezeFrameRecords=1, DemEventId=10, DemDTCClassRef=DTCClass_DTC_0X9A0201, DemExtendedDataClassRef=ExtendedDataClass_83dcefb7, DemFreezeFrameClassRef=FreezeFrameClass_fb82c988
          DemEventClass:
            DemAgingAllowed = true
            DemAgingCycleCounterThreshold = 80
            DemEventDestination = DEM_DTC_ORIGIN_PRIMARY_MEMORY
            DemEventPriority = 1
            DemEventFailureCycleCounterThreshold = 0
            DemConsiderPtoStatus = false
            DemFFPrestorageSupported = false
            DemAgingCycleRef = PowerCycle
            DemEnableConditionGroupRef = EnableConditionGroup_b30aa5c2
            DemOperationCycleRef = PowerCycle
            DemDebounceAlgorithmClass
              DemDebounceCounterBased:
                DemDebounceCounterDecrementStepSize = 1
                DemDebounceCounterIncrementStepSize = 1
                DemDebounceCounterJumpDown = false
                DemDebounceCounterJumpUp = false
                DemDebounceBehavior = DEM_DEBOUNCE_FREEZE
                DemDebounceCounterFailedThreshold = 127
                DemDebounceCounterJumpDownValue = 0
                DemDebounceCounterJumpUpValue = 0
                DemDebounceCounterPassedThreshold = -128
                DemDebounceCounterStorage = false
                DemDebounceContinuous = false
        DTC_0X9A031E: DemMaxNumberFreezeFrameRecords=1, DemEventId=3, DemDTCClassRef=DTCClass_DTC_0X9A031E, DemExtendedDataClassRef=ExtendedDataClass_83dcefb7, DemFreezeFrameClassRef=FreezeFrameClass_fb82c988
          DemEventClass:
            DemAgingAllowed = true
            DemAgingCycleCounterThreshold = 80
            DemEventDestination = DEM_DTC_ORIGIN_PRIMARY_MEMORY
            DemEventPriority = 1
            DemEventFailureCycleCounterThreshold = 0
            DemConsiderPtoStatus = false
            DemFFPrestorageSupported = false
            DemAgingCycleRef = PowerCycle
            DemEnableConditionGroupRef = EnableConditionGroup_b30aa5c2
            DemOperationCycleRef = PowerCycle
            DemDebounceAlgorithmClass
              DemDebounceCounterBased:
                DemDebounceCounterDecrementStepSize = 1
                DemDebounceCounterIncrementStepSize = 1
                DemDebounceCounterJumpDown = false
                DemDebounceCounterJumpUp = false
                DemDebounceBehavior = DEM_DEBOUNCE_FREEZE
                DemDebounceCounterFailedThreshold = 127
                DemDebounceCounterJumpDownValue = 0
                DemDebounceCounterJumpUpValue = 0
                DemDebounceCounterPassedThreshold = -128
                DemDebounceCounterStorage = false
                DemDebounceContinuous = false
        DTC_0XC19988: DemMaxNumberFreezeFrameRecords=1, DemEventId=51, DemDTCClassRef=DTCClass_DTC_0XC19988, DemExtendedDataClassRef=ExtendedDataClass_83dcefb7, DemFreezeFrameClassRef=FreezeFrameClass_fb82c988
          DemEventClass:
            DemAgingAllowed = true
            DemAgingCycleCounterThreshold = 80
            DemEventDestination = DEM_DTC_ORIGIN_PRIMARY_MEMORY
            DemEventPriority = 1
            DemEventFailureCycleCounterThreshold = 0
            DemConsiderPtoStatus = false
            DemFFPrestorageSupported = false
            DemAgingCycleRef = PowerCycle
            DemEnableConditionGroupRef = EnableConditionGroup_ce4d85f8
            DemOperationCycleRef = PowerCycle
            DemDebounceAlgorithmClass
              DemDebounceCounterBased:
                DemDebounceCounterDecrementStepSize = 1
                DemDebounceCounterIncrementStepSize = 1
                DemDebounceCounterJumpDown = false
                DemDebounceCounterJumpUp = false
                DemDebounceBehavior = DEM_DEBOUNCE_FREEZE
                DemDebounceCounterFailedThreshold = 127
                DemDebounceCounterJumpDownValue = 0
                DemDebounceCounterJumpUpValue = 0
                DemDebounceCounterPassedThreshold = -128
                DemDebounceCounterStorage = false
                DemDebounceContinuous = false
        DemEventParameter_Ramtst: DemEventId=55
          DemEventClass:
            DemAgingAllowed = false
            DemConsiderPtoStatus = false
            DemEventDestination = DEM_DTC_ORIGIN_PRIMARY_MEMORY
            DemEventPriority = 2
            DemFFPrestorageSupported = false
            DemOperationCycleRef = PowerCycle
            DemDebounceAlgorithmClass
              DemDebounceCounterBased:
                DemDebounceBehavior = DEM_DEBOUNCE_FREEZE
                DemDebounceCounterDecrementStepSize = 1
                DemDebounceCounterFailedThreshold = 127
                DemDebounceCounterIncrementStepSize = 1
                DemDebounceCounterJumpDown = true
                DemDebounceCounterJumpDownValue = 0
                DemDebounceCounterJumpUp = true
                DemDebounceCounterJumpUpValue = 0
                DemDebounceCounterPassedThreshold = -128
                DemDebounceCounterStorage = false
                DemDebounceContinuous = false
      DemDTCClass_StartApplication (DemDTCClass): DemImmediateNvStorage=false, DemUdsDTC=4729855
      DEM_EVENT_StartApplication (DemEventParameter):
        DemEventTimeSeries = DEM_TIMESERIES_SNAPSHOT_NONE
        DemEventAvailable = true
        DemEventId = 56
        DemEventKind = DEM_EVENT_KIND_SWC
        DemEventAvailableInVariant = true
        DemEventLatchTestFailed = false
        DemMaxNumberFreezeFrameRecords = 1
        DemEventCreateInfoPort = true
        DemDTCClassRef = DemDTCClass_StartApplication
        DemFreezeFrameClassRef = DemFreezeFrameClass_StartApplication
        DemEventClass:
          DemAgingAllowed = false
          DemConsiderPtoStatus = false
          DemEventDestination = DEM_DTC_ORIGIN_PRIMARY_MEMORY
          DemEventPriority = 2
          DemFFPrestorageSupported = false
          DemOperationCycleRef = PowerCycle
          DemAgingCycleRef = PowerCycle
          DemDebounceAlgorithmClass
            DemDebounceCounterBased:
              DemDebounceBehavior = DEM_DEBOUNCE_FREEZE
              DemDebounceCounterDecrementStepSize = 1
              DemDebounceCounterFailedThreshold = 127
              DemDebounceCounterIncrementStepSize = 1
              DemDebounceCounterJumpDown = true
              DemDebounceCounterJumpDownValue = 0
              DemDebounceCounterJumpUp = true
              DemDebounceCounterJumpUpValue = 0
              DemDebounceCounterPassedThreshold = -128
              DemDebounceCounterStorage = false
              DemDebounceContinuous = false
    DemGeneral:
      DemAgingCycleCounterProcessing = DEM_PROCESS_AGINGCTR_INTERN
      DemDebounceCounterBasedSupport = true
      DemDtcStatusAvailabilityMask = 255
      DemEnableConditionSupport = true
      DemMaxNumberEventEntryMirror = 0
      DemPTOSupport = false
      DemTypeOfFreezeFrameRecordNumeration = DEM_FF_RECNUM_CALCULATED
      DemGeneralInterfaceSupport = false
      DemDataElementDefaultEndianness = LITTLE_ENDIAN
      DemAgingRequieresTestedCycle = false
      DemTriggerMonitorInitBeforeClearOk = true
      DemExtendedDataCapture = DEM_TRIGGER_EVENT_MEMORY_STORAGE
      DemFreezeFrameCapture = DEM_TRIGGER_EVENT_MEMORY_STORAGE
      DemOperationCycleProcessing = DEM_PROCESS_OPCYC_STATE
      DemMaxNumberTimeSeriesSnapshots = 0
      DemAvailabilitySupport = DEM_NO_AVAILABILITY
      DemAvailabilityStorage = false
      DemBswErrorBufferSize = 0
      DemClearDTCBehavior = DEM_CLRRESP_VOLATILE
      DemClearDTCLimitation = DEM_ALL_SUPPORTED_DTCS
      DemDebounceTimeBasedSupport = false
      DemDevErrorDetect = true
      DemEventCombinationSupport = DEM_EVCOMB_DISABLED
      DemEventDisplacementStrategy = DEM_DISPLACEMENT_LEGACY_403
      DemEventMemoryEntryStorageTrigger = DEM_STORAGE_ON_TEST_FAILED
      DemMaxNumberEventEntryOBDFreezeFrame = 0
      DemMaxNumberEventEntryPermanent = 0
      DemMaxNumberEventEntryPrimary = 8
      DemMaxNumberEventEntrySecondary = 0
      DemMaxNumberPrestoredFF = 0
      DemOBDSupport = DEM_OBD_NO_OBD_SUPPORT
      DemOccurrenceCounterProcessing = DEM_PROCESS_OCCCTR_TF
      DemOperationCycleStatusStorage = false
      DemResetConfirmedBitOnOverflow = true
      DemStatusBitHandlingTestFailedSinceLastClear = DEM_STATUS_BIT_NORMAL
      DemStatusBitStorageTestFailed = true
      DemStorageConditionSupport = false
      DemSuppressionSupport = DEM_NO_SUPPRESSION
      DemTaskTime = 0.01
      DemTriggerDcmReports = false
      DemTriggerDltReports = false
      DemTriggerFiMReports = false
      DemTriggerFiMReportsExtended = false
      DemTriggerMonitorInitForEnableConditions = false
      DemTypeOfDTCSupported = DEM_DTC_TRANSLATION_ISO14229_1
      DemVersionInfoApi = false
      DemBswApiVersion = DEM_BSW_API_4_XX_XX
      DemBswApiVersionNvM = DEM_BSW_API_4_XX_XX
      DemBswApiVersionFiM = DEM_BSW_API_4_XX_XX
      DemAgingAfterHealing = DEM_AGING_WHILE_HEALING
      DemAgingBehavior = DEM_AGING_TYPE_1
      DemAgingCounterBehavior = DEM_AGING_COUNT_ALWAYS
      DemAgingCounterReporting = DEM_AGING_NORMAL_REPORTING
      DemAgingRetainEnvironmentalData = false
      DemCompiledPostbuildCrc = 1087818435
      DemCompiledPostbuildCrcMode = DEM_POSTBUILD_CRC_AUTOMATIC
      DemEventDisplacementFallbackStrategy = DEM_FALLBACK_DISCARD_NEW_EVENT
      DemGeneralDiagnosticInfoSupport = true
      DemJ1939Support = false
      DemNvSynchronizeSupport = false
      DemPendingDtcProcessing = DEM_PROCESS_PDTC_STOREDONLY
      DemResetDebounceBehavior = DEM_RESET_DEBOUNCE_ON_DISABLE_ENABLE_CONDITIONS
      DemResetTestFailedOnOperationCycleStart = false
      DemRetryStorageSupport = false
      DemSafeBswChecks = false
      DemUseMemcopyMacros = false
      DemUseRte = true
      DemUserControlledWirBehavior = DEM_ENABLED_DURING_CONTROLDTCSETTING
      DemUserDefinedCompareAndSwap = false
      DemWarningIndicatorRequestedProcessing = DEM_PROCESS_WIR_STOREDONLY
      DemUseMultiPartitionFiM = false
      OccurrenceCounter (DemExtendedDataRecordClass): DemExtendedDataRecordNumber=1, DemDataClassRef=OccurrenceCounter_Occurrence_Counter
      DemPostbuild: DemEventAvailableDefaultSupport=true, DemMaxSizeFreezeFrame=2, DemMaxNumberDtr=0
      IgnitionCycle (DemOperationCycle): DemOperationCycleType=DEM_OPCYC_IGNITION, DemOperationCycleAutomaticEnd=false, DemOperationCycleAutostart=false
      4 x DemEnableCondition, all with DemEnableConditionStatus=true:
        V51: DemEnableConditionId=8
        supply: DemEnableConditionId=21
        power: DemEnableConditionId=19
        STATE_NORMAL: DemEnableConditionId=6
      DemEventMemorySet
      3 x DemEnableCondition, all with DemEnableConditionStatus=true:
        HUT: DemEnableConditionId=3
        sequence: DemEnableConditionId=20
        Vechile: DemEnableConditionId=9
      PowerCycle (DemOperationCycle): DemOperationCycleType=DEM_OPCYC_POWER, DemOperationCycleAutomaticEnd=false, DemOperationCycleAutostart=false
      No (DemEnableCondition): DemEnableConditionId=5, DemEnableConditionStatus=true
      fault (DemEnableCondition): DemEnableConditionId=14, DemEnableConditionStatus=true
      EnableConditionGroup_2d4cad61 (DemEnableConditionGroup):
        DemEnableConditionRef = HUT
        DemEnableConditionRef = HUT
        DemEnableConditionRef = No
        DemEnableConditionRef = STATE_NORMAL
        DemEnableConditionRef = Start
        DemEnableConditionRef = camer
        DemEnableConditionRef = completed
        DemEnableConditionRef = fault
        DemEnableConditionRef = in
        DemEnableConditionRef = is
        DemEnableConditionRef = is
        DemEnableConditionRef = power
        DemEnableConditionRef = sequence
        DemEnableConditionRef = supply
        DemEnableConditionRef = up
      up (DemEnableCondition): DemEnableConditionId=22, DemEnableConditionStatus=true
      PID_0x14_DID_Data (DemDataClass):
        DemDataElementDataSize = 2
        DemDataElementDataType = UINT16
        DemDataElementEndianness = BIG_ENDIAN
        DemDataElementUsePort = USE_DATA_CLIENT_SERVER_PORT
        DemDataElementStoreNonVolatile = true
      3 x DemEnableCondition, all with DemEnableConditionStatus=true:
        voltage: DemEnableConditionId=24
        IP: DemEnableConditionId=4
        in: DemEnableConditionId=15
      OccurrenceCounter_Occurrence_Counter (DemDataClass): DemDataElementDataSize=1, DemDataElementInternalData=DEM_OCCCTR, DemDataElementUsePort=USE_DATA_INTERNAL, DemDataElementStoreNonVolatile=true
      or (DemEnableCondition): DemEnableConditionId=18, DemEnableConditionStatus=true
      ExtendedDataClass_83dcefb7 (DemExtendedDataClass): DemExtendedDataRecordClassRef=OccurrenceCounter
      EnableConditionGroup_5fbd712e (DemEnableConditionGroup):
        DemEnableConditionRef = China
        DemEnableConditionRef = H9
        DemEnableConditionRef = HUT
        DemEnableConditionRef = HUT
        DemEnableConditionRef = STATE_NORMAL
        DemEnableConditionRef = Start
        DemEnableConditionRef = V51
        DemEnableConditionRef = Vechile
        DemEnableConditionRef = completed
        DemEnableConditionRef = in
        DemEnableConditionRef = is
        DemEnableConditionRef = is
        DemEnableConditionRef = or
        DemEnableConditionRef = sequence
        DemEnableConditionRef = up
        DemEnableConditionRef = variant
      H9 (DemEnableCondition): DemEnableConditionId=2, DemEnableConditionStatus=true
      variant (DemEnableCondition): DemEnableConditionId=23, DemEnableConditionStatus=true
      FreezeFrameClass_fb82c988 (DemFreezeFrameClass): DemDidClassRef=DID_0xf414
      diagnostic (DemEnableCondition): DemEnableConditionId=12, DemEnableConditionStatus=true
      is (DemEnableCondition): DemEnableConditionId=16, DemEnableConditionStatus=true
      EnableConditionGroup_b30aa5c2 (DemEnableConditionGroup):
        DemEnableConditionRef = HUT
        DemEnableConditionRef = HUT
        DemEnableConditionRef = STATE_NORMAL
        DemEnableConditionRef = Start
        DemEnableConditionRef = completed
        DemEnableConditionRef = in
        DemEnableConditionRef = is
        DemEnableConditionRef = is
        DemEnableConditionRef = sequence
        DemEnableConditionRef = up
      4 x DemEnableCondition, all with DemEnableConditionStatus=true:
        camer: DemEnableConditionId=10
        display: DemEnableConditionId=13
        completed: DemEnableConditionId=11
        Start: DemEnableConditionId=7
      EnableConditionGroup_f70a9d46 (DemEnableConditionGroup):
        DemEnableConditionRef = HUT
        DemEnableConditionRef = HUT
        DemEnableConditionRef = IP
        DemEnableConditionRef = STATE_NORMAL
        DemEnableConditionRef = Start
        DemEnableConditionRef = completed
        DemEnableConditionRef = in
        DemEnableConditionRef = is
        DemEnableConditionRef = is
        DemEnableConditionRef = is
        DemEnableConditionRef = online
        DemEnableConditionRef = sequence
        DemEnableConditionRef = up
      EnableConditionGroup_3e8e3f33 (DemEnableConditionGroup):
        DemEnableConditionRef = HUT
        DemEnableConditionRef = HUT
        DemEnableConditionRef = No
        DemEnableConditionRef = STATE_NORMAL
        DemEnableConditionRef = Start
        DemEnableConditionRef = completed
        DemEnableConditionRef = display
        DemEnableConditionRef = fault
        DemEnableConditionRef = in
        DemEnableConditionRef = is
        DemEnableConditionRef = is
        DemEnableConditionRef = power
        DemEnableConditionRef = sequence
        DemEnableConditionRef = supply
        DemEnableConditionRef = up
      China (DemEnableCondition): DemEnableConditionId=1, DemEnableConditionStatus=true
      EnableConditionGroup_ce4d85f8 (DemEnableConditionGroup):
        DemEnableConditionRef = HUT
        DemEnableConditionRef = HUT
        DemEnableConditionRef = No
        DemEnableConditionRef = STATE_NORMAL
        DemEnableConditionRef = Start
        DemEnableConditionRef = completed
        DemEnableConditionRef = diagnostic
        DemEnableConditionRef = fault
        DemEnableConditionRef = in
        DemEnableConditionRef = is
        DemEnableConditionRef = is
        DemEnableConditionRef = sequence
        DemEnableConditionRef = up
        DemEnableConditionRef = voltage
      DID_0xf414 (DemDidClass): DemDidIdentifier=62484, DemDidDataClassRef=PID_0x14_DID_Data
      online (DemEnableCondition): DemEnableConditionId=17, DemEnableConditionStatus=true
      10 x DemNvRamBlockId:
        Dem_AdminData: DemNvRamBlockIdType=DEM_NVBLOCK_ADMIN, DemNvRamBlockIdRef=DemAdminDataBlock
        Dem_StatusData: DemNvRamBlockIdType=DEM_NVBLOCK_STATUS, DemNvRamBlockIdRef=DemStatusDataBlock
        Dem_PrimaryEntry{0..7}: DemNvRamBlockIdType=DEM_NVBLOCK_PRIMARY, DemNvRamBlockIdIndex={0..7}, DemNvRamBlockIdRef=DemPrimaryDataBlock{0..7}
      DemClient: DemClientId=0
      DemDataElementClass_StartApplication (DemDataClass): DemDataElementDataSize=2, DemDataElementStoreNonVolatile=true, DemDataElementUsePort=USE_DATA_CLIENT_SERVER_PORT
      DemDidClass_StartApplication (DemDidClass): DemDidIdentifier=85, DemDidDataClassRef=DemDataElementClass_StartApplication
      DemFreezeFrameClass_StartApplication (DemFreezeFrameClass): DemDidClassRef=DemDidClass_StartApplication
