[part 4 of 5: package /ActiveEcuC]
AUTOSAR XML (schema 4-2-1)
package /ActiveEcuC  (continued)
  module config Dcm: implementation-config-variant=VARIANT-PRE-COMPILE, module-description=Dcm_Impl
    DcmConfigSet
      DcmDsl
        DcmDslProtocol
          DcmDslProtocolRow_29812fbf (DcmDslProtocolRow):
            DcmDslProtocolEndiannessConvEnabled = false
            DcmDslProtocolID = DCM_UDS_ON_CAN
            DcmDslProtocolIsParallelExecutab = false
            DcmDslProtocolPreemptTimeout = 0
            DcmDslProtocolPriority = 0
            DcmSendRespPendOnTransToBoot = true
            DcmTimStrP2ServerAdjust = 0
            DcmTimStrP2StarServerAdjust = 0
            DcmDslProtocolMaximumResponseSize = 4095
            DcmDslProtocolRxBufferID = DcmDslBuffer
            DcmDslProtocolSIDTable = DcmDsdServiceTable
            DcmDslProtocolTxBufferID = DcmDslBuffer
            DcmDemClientRef = DemClient
            DC_0xE001_oMyECU_oCAN_9c85e87b (DcmDslConnection)
              DcmDslMainConnection: DcmDslProtocolRxTesterSourceAddr=224, DcmDslPeriodicTranmissionConRef=DcmDslPeriodicTransmission
                msg_diag_Request_MyECU_oCAN_cd2e72ff_Rx_db217017 (DcmDslProtocolRx):
                  DcmDslProtocolRxAddrType = DCM_PHYSICAL_TYPE
                  DcmDslProtocolRxPduId = 1
                  DcmDslProtocolRxChannelId = 0
                  DcmDslProtocolRxComMChannelRef = ComMConfigSet/CN_CAN_fe6ecc87
                  DcmDslProtocolRxPduRef = msg_diag_Request_MyECU_oCAN_cd2e72ff_Rx
                msg_diag_Response_MyECU_oCAN_06426912_Tx_5d336398 (DcmDslProtocolTx): DcmDslTxConfirmationPduId=1, DcmDslProtocolTxPduRef=EcucPduCollection/msg_diag_Response_MyECU_oCAN_06426912_Tx
                msg_diag_RequestGlobal_oCAN_2eba11fb_Rx_1026d879 (DcmDslProtocolRx):
                  DcmDslProtocolRxAddrType = DCM_FUNCTIONAL_TYPE
                  DcmDslProtocolRxPduId = 0
                  DcmDslProtocolRxChannelId = 0
                  DcmDslProtocolRxComMChannelRef = ComMConfigSet/CN_CAN_fe6ecc87
                  DcmDslProtocolRxPduRef = msg_diag_RequestGlobal_oCAN_2eba11fb_Rx
            DcmDslConnection
              DcmDslPeriodicTransmission: DcmDslPeriodicTxConfirmationTimeout=0.1
                DcmDslPeriodicConnection: DcmDslPeriodicTxConfirmationPduId=0, DcmDslPeriodicTxPduRef=EcucPduCollection/msg_diag_Uudt_Response_MyECU_oCAN_f130d337_Tx
        DcmDslDiagResp: DcmDslDiagRespMaxNumRespPend=0, DcmDslDiagRespOnSecondDeclinedRequest=false, DcmDslDiagRespMaxNumOfDeclinedRequests=3
        DcmDslBuffer: DcmDslBufferSize=53
      DcmGeneral:
        DcmDevErrorDetect = true
        DcmRequestManufacturerNotificationEnabled = false
        DcmRequestSupplierNotificationEnabled = false
        DcmRespondAllRequest = true
        DcmTaskTime = 0.01
        DcmVersionInfoApi = false
        DcmDspDataDefaultEndianness = LITTLE_ENDIAN
        DcmSafeBswChecks = false
        DcmSupportedIDCalculationSuppressionEnabled = false
        DcmDtrDataProvisionViaDemEnabled = true
        DcmForeignDiagnosticRequestDetectionEnabled = false
        DcmSuppressResponseOnCanTpFuncMixedAddrRequests = false
        DcmSenderReceiverPRPortsEnabled = false
      DcmDsd
        DcmDsdServiceTable
          13 x DcmDsdService:
            ClearDiagInfo: DcmDsdSidTabServiceId=20, DcmDsdSidTabSubfuncAvail=false
            EcuReset: DcmDsdSidTabServiceId=17, DcmDsdSidTabSubfuncAvail=true
              Soft (DcmDsdSubService): DcmDsdSubServiceId=3
              Hard (DcmDsdSubService): DcmDsdSubServiceId=1
            ControlDtcSetting: DcmDsdSidTabServiceId=133, DcmDsdSidTabSubfuncAvail=true, DcmDsdSidTabSessionLevelRef=DcmDspSession/Extended
              Disable (DcmDsdSubService): DcmDsdSubServiceId=2, DcmDsdSubServiceSessionLevelRef=DcmDspSession/Extended
              Enable (DcmDsdSubService): DcmDsdSubServiceId=1, DcmDsdSubServiceSessionLevelRef=DcmDspSession/Extended
            WriteDataById: DcmDsdSidTabServiceId=46, DcmDsdSidTabSubfuncAvail=false
            ReadDataById: DcmDsdSidTabServiceId=34, DcmDsdSidTabSubfuncAvail=false
            SecurityAccess: DcmDsdSidTabServiceId=39, DcmDsdSidTabSubfuncAvail=true, DcmDsdSidTabSessionLevelRef=DcmDspSession/Extended
              SeedLevel1_Request (DcmDsdSubService): DcmDsdSubServiceId=1, DcmDsdSubServiceSessionLevelRef=DcmDspSession/Extended
              KeyLevel1_Send (DcmDsdSubService): DcmDsdSubServiceId=2, DcmDsdSubServiceSessionLevelRef=DcmDspSession/Extended
            ReadMemoryByAddress: DcmDsdSidTabServiceId=35, DcmDsdSidTabSubfuncAvail=false
            ReadDtcInfo: DcmDsdSidTabServiceId=25, DcmDsdSidTabSubfuncAvail=true
              5 x DcmDsdSubService:
                RDTCEDRBDN: DcmDsdSubServiceId=6
                RSUPDTC: DcmDsdSubServiceId=10
                RDTCBSM: DcmDsdSubServiceId=2
                RNODTCBSM: DcmDsdSubServiceId=1
                RDTCSSBDTC: DcmDsdSubServiceId=4
            TesterPresent: DcmDsdSidTabServiceId=62, DcmDsdSidTabSubfuncAvail=true
              TesterPresent (DcmDsdSubService): DcmDsdSubServiceId=0
            WriteMemoryByAddress: DcmDsdSidTabServiceId=61, DcmDsdSidTabSubfuncAvail=false
            CommunicationControl: DcmDsdSidTabServiceId=40, DcmDsdSidTabSubfuncAvail=true, DcmDsdSidTabSessionLevelRef=DcmDspSession/Extended
              DisableRxAndTx (DcmDsdSubService): DcmDsdSubServiceId=3, DcmDsdSubServiceSessionLevelRef=DcmDspSession/Extended
              EnableRxAndTx (DcmDsdSubService): DcmDsdSubServiceId=0, DcmDsdSubServiceSessionLevelRef=DcmDspSession/Extended
            RoutineControl: DcmDsdSidTabServiceId=49, DcmDsdSidTabSubfuncAvail=true, DcmDsdSidTabSessionLevelRef=DcmDspSession/Extended, DcmDsdSidTabSecurityLevelRef=UnlockedL1
            DiagSessionControl: DcmDsdSidTabServiceId=16, DcmDsdSidTabSubfuncAvail=true
              Default (DcmDsdSubService): DcmDsdSubServiceId=1
              Extended (DcmDsdSubService): DcmDsdSubServiceId=3
      DcmDsp: DcmDspMaxDidToRead=5, DcmDspReadDIDReportsNODIByte=false
        DidInfo_Select_Speaker_Test_Tone_FD34 (DcmDspDidInfo)
          DcmDspDidAccess
            DcmDspDidWrite
        DataInfo_AME_Input_Output_OnOff_control_FD18_OnOffModule (DcmDspDataInfo): DcmDspDataFixedLength=true
        Select_Speaker_Test_Tone_FD34_Select_tone (DcmDspData):
          DcmDspDataSize = 8
          DcmDspDataType = UINT8
          DcmDspDataUsePort = USE_DATA_ASYNCH_CLIENT_SERVER
          DcmDspDataInfoRef = DataInfo_Select_Speaker_Test_Tone_FD34_Select_tone
        RoutineInfo_HUT_self_check (DcmDspRoutineInfo)
          DcmDspRoutineAuthorization: DcmDspRoutineSessionRef=DcmDspSession/Extended, DcmDspRoutineSecurityLevelRef=UnlockedL1
        Support_AM_frequency_Min_E00D_Support_AM_frequency_Min (DcmDspData):
          DcmDspDataSize = 32
          DcmDspDataType = UINT32
          DcmDspDataUsePort = USE_DATA_ASYNCH_CLIENT_SERVER
          DcmDspDataInfoRef = DataInfo_Support_AM_frequency_Min_E00D_Support_AM_frequency_Min
        DidInfo_AME_BT_Auto_Pairing_FD63 (DcmDspDidInfo)
          DcmDspDidAccess
            DcmDspDidWrite
        AME_Read_system_voltage_FD14_CombinedDataElement (DcmDspData):
          DcmDspDataSize = 16
          DcmDspDataType = UINT8_N
          DcmDspDataUsePort = USE_DATA_ASYNCH_CLIENT_SERVER
          DcmDspDataInfoRef = DataInfo_AME_Read_system_voltage_FD14_CombinedDataElement
        DataInfo_Support_AM_frequency_Max_E00E_Support_AM_frequency_Max (DcmDspDataInfo): DcmDspDataFixedLength=true
        Tbox_IP_Address_E016_Tbox_IP_Address (DcmDspData):
          DcmDspDataSize = 128
          DcmDspDataType = UINT8_N
          DcmDspDataUsePort = USE_DATA_ASYNCH_CLIENT_SERVER
          DcmDspDataInfoRef = DataInfo_Tbox_IP_Address_E016_Tbox_IP_Address
        DataInfo_Operating_Voltage_Value_D003_Operating_Voltage_Value (DcmDspDataInfo): DcmDspDataFixedLength=true
        3 x DcmDspDidInfo:
          DidInfo_Support_FM_frequency_Max_E010
            DcmDspDidAccess
              DcmDspDidRead
          DidInfo_AME_Read_Head_Unit_Connector_Status_FD90
            DcmDspDidAccess
              DcmDspDidRead
          DidInfo_BT_Power_Class_E007
            DcmDspDidAccess
              DcmDspDidRead
        Vehicle_Speed_D001 (DcmDspDid): DcmDspDidIdentifier=53249, DcmDspDidUsed=true, DcmDspDidUsePort=USE_DATA_ELEMENT_SPECIFIC_INTERFACES, DcmDspDidInfoRef=DidInfo_Vehicle_Speed_D001
          Vehicle_Speed (DcmDspDidSignal): DcmDspDidDataPos=0, DcmDspDidDataRef=Vehicle_Speed_D001_Vehicle_Speed
        Telematics_Module_Status_E01A (DcmDspDid):
          DcmDspDidIdentifier = 57370
          DcmDspDidUsed = true
          DcmDspDidUsePort = USE_DATA_ELEMENT_SPECIFIC_INTERFACES
          DcmDspDidInfoRef = DidInfo_Telematics_Module_Status_E01A
          Telematics_Module_Status (DcmDspDidSignal): DcmDspDidDataPos=0, DcmDspDidDataRef=Telematics_Module_Status_E01A_Telematics_Module_Status
        DataInfo_AME_Read_system_temperature_FD13_CombinedDataElement (DcmDspDataInfo): DcmDspDataFixedLength=true
        DataInfo_Currently_connected_USB_Type_E00C_Currently_connected_USB_Type (DcmDspDataInfo): DcmDspDataFixedLength=true
        DidInfo_AME_Route_Video_To_HMI_FD37 (DcmDspDidInfo)
          DcmDspDidAccess
            DcmDspDidWrite
        DataInfo_Vehicle_Identification_Number_F190_VIN (DcmDspDataInfo): DcmDspDataFixedLength=true
        AME_Route_MIC_To_Internal_Speaker_FD36_Control (DcmDspData):
          DcmDspDataSize = 8
          DcmDspDataType = UINT8
          DcmDspDataUsePort = USE_DATA_ASYNCH_CLIENT_SERVER
          DcmDspDataInfoRef = DataInfo_AME_Route_MIC_To_Internal_Speaker_FD36_Control
        DataInfo_AME_Play_BT_Audio_Control_FD64_Reserved_Byte (DcmDspDataInfo): DcmDspDataFixedLength=true
        AME_Read_Head_Unit_Connector_Status_FD90_CombinedDataElement (DcmDspData):
          DcmDspDataSize = 16
          DcmDspDataType = UINT8_N
          DcmDspDataUsePort = USE_DATA_ASYNCH_CLIENT_SERVER
          DcmDspDataInfoRef = DataInfo_AME_Read_Head_Unit_Connector_Status_FD90_CombinedDataElement
        Audio_jack_status_E00A_Audio_jack_status (DcmDspData):
          DcmDspDataSize = 8
          DcmDspDataType = UINT8
          DcmDspDataUsePort = USE_DATA_ASYNCH_CLIENT_SERVER
          DcmDspDataInfoRef = DataInfo_Audio_jack_status_E00A_Audio_jack_status
        DidInfo_AME_Switch_Source_FD40 (DcmDspDidInfo)
          DcmDspDidAccess
            DcmDspDidWrite
        DataInfo_Number_of_external_USB_devices_plugged_E00B_Number_of_external_USB_devices_plugged (DcmDspDataInfo): DcmDspDataFixedLength=true
        DataInfo_AME_Read_GYRO_Status_FD71_GYRO_Status (DcmDspDataInfo): DcmDspDataFixedLength=true
        DidInfo_Currently_connected_USB_Type_E00C (DcmDspDidInfo)
          DcmDspDidAccess
            DcmDspDidRead
        Wi_Fi_Module_Status_E013 (DcmDspDid):
          DcmDspDidIdentifier = 57363
          DcmDspDidUsed = true
          DcmDspDidUsePort = USE_DATA_ELEMENT_SPECIFIC_INTERFACES
          DcmDspDidInfoRef = DidInfo_Wi_Fi_Module_Status_E013
          Wi_Fi_Module_Status (DcmDspDidSignal): DcmDspDidDataPos=0, DcmDspDidDataRef=Wi_Fi_Module_Status_E013_Wi_Fi_Module_Status
        AME_Read_GPS_Info_FD72_Number_of_visible_staellite (DcmDspData):
          DcmDspDataSize = 8
          DcmDspDataType = UINT8
          DcmDspDataUsePort = USE_DATA_ASYNCH_CLIENT_SERVER
          DcmDspDataInfoRef = DataInfo_AME_Read_GPS_Info_FD72_Number_of_visible_staellite
        AME_Input_Output_OnOff_control_FD18_OnOffValue (DcmDspData):
          DcmDspDataSize = 8
          DcmDspDataType = UINT8
          DcmDspDataUsePort = USE_DATA_ASYNCH_CLIENT_SERVER
          DcmDspDataInfoRef = DataInfo_AME_Input_Output_OnOff_control_FD18_OnOffValue
        BT_firmware_version_E009 (DcmDspDid):
          DcmDspDidIdentifier = 57353
          DcmDspDidUsed = true
          DcmDspDidUsePort = USE_DATA_ELEMENT_SPECIFIC_INTERFACES
          DcmDspDidInfoRef = DidInfo_BT_firmware_version_E009
          BT_firmware_version (DcmDspDidSignal): DcmDspDidDataPos=0, DcmDspDidDataRef=BT_firmware_version_E009_BT_firmware_version
        DidInfo_AME_Skip_welcome_confirm_FD20 (DcmDspDidInfo)
          DcmDspDidAccess
            DcmDspDidWrite
        AME_Set_Volume_FD30_Set_Volume (DcmDspData): DcmDspDataSize=8, DcmDspDataType=UINT8, DcmDspDataUsePort=USE_DATA_ASYNCH_CLIENT_SERVER, DcmDspDataInfoRef=DataInfo_AME_Set_Volume_FD30_Set_Volume
        BT_active_profile_list_E008 (DcmDspDid):
          DcmDspDidIdentifier = 57352
          DcmDspDidUsed = true
          DcmDspDidUsePort = USE_DATA_ELEMENT_SPECIFIC_INTERFACES
          DcmDspDidInfoRef = DidInfo_BT_active_profile_list_E008
          BT_active_profile_list (DcmDspDidSignal): DcmDspDidDataPos=0, DcmDspDidDataRef=BT_active_profile_list_E008_BT_active_profile_list
        DataInfo_Wi_Fi_Module_Status_E013_Wi_Fi_Module_Status (DcmDspDataInfo): DcmDspDataFixedLength=true
        DataInfo_AME_Read_AME_diagnostic_version_FD08_CombinedDataElement (DcmDspDataInfo): DcmDspDataFixedLength=false
        DidInfo_Tbox_Gateway_sub_mask_E017 (DcmDspDidInfo)
          DcmDspDidAccess
            DcmDspDidRead
        AME_Skip_welcome_confirm_FD20_Reserved_Byte (DcmDspData):
          DcmDspDataSize = 8
          DcmDspDataType = UINT8
          DcmDspDataUsePort = USE_DATA_ASYNCH_CLIENT_SERVER
          DcmDspDataInfoRef = DataInfo_AME_Skip_welcome_confirm_FD20_Reserved_Byte
        DidInfo_AME_BT_Handfree_Loopback_Test_FD6B (DcmDspDidInfo)
          DcmDspDidAccess
            DcmDspDidWrite
        Vehicle_Identification_Number_F190 (DcmDspDid):
          DcmDspDidIdentifier = 61840
          DcmDspDidUsed = true
          DcmDspDidUsePort = USE_DATA_ELEMENT_SPECIFIC_INTERFACES
          DcmDspDidInfoRef = DidInfo_Vehicle_Identification_Number_F190
          VIN (DcmDspDidSignal): DcmDspDidDataPos=0, DcmDspDidDataRef=Vehicle_Identification_Number_F190_VIN
        DataInfo_AME_BT_Auto_Pairing_FD63_BT_Chip (DcmDspDataInfo): DcmDspDataFixedLength=true
        DcmDspSecurity
          UnlockedL1 (DcmDspSecurityRow):
            DcmDspSecurityDelayTime = 10
            DcmDspSecurityDelayTimeOnBoot = 0
            DcmDspSecurityKeySize = 4
            DcmDspSecurityLevel = 1
            DcmDspSecurityNumAttDelay = 3
            DcmDspSecuritySeedSize = 4
            DcmDspSecurityAttemptCounterEnabled = false
            DcmDspSecurityUsePort = USE_ASYNCH_CLIENT_SERVER
          Locked (DcmDspSecurityRow):
            DcmDspSecurityLevel = 0
            DcmDspSecurityAttemptCounterEnabled = false
            DcmDspSecurityDelayTime = 0
            DcmDspSecurityDelayTimeOnBoot = 0
            DcmDspSecurityKeySize = 4
            DcmDspSecurityNumAttDelay = 0
            DcmDspSecuritySeedSize = 4
            DcmDspSecurityUsePort = USE_ASYNCH_CLIENT_SERVER
        AME_Ethernet_IP_Ping_Function_FD6E_Ethernet_Channel (DcmDspData):
          DcmDspDataSize = 8
          DcmDspDataType = UINT8
          DcmDspDataUsePort = USE_DATA_ASYNCH_CLIENT_SERVER
          DcmDspDataInfoRef = DataInfo_AME_Ethernet_IP_Ping_Function_FD6E_Ethernet_Channel
        AME_Read_SW_and_HW_Version_FD04 (DcmDspDid):
          DcmDspDidIdentifier = 64772
          DcmDspDidUsed = true
          DcmDspDidUsePort = USE_DATA_ELEMENT_SPECIFIC_INTERFACES
          DcmDspDidInfoRef = DidInfo_AME_Read_SW_and_HW_Version_FD04
          CombinedDataElement (DcmDspDidSignal): DcmDspDidDataPos=0, DcmDspDidDataRef=AME_Read_SW_and_HW_Version_FD04_CombinedDataElement
        DataInfo_AME_Set_HMI_Language_FD21_Set_HMI_Language (DcmDspDataInfo): DcmDspDataFixedLength=true
        DidInfo_Tbox_geographical_coordinates_when_connection_lost_E019 (DcmDspDidInfo)
          DcmDspDidAccess
            DcmDspDidRead
        AME_Skip_welcome_confirm_FD20 (DcmDspDid):
          DcmDspDidIdentifier = 64800
          DcmDspDidUsed = true
          DcmDspDidUsePort = USE_DATA_ELEMENT_SPECIFIC_INTERFACES
          DcmDspDidInfoRef = DidInfo_AME_Skip_welcome_confirm_FD20
          Reserved_Byte (DcmDspDidSignal): DcmDspDidDataPos=0, DcmDspDidDataRef=AME_Skip_welcome_confirm_FD20_Reserved_Byte
        AME_Read_harman_manufactory_part_number_FD06_Harman_Manufactory_Part_Number (DcmDspData):
          DcmDspDataSize = 224
          DcmDspDataType = UINT8_N
          DcmDspDataUsePort = USE_DATA_ASYNCH_CLIENT_SERVER
          DcmDspDataInfoRef = DataInfo_AME_Read_harman_manufactory_part_number_FD06_Harman_Manufactory_Part_Number
        DataInfo_BT_Power_Class_E007_BT_Power_Class (DcmDspDataInfo): DcmDspDataFixedLength=true
        DidInfo_Screen_resolution_E002 (DcmDspDidInfo)
          DcmDspDidAccess
            DcmDspDidRead
        Telematics_Module_Status_E01A_Telematics_Module_Status (DcmDspData):
          DcmDspDataSize = 8
          DcmDspDataType = UINT8
          DcmDspDataUsePort = USE_DATA_ASYNCH_CLIENT_SERVER
          DcmDspDataInfoRef = DataInfo_Telematics_Module_Status_E01A_Telematics_Module_Status
        Select_Speaker_Test_Tone_FD34 (DcmDspDid):
          DcmDspDidIdentifier = 64820
          DcmDspDidUsed = true
          DcmDspDidUsePort = USE_DATA_ELEMENT_SPECIFIC_INTERFACES
          DcmDspDidInfoRef = DidInfo_Select_Speaker_Test_Tone_FD34
          Select_tone (DcmDspDidSignal): DcmDspDidDataPos=0, DcmDspDidDataRef=Select_Speaker_Test_Tone_FD34_Select_tone
        3 x DcmDspDidInfo:
          DidInfo_Telematics_Module_Status_E01A
            DcmDspDidAccess
              DcmDspDidRead
          DidInfo_AME_Write_harman_manufactory_part_number_FD07
            DcmDspDidAccess
              DcmDspDidWrite
          DidInfo_Number_of_installed_cameras_E001
            DcmDspDidAccess
              DcmDspDidRead
        AME_Read_GPS_Info_FD72 (DcmDspDid):
          DcmDspDidIdentifier = 64882
          DcmDspDidUsed = true
          DcmDspDidUsePort = USE_DATA_ELEMENT_SPECIFIC_INTERFACES
          DcmDspDidInfoRef = DidInfo_AME_Read_GPS_Info_FD72
          3 x DcmDspDidSignal:
            Number_of_used_satellite: DcmDspDidDataPos=16, DcmDspDidDataRef=AME_Read_GPS_Info_FD72_Number_of_used_satellite
            Number_of_visible_staellite: DcmDspDidDataPos=0, DcmDspDidDataRef=AME_Read_GPS_Info_FD72_Number_of_visible_staellite
            Number_of_fix: DcmDspDidDataPos=8, DcmDspDidDataRef=AME_Read_GPS_Info_FD72_Number_of_fix
        DidInfo_Number_of_installed_speakers_E01C (DcmDspDidInfo)
          DcmDspDidAccess
            DcmDspDidRead
        System_Supplier_ECU_Hardware_Version_Number_F193_Hardware_Version_Number (DcmDspData):
          DcmDspDataSize = 128
          DcmDspDataType = UINT8_N
          DcmDspDataUsePort = USE_DATA_ASYNCH_CLIENT_SERVER
          DcmDspDataInfoRef = DataInfo_System_Supplier_ECU_Hardware_Version_Number_F193_Hardware_Version_Number
        DataInfo_BT_active_profile_list_E008_BT_active_profile_list (DcmDspDataInfo): DcmDspDataFixedLength=true
        DataInfo_AME_ReadGPSSNR_FD73_GPSSNR (DcmDspDataInfo): DcmDspDataFixedLength=true
        AME_Set_AM_Frequency_FD52 (DcmDspDid):
          DcmDspDidIdentifier = 64850
          DcmDspDidUsed = true
          DcmDspDidUsePort = USE_DATA_ELEMENT_SPECIFIC_INTERFACES
          DcmDspDidInfoRef = DidInfo_AME_Set_AM_Frequency_FD52
          AM_Frequency (DcmDspDidSignal): DcmDspDidDataPos=0, DcmDspDidDataRef=AME_Set_AM_Frequency_FD52_AM_Frequency
        DataInfo_Vehicle_Manufacture_Spare_Part_Number_F187_Vehicle_Manufacture_Spare_Part_Number (DcmDspDataInfo): DcmDspDataFixedLength=true
        DataInfo_Tbox_geographical_coordinates_when_connection_lost_E019_Tbox_geographical_coordinates_when_connection_lost (DcmDspDataInfo): DcmDspDataFixedLength=true
        DidInfo_Vehicle_Speed_D001 (DcmDspDidInfo)
          DcmDspDidAccess
            DcmDspDidRead
        AME_Power_Control_FD01 (DcmDspDid):
          DcmDspDidIdentifier = 64769
          DcmDspDidUsed = true
          DcmDspDidUsePort = USE_DATA_ELEMENT_SPECIFIC_INTERFACES
          DcmDspDidInfoRef = DidInfo_AME_Power_Control_FD01
          Power_Control (DcmDspDidSignal): DcmDspDidDataPos=0, DcmDspDidDataRef=AME_Power_Control_FD01_Power_Control
        DataInfo_AME_Connectivy_OnOff_Control_FD62_ON_OFF (DcmDspDataInfo): DcmDspDataFixedLength=true
        DidInfo_AME_Set_FAN_speed_FD12 (DcmDspDidInfo)
          DcmDspDidAccess
            DcmDspDidWrite
        DidInfo_AME_Switch_BIOS_Mode_FD02 (DcmDspDidInfo)
          DcmDspDidAccess
            DcmDspDidWrite
        DataInfo_AME_Read_GPS_Info_FD72_Number_of_fix (DcmDspDataInfo): DcmDspDataFixedLength=true
        DataInfo_AME_Set_Volume_FD30_Set_Volume (DcmDspDataInfo): DcmDspDataFixedLength=true
        AME_Set_Mute_Control_FD31 (DcmDspDid):
          DcmDspDidIdentifier = 64817
          DcmDspDidUsed = true
          DcmDspDidUsePort = USE_DATA_ELEMENT_SPECIFIC_INTERFACES
          DcmDspDidInfoRef = DidInfo_AME_Set_Mute_Control_FD31
          Set_Mute_Control (DcmDspDidSignal): DcmDspDidDataPos=0, DcmDspDidDataRef=AME_Set_Mute_Control_FD31_Set_Mute_Control
        DataInfo_AME_Route_Video_To_HMI_FD37_Route_Vedio_To_HMI (DcmDspDataInfo): DcmDspDataFixedLength=true
        DidInfo_AME_Read_GYRO_Status_FD71 (DcmDspDidInfo)
          DcmDspDidAccess
            DcmDspDidRead
        AME_Set_Volume_FD30 (DcmDspDid): DcmDspDidIdentifier=64816, DcmDspDidUsed=true, DcmDspDidUsePort=USE_DATA_ELEMENT_SPECIFIC_INTERFACES, DcmDspDidInfoRef=DidInfo_AME_Set_Volume_FD30
          Set_Volume (DcmDspDidSignal): DcmDspDidDataPos=0, DcmDspDidDataRef=AME_Set_Volume_FD30_Set_Volume
        3 x DcmDspData, all with DcmDspDataUsePort=USE_DATA_ASYNCH_CLIENT_SERVER:
          AME_Read_Detection_Input_Info_FD92_CombinedDataElement: DcmDspDataSize=16, DcmDspDataType=UINT8_N, DcmDspDataInfoRef=DataInfo_AME_Read_Detection_Input_Info_FD92_CombinedDataElement
          Support_AM_frequency_Max_E00E_Support_AM_frequency_Max: DcmDspDataSize=32, DcmDspDataType=UINT32, DcmDspDataInfoRef=DataInfo_Support_AM_frequency_Max_E00E_Support_AM_frequency_Max
          Number_of_external_USB_devices_plugged_E00B_Number_of_external_USB_devices_plugged: DcmDspDataSize=8, DcmDspDataType=UINT8, DcmDspDataInfoRef=DataInfo_Number_of_external_USB_devices_plugged_E00B_Number_of_external_USB_devices_plugged
        DidInfo_AME_Read_SW_and_HW_Version_FD04 (DcmDspDidInfo)
          DcmDspDidAccess
            DcmDspDidRead
        DidInfo_Wi_Fi_Module_Status_E013 (DcmDspDidInfo)
          DcmDspDidAccess
            DcmDspDidRead
        DataInfo_System_Supplier_ECU_Software_Version_Number_F195_Software_Version_Number (DcmDspDataInfo): DcmDspDataFixedLength=true
        AME_Read_AME_diagnostic_version_FD08_CombinedDataElement (DcmDspData):
          DcmDspDataSize = 136
          DcmDspDataType = UINT8_N
          DcmDspDataUsePort = USE_DATA_ASYNCH_CLIENT_SERVER
          DcmDspDataInfoRef = DataInfo_AME_Read_AME_diagnostic_version_FD08_CombinedDataElement
        DidInfo_AME_Reset_Factory_Mode_FD05 (DcmDspDidInfo)
          DcmDspDidAccess
            DcmDspDidWrite
        AME_Switch_BIOS_Mode_FD02_Switch_BIOS (DcmDspData):
          DcmDspDataSize = 8
          DcmDspDataType = UINT8
          DcmDspDataUsePort = USE_DATA_ASYNCH_CLIENT_SERVER
          DcmDspDataInfoRef = DataInfo_AME_Switch_BIOS_Mode_FD02_Switch_BIOS
        Audio_jack_status_E00A (DcmDspDid):
          DcmDspDidIdentifier = 57354
          DcmDspDidUsed = true
          DcmDspDidUsePort = USE_DATA_ELEMENT_SPECIFIC_INTERFACES
          DcmDspDidInfoRef = DidInfo_Audio_jack_status_E00A
          Audio_jack_status (DcmDspDidSignal): DcmDspDidDataPos=0, DcmDspDidDataRef=Audio_jack_status_E00A_Audio_jack_status
        AME_ReadGPSSNR_FD73 (DcmDspDid): DcmDspDidIdentifier=64883, DcmDspDidUsed=true, DcmDspDidUsePort=USE_DATA_ELEMENT_SPECIFIC_INTERFACES, DcmDspDidInfoRef=DidInfo_AME_ReadGPSSNR_FD73
          GPSSNR (DcmDspDidSignal): DcmDspDidDataPos=0, DcmDspDidDataRef=AME_ReadGPSSNR_FD73_GPSSNR
        3 x DcmDspDataInfo, all with DcmDspDataFixedLength=true:
          DataInfo_AME_Ethernet_IP_Ping_Function_FD6E_IPAddress_Byte1
          DataInfo_AME_Ethernet_IP_Ping_Function_FD6E_IPAddress_Byte3
          DataInfo_AME_Select_Audio_Buffer_Channel_Output_FD39_SelectAudioBufferChannelOutput
        DidInfo_Vehicle_Manufacture_Spare_Part_Number_F187 (DcmDspDidInfo)
          DcmDspDidAccess
            DcmDspDidRead
        Support_FM_frequency_Min_E00F (DcmDspDid):
          DcmDspDidIdentifier = 57359
          DcmDspDidUsed = true
          DcmDspDidUsePort = USE_DATA_ELEMENT_SPECIFIC_INTERFACES
          DcmDspDidInfoRef = DidInfo_Support_FM_frequency_Min_E00F
          Support_FM_frequency_Min (DcmDspDidSignal): DcmDspDidDataPos=0, DcmDspDidDataRef=Support_FM_frequency_Min_E00F_Support_FM_frequency_Min
        DataInfo_AME_Ethernet_IP_Ping_Function_FD6E_IPAddress_Byte2 (DcmDspDataInfo): DcmDspDataFixedLength=true
        Present_GPS_coordinates_shift_data_E003_GPS_coordinates (DcmDspData):
          DcmDspDataSize = 32
          DcmDspDataType = UINT32
          DcmDspDataUsePort = USE_DATA_ASYNCH_CLIENT_SERVER
          DcmDspDataInfoRef = DataInfo_Present_GPS_coordinates_shift_data_E003_GPS_coordinates
        DataInfo_AME_Power_Control_FD01_Power_Control (DcmDspDataInfo): DcmDspDataFixedLength=true
        DataInfo_Telematics_Module_Status_E01A_Telematics_Module_Status (DcmDspDataInfo): DcmDspDataFixedLength=true
        DidInfo_AME_Read_AME_diagnostic_version_FD08 (DcmDspDidInfo)
          DcmDspDidAccess
            DcmDspDidRead
        DataInfo_AME_Ethernet_IP_Ping_Function_FD6E_IPAddress_Byte4 (DcmDspDataInfo): DcmDspDataFixedLength=true
        DataInfo_Present_GPS_coordinates_shift_data_E003_GPS_coordinates (DcmDspDataInfo): DcmDspDataFixedLength=true
        AME_Display_Color_Bar_Control_FD38_Display_Color_Bar_Control (DcmDspData):
          DcmDspDataSize = 8
          DcmDspDataType = UINT8
          DcmDspDataUsePort = USE_DATA_ASYNCH_CLIENT_SERVER
          DcmDspDataInfoRef = DataInfo_AME_Display_Color_Bar_Control_FD38_Display_Color_Bar_Control
        Support_FM_frequency_Max_E010 (DcmDspDid):
          DcmDspDidIdentifier = 57360
          DcmDspDidUsed = true
          DcmDspDidUsePort = USE_DATA_ELEMENT_SPECIFIC_INTERFACES
          DcmDspDidInfoRef = DidInfo_Support_FM_frequency_Max_E010
          Support_FM_frequency_Max (DcmDspDidSignal): DcmDspDidDataPos=0, DcmDspDidDataRef=Support_FM_frequency_Max_E010_Support_FM_frequency_Max
        Set_debug_on_off_control_FDF0_CombinedDataElement (DcmDspData):
          DcmDspDataSize = 16
          DcmDspDataType = UINT8_N
          DcmDspDataUsePort = USE_DATA_ASYNCH_CLIENT_SERVER
          DcmDspDataInfoRef = DataInfo_Set_debug_on_off_control_FDF0_CombinedDataElement
        DataInfo_AME_TrackMedia_Audio_Source_Play_FD41_TrackMedia_AudioSourcePlay (DcmDspDataInfo): DcmDspDataFixedLength=true
        DataInfo_System_Supplier_ECU_Hardware_Version_Number_F193_Hardware_Version_Number (DcmDspDataInfo): DcmDspDataFixedLength=true
        DidInfo_VehicleNetworkConfiguration_F1A1 (DcmDspDidInfo)
          DcmDspDidAccess
            DcmDspDidWrite: DcmDspDidWriteSessionRef=DcmDspSession/Extended, DcmDspDidWriteSecurityLevelRef=UnlockedL1
            DcmDspDidRead
        DataInfo_AME_Write_MAC_Address_FD61_A5 (DcmDspDataInfo): DcmDspDataFixedLength=true
        DataInfo_AME_Write_MAC_Address_FD61_A4 (DcmDspDataInfo): DcmDspDataFixedLength=true
        Number_of_installed_cameras_E001 (DcmDspDid):
          DcmDspDidIdentifier = 57345
          DcmDspDidUsed = true
          DcmDspDidUsePort = USE_DATA_ELEMENT_SPECIFIC_INTERFACES
          DcmDspDidInfoRef = DidInfo_Number_of_installed_cameras_E001
          Number_of_installed_cameras (DcmDspDidSignal): DcmDspDidDataPos=0, DcmDspDidDataRef=Number_of_installed_cameras_E001_Number_of_installed_cameras
        AME_Write_harman_manufactory_part_number_FD07 (DcmDspDid):
          DcmDspDidIdentifier = 64775
          DcmDspDidUsed = true
          DcmDspDidUsePort = USE_DATA_ELEMENT_SPECIFIC_INTERFACES
          DcmDspDidInfoRef = DidInfo_AME_Write_harman_manufactory_part_number_FD07
          Harman_Manufactory_Part_Number (DcmDspDidSignal): DcmDspDidDataPos=0, DcmDspDidDataRef=AME_Write_harman_manufactory_part_number_FD07_Harman_Manufactory_Part_Number
        DidInfo_BT_active_profile_list_E008 (DcmDspDidInfo)
          DcmDspDidAccess
            DcmDspDidRead
        DataInfo_Screen_resolution_E002_Width (DcmDspDataInfo): DcmDspDataFixedLength=true
        AME_Read_system_temperature_FD13 (DcmDspDid):
          DcmDspDidIdentifier = 64787
          DcmDspDidUsed = true
          DcmDspDidUsePort = USE_DATA_ELEMENT_SPECIFIC_INTERFACES
          DcmDspDidInfoRef = DidInfo_AME_Read_system_temperature_FD13
          CombinedDataElement (DcmDspDidSignal): DcmDspDidDataPos=0, DcmDspDidDataRef=AME_Read_system_temperature_FD13_CombinedDataElement
        DidInfo_Odometer_D004 (DcmDspDidInfo)
          DcmDspDidAccess
            DcmDspDidRead
        Currently_connected_USB_Type_E00C_Currently_connected_USB_Type (DcmDspData):
          DcmDspDataSize = 8
          DcmDspDataType = UINT8
          DcmDspDataUsePort = USE_DATA_ASYNCH_CLIENT_SERVER
          DcmDspDataInfoRef = DataInfo_Currently_connected_USB_Type_E00C_Currently_connected_USB_Type
        AME_Set_FAN_speed_FD12 (DcmDspDid):
          DcmDspDidIdentifier = 64786
          DcmDspDidUsed = true
          DcmDspDidUsePort = USE_DATA_ELEMENT_SPECIFIC_INTERFACES
          DcmDspDidInfoRef = DidInfo_AME_Set_FAN_speed_FD12
          FAN_Speed (DcmDspDidSignal): DcmDspDidDataPos=0, DcmDspDidDataRef=AME_Set_FAN_speed_FD12_FAN_Speed
        AME_Write_MAC_Address_FD61_A0 (DcmDspData): DcmDspDataSize=8, DcmDspDataType=UINT8, DcmDspDataUsePort=USE_DATA_ASYNCH_CLIENT_SERVER, DcmDspDataInfoRef=DataInfo_AME_Write_MAC_Address_FD61_A0
        System_Supplier_Identifier_F18A (DcmDspDid):
          DcmDspDidIdentifier = 61834
          DcmDspDidUsed = true
          DcmDspDidUsePort = USE_DATA_ELEMENT_SPECIFIC_INTERFACES
          DcmDspDidInfoRef = DidInfo_System_Supplier_Identifier_F18A
          System_Supplier_Identifier (DcmDspDidSignal): DcmDspDidDataPos=0, DcmDspDidDataRef=System_Supplier_Identifier_F18A_System_Supplier_Identifier
        DidInfo_System_Supplier_ECU_Software_Version_Number_F195 (DcmDspDidInfo)
          DcmDspDidAccess
            DcmDspDidRead
        DidInfo_Number_of_external_USB_devices_plugged_E00B (DcmDspDidInfo)
          DcmDspDidAccess
            DcmDspDidRead
        AME_Connectivy_OnOff_Control_FD62_ON_OFF (DcmDspData):
          DcmDspDataSize = 8
          DcmDspDataType = UINT8
          DcmDspDataUsePort = USE_DATA_ASYNCH_CLIENT_SERVER
          DcmDspDataInfoRef = DataInfo_AME_Connectivy_OnOff_Control_FD62_ON_OFF
        Operating_Voltage_Value_D003_Operating_Voltage_Value (DcmDspData):
          DcmDspDataSize = 8
          DcmDspDataType = UINT8
          DcmDspDataUsePort = USE_DATA_ASYNCH_CLIENT_SERVER
          DcmDspDataInfoRef = DataInfo_Operating_Voltage_Value_D003_Operating_Voltage_Value
        DidInfo_Bluetooth_Current_Discoverability_modes_E005 (DcmDspDidInfo)
          DcmDspDidAccess
            DcmDspDidRead
        AME_Route_MIC_To_Internal_Speaker_FD36 (DcmDspDid):
          DcmDspDidIdentifier = 64822
          DcmDspDidUsed = true
          DcmDspDidUsePort = USE_DATA_ELEMENT_SPECIFIC_INTERFACES
          DcmDspDidInfoRef = DidInfo_AME_Route_MIC_To_Internal_Speaker_FD36
          Control (DcmDspDidSignal): DcmDspDidDataPos=8, DcmDspDidDataRef=AME_Route_MIC_To_Internal_Speaker_FD36_Control
          Mic (DcmDspDidSignal): DcmDspDidDataPos=0, DcmDspDidDataRef=AME_Route_MIC_To_Internal_Speaker_FD36_Mic
        ECU_Serial_Number_F18C_ECU_Serial_Number (DcmDspData):
          DcmDspDataSize = 128
          DcmDspDataType = UINT8_N
          DcmDspDataUsePort = USE_DATA_ASYNCH_CLIENT_SERVER
          DcmDspDataInfoRef = DataInfo_ECU_Serial_Number_F18C_ECU_Serial_Number
        AME_Write_MAC_Address_FD61_A5 (DcmDspData): DcmDspDataSize=8, DcmDspDataType=UINT8, DcmDspDataUsePort=USE_DATA_ASYNCH_CLIENT_SERVER, DcmDspDataInfoRef=DataInfo_AME_Write_MAC_Address_FD61_A5
        Currently_connected_USB_Type_E00C (DcmDspDid):
          DcmDspDidIdentifier = 57356
          DcmDspDidUsed = true
          DcmDspDidUsePort = USE_DATA_ELEMENT_SPECIFIC_INTERFACES
          DcmDspDidInfoRef = DidInfo_Currently_connected_USB_Type_E00C
          Currently_connected_USB_Type (DcmDspDidSignal): DcmDspDidDataPos=0, DcmDspDidDataRef=Currently_connected_USB_Type_E00C_Currently_connected_USB_Type
        AME_Write_MAC_Address_FD61_A3 (DcmDspData): DcmDspDataSize=8, DcmDspDataType=UINT8, DcmDspDataUsePort=USE_DATA_ASYNCH_CLIENT_SERVER, DcmDspDataInfoRef=DataInfo_AME_Write_MAC_Address_FD61_A3
        DidInfo_Support_AM_frequency_Max_E00E (DcmDspDidInfo)
          DcmDspDidAccess
            DcmDspDidRead
        AME_Write_MAC_Address_FD61_A4 (DcmDspData): DcmDspDataSize=8, DcmDspDataType=UINT8, DcmDspDataUsePort=USE_DATA_ASYNCH_CLIENT_SERVER, DcmDspDataInfoRef=DataInfo_AME_Write_MAC_Address_FD61_A4
        AME_Write_MAC_Address_FD61_A1 (DcmDspData): DcmDspDataSize=8, DcmDspDataType=UINT8, DcmDspDataUsePort=USE_DATA_ASYNCH_CLIENT_SERVER, DcmDspDataInfoRef=DataInfo_AME_Write_MAC_Address_FD61_A1
        DidInfo_ECU_Serial_Number_F18C (DcmDspDidInfo)
          DcmDspDidAccess
            DcmDspDidWrite: DcmDspDidWriteSessionRef=DcmDspSession/Extended, DcmDspDidWriteSecurityLevelRef=UnlockedL1
            DcmDspDidRead
        AME_Write_MAC_Address_FD61_A2 (DcmDspData): DcmDspDataSize=8, DcmDspDataType=UINT8, DcmDspDataUsePort=USE_DATA_ASYNCH_CLIENT_SERVER, DcmDspDataInfoRef=DataInfo_AME_Write_MAC_Address_FD61_A2
        Bluetooth_Status_E006 (DcmDspDid):
          DcmDspDidIdentifier = 57350
          DcmDspDidUsed = true
          DcmDspDidUsePort = USE_DATA_ELEMENT_SPECIFIC_INTERFACES
          DcmDspDidInfoRef = DidInfo_Bluetooth_Status_E006
          Bluetooth_Status (DcmDspDidSignal): DcmDspDidDataPos=0, DcmDspDidDataRef=Bluetooth_Status_E006_Bluetooth_Status
        AME_Select_Audio_Buffer_Channel_Output_FD39 (DcmDspDid):
          DcmDspDidIdentifier = 64825
          DcmDspDidUsed = true
          DcmDspDidUsePort = USE_DATA_ELEMENT_SPECIFIC_INTERFACES
          DcmDspDidInfoRef = DidInfo_AME_Select_Audio_Buffer_Channel_Output_FD39
          SelectAudioBufferChannelOutput (DcmDspDidSignal): DcmDspDidDataPos=0, DcmDspDidDataRef=AME_Select_Audio_Buffer_Channel_Output_FD39_SelectAudioBufferChannelOutput
        System_Supplier_ECU_Software_Version_Number_F195_Software_Version_Number (DcmDspData):
          DcmDspDataSize = 128
          DcmDspDataType = UINT8_N
          DcmDspDataUsePort = USE_DATA_ASYNCH_CLIENT_SERVER
          DcmDspDataInfoRef = DataInfo_System_Supplier_ECU_Software_Version_Number_F195_Software_Version_Number
        DidInfo_AME_Read_harman_manufactory_part_number_FD06 (DcmDspDidInfo)
          DcmDspDidAccess
            DcmDspDidRead
        DataInfo_AME_Read_MAC_Address_FD60_CombinedDataElement (DcmDspDataInfo): DcmDspDataFixedLength=false
        AME_Read_system_temperature_FD13_CombinedDataElement (DcmDspData):
          DcmDspDataSize = 16
          DcmDspDataType = UINT8_N
          DcmDspDataUsePort = USE_DATA_ASYNCH_CLIENT_SERVER
          DcmDspDataInfoRef = DataInfo_AME_Read_system_temperature_FD13_CombinedDataElement
        DataInfo_AME_Set_External_Output_Status_FD93_HW (DcmDspDataInfo): DcmDspDataFixedLength=true
        AME_Set_External_Output_Status_FD93_HW (DcmDspData):
          DcmDspDataSize = 8
          DcmDspDataType = UINT8
          DcmDspDataUsePort = USE_DATA_ASYNCH_CLIENT_SERVER
          DcmDspDataInfoRef = DataInfo_AME_Set_External_Output_Status_FD93_HW
        AME_TrackMedia_Audio_Source_Play_FD41_TrackMedia_AudioSourcePlay (DcmDspData):
          DcmDspDataSize = 8
          DcmDspDataType = UINT8
          DcmDspDataUsePort = USE_DATA_ASYNCH_CLIENT_SERVER
          DcmDspDataInfoRef = DataInfo_AME_TrackMedia_Audio_Source_Play_FD41_TrackMedia_AudioSourcePlay
        DidInfo_AME_Set_WIFI_Mode_FD67 (DcmDspDidInfo)
          DcmDspDidAccess
            DcmDspDidWrite
        Switch_HU_boot_mode_FDF1_Boot_Mode (DcmDspData):
          DcmDspDataSize = 8
          DcmDspDataType = UINT8
          DcmDspDataUsePort = USE_DATA_ASYNCH_CLIENT_SERVER
          DcmDspDataInfoRef = DataInfo_Switch_HU_boot_mode_FDF1_Boot_Mode
        FM_signal_Strength_E012_FM_signal_Strength (DcmDspData):
          DcmDspDataSize = 8
          DcmDspDataType = UINT8
          DcmDspDataUsePort = USE_DATA_ASYNCH_CLIENT_SERVER
          DcmDspDataInfoRef = DataInfo_FM_signal_Strength_E012_FM_signal_Strength
        3 x DcmDspDataInfo, all with DcmDspDataFixedLength=true:
          DataInfo_AME_Write_MAC_Address_FD61_A1
          DataInfo_AME_Set_Mute_Control_FD31_Set_Mute_Control
          DataInfo_VehicleNetworkConfiguration_F1A1_VehicleNetworkConfiguration
        DidInfo_AME_Enter_NAV_Demo_Mode_FD70 (DcmDspDidInfo)
          DcmDspDidAccess
            DcmDspDidWrite
        AME_Route_Video_To_HMI_FD37 (DcmDspDid):
          DcmDspDidIdentifier = 64823
          DcmDspDidUsed = true
          DcmDspDidUsePort = USE_DATA_ELEMENT_SPECIFIC_INTERFACES
          DcmDspDidInfoRef = DidInfo_AME_Route_Video_To_HMI_FD37
          Route_Vedio_To_HMI (DcmDspDidSignal): DcmDspDidDataPos=0, DcmDspDidDataRef=AME_Route_Video_To_HMI_FD37_Route_Vedio_To_HMI
        DataInfo_AME_Write_MAC_Address_FD61_A0 (DcmDspDataInfo): DcmDspDataFixedLength=true
        AME_Connectivy_OnOff_Control_FD62_BT_WiFi (DcmDspData):
          DcmDspDataSize = 8
          DcmDspDataType = UINT8
          DcmDspDataUsePort = USE_DATA_ASYNCH_CLIENT_SERVER
          DcmDspDataInfoRef = DataInfo_AME_Connectivy_OnOff_Control_FD62_BT_WiFi
        DataInfo_AME_Write_MAC_Address_FD61_A3 (DcmDspDataInfo): DcmDspDataFixedLength=true
        DataInfo_AME_Write_MAC_Address_FD61_A2 (DcmDspDataInfo): DcmDspDataFixedLength=true
        FM_signal_Strength_E012 (DcmDspDid):
          DcmDspDidIdentifier = 57362
          DcmDspDidUsed = true
          DcmDspDidUsePort = USE_DATA_ELEMENT_SPECIFIC_INTERFACES
          DcmDspDidInfoRef = DidInfo_FM_signal_Strength_E012
          FM_signal_Strength (DcmDspDidSignal): DcmDspDidDataPos=0, DcmDspDidDataRef=FM_signal_Strength_E012_FM_signal_Strength
        AME_Switch_Source_FD40 (DcmDspDid):
          DcmDspDidIdentifier = 64832
          DcmDspDidUsed = true
          DcmDspDidUsePort = USE_DATA_ELEMENT_SPECIFIC_INTERFACES
          DcmDspDidInfoRef = DidInfo_AME_Switch_Source_FD40
          SelectAudioBufferChannelOutput (DcmDspDidSignal): DcmDspDidDataPos=0, DcmDspDidDataRef=AME_Switch_Source_FD40_SelectAudioBufferChannelOutput
        DidInfo_AME_Set_Mute_Control_FD31 (DcmDspDidInfo)
          DcmDspDidAccess
            DcmDspDidWrite
        AME_Read_GPS_Info_FD72_Number_of_fix (DcmDspData):
          DcmDspDataSize = 8
          DcmDspDataType = UINT8
          DcmDspDataUsePort = USE_DATA_ASYNCH_CLIENT_SERVER
          DcmDspDataInfoRef = DataInfo_AME_Read_GPS_Info_FD72_Number_of_fix
        DidInfo_AME_Input_Output_OnOff_control_FD18 (DcmDspDidInfo)
          DcmDspDidAccess
            DcmDspDidWrite
        DataInfo_C_matrix_Version_of_the_ECU_product_F1A2_C_matrix_Version (DcmDspDataInfo): DcmDspDataFixedLength=true
        AME_Mirror_Link_connection_FD6D (DcmDspDid):
          DcmDspDidIdentifier = 64877
          DcmDspDidUsed = true
          DcmDspDidUsePort = USE_DATA_ELEMENT_SPECIFIC_INTERFACES
          DcmDspDidInfoRef = DidInfo_AME_Mirror_Link_connection_FD6D
          Mirror_Link_connection (DcmDspDidSignal): DcmDspDidDataPos=0, DcmDspDidDataRef=AME_Mirror_Link_connection_FD6D_Mirror_Link_connection
        AM_signal_Strength_E011_AM_signal_Strength (DcmDspData):
          DcmDspDataSize = 8
          DcmDspDataType = UINT8
          DcmDspDataUsePort = USE_DATA_ASYNCH_CLIENT_SERVER
          DcmDspDataInfoRef = DataInfo_AM_signal_Strength_E011_AM_signal_Strength
        AME_BT_Auto_Pairing_FD63 (DcmDspDid):
          DcmDspDidIdentifier = 64867
          DcmDspDidUsed = true
          DcmDspDidUsePort = USE_DATA_ELEMENT_SPECIFIC_INTERFACES
          DcmDspDidInfoRef = DidInfo_AME_BT_Auto_Pairing_FD63
          BT_Chip (DcmDspDidSignal): DcmDspDidDataPos=0, DcmDspDidDataRef=AME_BT_Auto_Pairing_FD63_BT_Chip
          BT_MAC_Address (DcmDspDidSignal): DcmDspDidDataPos=8, DcmDspDidDataRef=AME_BT_Auto_Pairing_FD63_BT_MAC_Address
        DataInfo_AME_Set_External_Output_Status_FD93_Status (DcmDspDataInfo): DcmDspDataFixedLength=true
        DataInfo_Tbox_Gateway_sub_mask_E017_Tbox_Gateway_sub_mask (DcmDspDataInfo): DcmDspDataFixedLength=true
        Tbox_geographical_coordinates_when_connection_lost_E019_Tbox_geographical_coordinates_when_connection_lost (DcmDspData):
          DcmDspDataSize = 128
          DcmDspDataType = UINT8_N
          DcmDspDataUsePort = USE_DATA_ASYNCH_CLIENT_SERVER
          DcmDspDataInfoRef = DataInfo_Tbox_geographical_coordinates_when_connection_lost_E019_Tbox_geographical_coordinates_when_connection_lost
        DidInfo_AME_Display_Color_Bar_Control_FD38 (DcmDspDidInfo)
          DcmDspDidAccess
            DcmDspDidWrite
        Odometer_D004 (DcmDspDid): DcmDspDidIdentifier=53252, DcmDspDidUsed=true, DcmDspDidUsePort=USE_DATA_ELEMENT_SPECIFIC_INTERFACES, DcmDspDidInfoRef=DidInfo_Odometer_D004
          Odometer (DcmDspDidSignal): DcmDspDidDataPos=0, DcmDspDidDataRef=Odometer_D004_Odometer
        Wi_Fi_Module_Hardware_Part_Number_E015 (DcmDspDid):
          DcmDspDidIdentifier = 57365
          DcmDspDidUsed = true
          DcmDspDidUsePort = USE_DATA_ELEMENT_SPECIFIC_INTERFACES
          DcmDspDidInfoRef = DidInfo_Wi_Fi_Module_Hardware_Part_Number_E015
          Wi_Fi_Module_Hardware_Part_Number (DcmDspDidSignal): DcmDspDidDataPos=0, DcmDspDidDataRef=Wi_Fi_Module_Hardware_Part_Number_E015_Wi_Fi_Module_Hardware_Part_Number
        DataInfo_Wi_Fi_Module_Firmware_Version_E014_Wi_Fi_Module_Firmware_Version (DcmDspDataInfo): DcmDspDataFixedLength=true
        5 x DcmDspData, all with DcmDspDataUsePort=USE_DATA_ASYNCH_CLIENT_SERVER:
          AME_Set_FAN_speed_FD12_FAN_Speed: DcmDspDataSize=8, DcmDspDataType=UINT8, DcmDspDataInfoRef=DataInfo_AME_Set_FAN_speed_FD12_FAN_Speed
          Number_of_installed_speakers_E01C_Number_of_installed_speakers: DcmDspDataSize=8, DcmDspDataType=UINT8, DcmDspDataInfoRef=DataInfo_Number_of_installed_speakers_E01C_Number_of_installed_speakers
          AME_BT_Auto_Pairing_FD63_BT_MAC_Address: DcmDspDataSize=48, DcmDspDataType=UINT8_N, DcmDspDataInfoRef=DataInfo_AME_BT_Auto_Pairing_FD63_BT_MAC_Address
          AME_Set_FM_Frequency_FD50_FM_Frequency: DcmDspDataSize=24, DcmDspDataType=UINT8_N, DcmDspDataInfoRef=DataInfo_AME_Set_FM_Frequency_FD50_FM_Frequency
          AME_Switch_Source_FD40_SelectAudioBufferChannelOutput: DcmDspDataSize=8, DcmDspDataType=UINT8, DcmDspDataInfoRef=DataInfo_AME_Switch_Source_FD40_SelectAudioBufferChannelOutput
        AME_Display_Color_Bar_Control_FD38 (DcmDspDid):
          DcmDspDidIdentifier = 64824
          DcmDspDidUsed = true
          DcmDspDidUsePort = USE_DATA_ELEMENT_SPECIFIC_INTERFACES
          DcmDspDidInfoRef = DidInfo_AME_Display_Color_Bar_Control_FD38
          Display_Color_Bar_Control (DcmDspDidSignal): DcmDspDidDataPos=0, DcmDspDidDataRef=AME_Display_Color_Bar_Control_FD38_Display_Color_Bar_Control
        DidInfo_AME_Select_Audio_Buffer_Channel_Output_FD39 (DcmDspDidInfo)
          DcmDspDidAccess
            DcmDspDidWrite
        DidInfo_Engine_Speed_D002 (DcmDspDidInfo)
          DcmDspDidAccess
            DcmDspDidRead
        AME_Route_MIC_To_Internal_Speaker_FD36_Mic (DcmDspData):
          DcmDspDataSize = 8
          DcmDspDataType = UINT8
          DcmDspDataUsePort = USE_DATA_ASYNCH_CLIENT_SERVER
          DcmDspDataInfoRef = DataInfo_AME_Route_MIC_To_Internal_Speaker_FD36_Mic
        DidInfo_AME_TBOX_communication_status_check_FD80 (DcmDspDidInfo)
          DcmDspDidAccess
            DcmDspDidRead
        4 x DcmDspDid, all with DcmDspDidUsed=true, DcmDspDidUsePort=USE_DATA_ELEMENT_SPECIFIC_INTERFACES:
          AME_Enter_NAV_Demo_Mode_FD70: DcmDspDidIdentifier=64880, DcmDspDidInfoRef=DidInfo_AME_Enter_NAV_Demo_Mode_FD70
            INVALID_SHORTNAME_Demo_Mode (DcmDspDidSignal): DcmDspDidDataPos=0, DcmDspDidDataRef=AME_Enter_NAV_Demo_Mode_FD70_Demo_Mode
          Support_AM_frequency_Min_E00D: DcmDspDidIdentifier=57357, DcmDspDidInfoRef=DidInfo_Support_AM_frequency_Min_E00D
            Support_AM_frequency_Min (DcmDspDidSignal): DcmDspDidDataPos=0, DcmDspDidDataRef=Support_AM_frequency_Min_E00D_Support_AM_frequency_Min
          Bluetooth_Current_Discoverability_modes_E005: DcmDspDidIdentifier=57349, DcmDspDidInfoRef=DidInfo_Bluetooth_Current_Discoverability_modes_E005
            Bluetooth_Current_Discoverability_modes (DcmDspDidSignal): DcmDspDidDataPos=0, DcmDspDidDataRef=Bluetooth_Current_Discoverability_modes_E005_Bluetooth_Current_Discoverability_modes
          Number_of_external_USB_devices_plugged_E00B: DcmDspDidIdentifier=57355, DcmDspDidInfoRef=DidInfo_Number_of_external_USB_devices_plugged_E00B
            Number_of_external_USB_devices_plugged (DcmDspDidSignal): DcmDspDidDataPos=0, DcmDspDidDataRef=Number_of_external_USB_devices_plugged_E00B_Number_of_external_USB_devices_plugged
        DataInfo_AME_Skip_welcome_confirm_FD20_Reserved_Byte (DcmDspDataInfo): DcmDspDataFixedLength=true
        DidInfo_C_matrix_Version_of_the_ECU_product_F1A2 (DcmDspDidInfo)
          DcmDspDidAccess
            DcmDspDidRead
        DataInfo_Set_debug_on_off_control_FDF0_CombinedDataElement (DcmDspDataInfo): DcmDspDataFixedLength=false
        Screen_resolution_E002_Width (DcmDspData): DcmDspDataSize=16, DcmDspDataType=UINT16, DcmDspDataUsePort=USE_DATA_ASYNCH_CLIENT_SERVER, DcmDspDataInfoRef=DataInfo_Screen_resolution_E002_Width
        AME_Set_WIFI_Mode_FD67 (DcmDspDid):
          DcmDspDidIdentifier = 64871
          DcmDspDidUsed = true
          DcmDspDidUsePort = USE_DATA_ELEMENT_SPECIFIC_INTERFACES
          DcmDspDidInfoRef = DidInfo_AME_Set_WIFI_Mode_FD67
          WiFi_Mode (DcmDspDidSignal): DcmDspDidDataPos=0, DcmDspDidDataRef=AME_Set_WIFI_Mode_FD67_WiFi_Mode
        Wi_Fi_Module_Hardware_Part_Number_E015_Wi_Fi_Module_Hardware_Part_Number (DcmDspData):
          DcmDspDataSize = 128
          DcmDspDataType = UINT8_N
          DcmDspDataUsePort = USE_DATA_ASYNCH_CLIENT_SERVER
          DcmDspDataInfoRef = DataInfo_Wi_Fi_Module_Hardware_Part_Number_E015_Wi_Fi_Module_Hardware_Part_Number
        DataInfo_AME_Mirror_Link_connection_FD6D_Mirror_Link_connection (DcmDspDataInfo): DcmDspDataFixedLength=true
        BT_firmware_version_E009_BT_firmware_version (DcmDspData):
          DcmDspDataSize = 128
          DcmDspDataType = UINT8_N
          DcmDspDataUsePort = USE_DATA_ASYNCH_CLIENT_SERVER
          DcmDspDataInfoRef = DataInfo_BT_firmware_version_E009_BT_firmware_version
        ComControl (DcmDspComControl)
          DspComContolAllChannel (DcmDspComControlAllChannel): DcmDspAllComMChannelRef=ComMConfigSet/CN_CAN_fe6ecc87
        DidInfo_AME_Play_BT_Audio_Control_FD64 (DcmDspDidInfo)
          DcmDspDidAccess
            DcmDspDidWrite
        AME_Set_AM_Frequency_FD52_AM_Frequency (DcmDspData):
          DcmDspDataSize = 16
          DcmDspDataType = UINT16
          DcmDspDataUsePort = USE_DATA_ASYNCH_CLIENT_SERVER
          DcmDspDataInfoRef = DataInfo_AME_Set_AM_Frequency_FD52_AM_Frequency
        Support_AM_frequency_Max_E00E (DcmDspDid):
          DcmDspDidIdentifier = 57358
          DcmDspDidUsed = true
          DcmDspDidUsePort = USE_DATA_ELEMENT_SPECIFIC_INTERFACES
          DcmDspDidInfoRef = DidInfo_Support_AM_frequency_Max_E00E
          Support_AM_frequency_Max (DcmDspDidSignal): DcmDspDidDataPos=0, DcmDspDidDataRef=Support_AM_frequency_Max_E00E_Support_AM_frequency_Max
        Vehicle_Manufacture_Spare_Part_Number_F187_Vehicle_Manufacture_Spare_Part_Number (DcmDspData):
          DcmDspDataSize = 120
          DcmDspDataType = UINT8_N
          DcmDspDataUsePort = USE_DATA_ASYNCH_CLIENT_SERVER
          DcmDspDataInfoRef = DataInfo_Vehicle_Manufacture_Spare_Part_Number_F187_Vehicle_Manufacture_Spare_Part_Number
        DTC_Occurrence_Timer_D005_Occure_Time_Inforamation (DcmDspData):
          DcmDspDataSize = 32
          DcmDspDataType = UINT32
          DcmDspDataUsePort = USE_DATA_ASYNCH_CLIENT_SERVER
          DcmDspDataInfoRef = DataInfo_DTC_Occurrence_Timer_D005_Occure_Time_Inforamation
        DataInfo_Engine_Speed_D002_Engine_Speed (DcmDspDataInfo): DcmDspDataFixedLength=true
        Engine_Speed_D002_Engine_Speed (DcmDspData):
          DcmDspDataSize = 16
          DcmDspDataType = UINT16
          DcmDspDataUsePort = USE_DATA_ASYNCH_CLIENT_SERVER
          DcmDspDataInfoRef = DataInfo_Engine_Speed_D002_Engine_Speed
        AME_Select_Speaker_Zone_FD33_Select_Speaker_Zone (DcmDspData):
          DcmDspDataSize = 8
          DcmDspDataType = UINT8
          DcmDspDataUsePort = USE_DATA_ASYNCH_CLIENT_SERVER
          DcmDspDataInfoRef = DataInfo_AME_Select_Speaker_Zone_FD33_Select_Speaker_Zone
        DidInfo_AME_Write_MAC_Address_FD61 (DcmDspDidInfo)
          DcmDspDidAccess
            DcmDspDidWrite
        DidInfo_System_Supplier_Identifier_F18A (DcmDspDidInfo)
          DcmDspDidAccess
            DcmDspDidRead
        DataInfo_AME_BT_Handfree_Loopback_Test_FD6B_Reserved_Byte (DcmDspDataInfo): DcmDspDataFixedLength=true
        DataInfo_AME_Read_GPS_Info_FD72_Number_of_visible_staellite (DcmDspDataInfo): DcmDspDataFixedLength=true
        Vehicle_Manufacture_Spare_Part_Number_F187 (DcmDspDid):
          DcmDspDidIdentifier = 61831
          DcmDspDidUsed = true
          DcmDspDidUsePort = USE_DATA_ELEMENT_SPECIFIC_INTERFACES
          DcmDspDidInfoRef = DidInfo_Vehicle_Manufacture_Spare_Part_Number_F187
          Vehicle_Manufacture_Spare_Part_Number (DcmDspDidSignal): DcmDspDidDataPos=0, DcmDspDidDataRef=Vehicle_Manufacture_Spare_Part_Number_F187_Vehicle_Manufacture_Spare_Part_Number
        AME_TBOX_communication_status_check_FD80_TBOX_status (DcmDspData):
          DcmDspDataSize = 8
          DcmDspDataType = UINT8
          DcmDspDataUsePort = USE_DATA_ASYNCH_CLIENT_SERVER
          DcmDspDataInfoRef = DataInfo_AME_TBOX_communication_status_check_FD80_TBOX_status
        DataInfo_Support_AM_frequency_Min_E00D_Support_AM_frequency_Min (DcmDspDataInfo): DcmDspDataFixedLength=true
        DidInfo_AME_ReadGPSSNR_FD73 (DcmDspDidInfo)
          DcmDspDidAccess
            DcmDspDidRead
        DidInfo_Wi_Fi_Module_Firmware_Version_E014 (DcmDspDidInfo)
          DcmDspDidAccess
            DcmDspDidRead
        AME_BT_Handfree_Loopback_Test_FD6B (DcmDspDid):
          DcmDspDidIdentifier = 64875
          DcmDspDidUsed = true
          DcmDspDidUsePort = USE_DATA_ELEMENT_SPECIFIC_INTERFACES
          DcmDspDidInfoRef = DidInfo_AME_BT_Handfree_Loopback_Test_FD6B
          Reserved_Byte (DcmDspDidSignal): DcmDspDidDataPos=0, DcmDspDidDataRef=AME_BT_Handfree_Loopback_Test_FD6B_Reserved_Byte
        DidInfo_AME_Power_Control_FD01 (DcmDspDidInfo)
          DcmDspDidAccess
            DcmDspDidWrite
        Wi_Fi_Module_Status_E013_Wi_Fi_Module_Status (DcmDspData):
          DcmDspDataSize = 8
          DcmDspDataType = UINT8
          DcmDspDataUsePort = USE_DATA_ASYNCH_CLIENT_SERVER
          DcmDspDataInfoRef = DataInfo_Wi_Fi_Module_Status_E013_Wi_Fi_Module_Status
        DataInfo_BT_firmware_version_E009_BT_firmware_version (DcmDspDataInfo): DcmDspDataFixedLength=true
        AME_BT_Handfree_Loopback_Test_FD6B_Reserved_Byte (DcmDspData):
          DcmDspDataSize = 8
          DcmDspDataType = UINT8
          DcmDspDataUsePort = USE_DATA_ASYNCH_CLIENT_SERVER
          DcmDspDataInfoRef = DataInfo_AME_BT_Handfree_Loopback_Test_FD6B_Reserved_Byte
        3 x DcmDspDataInfo, all with DcmDspDataFixedLength=true:
          DataInfo_AME_Switch_BIOS_Mode_FD02_Switch_BIOS
          DataInfo_AME_Read_harman_manufactory_part_number_FD06_Harman_Manufactory_Part_Number
          DataInfo_Support_FM_frequency_Max_E010_Support_FM_frequency_Max
        DidInfo_AME_Ethernet_IP_Ping_Function_FD6E (DcmDspDidInfo)
          DcmDspDidAccess
            DcmDspDidWrite
        DataInfo_Bluetooth_Current_Discoverability_modes_E005_Bluetooth_Current_Discoverability_modes (DcmDspDataInfo): DcmDspDataFixedLength=true
        BT_Power_Class_E007_BT_Power_Class (DcmDspData):
          DcmDspDataSize = 8
          DcmDspDataType = UINT8
          DcmDspDataUsePort = USE_DATA_ASYNCH_CLIENT_SERVER
          DcmDspDataInfoRef = DataInfo_BT_Power_Class_E007_BT_Power_Class
        DidInfo_AME_Read_system_temperature_FD13 (DcmDspDidInfo)
          DcmDspDidAccess
            DcmDspDidRead
        AME_TrackMedia_Audio_Source_Play_FD41 (DcmDspDid):
          DcmDspDidIdentifier = 64833
          DcmDspDidUsed = true
          DcmDspDidUsePort = USE_DATA_ELEMENT_SPECIFIC_INTERFACES
          DcmDspDidInfoRef = DidInfo_AME_TrackMedia_Audio_Source_Play_FD41
          TrackMedia_AudioSourcePlay (DcmDspDidSignal): DcmDspDidDataPos=0, DcmDspDidDataRef=AME_TrackMedia_Audio_Source_Play_FD41_TrackMedia_AudioSourcePlay
        DataInfo_AME_BT_Auto_Pairing_FD63_BT_MAC_Address (DcmDspDataInfo): DcmDspDataFixedLength=true
        AME_Power_Control_FD01_Power_Control (DcmDspData):
          DcmDspDataSize = 8
          DcmDspDataType = UINT8
          DcmDspDataUsePort = USE_DATA_ASYNCH_CLIENT_SERVER
          DcmDspDataInfoRef = DataInfo_AME_Power_Control_FD01_Power_Control
        BT_Power_Class_E007 (DcmDspDid): DcmDspDidIdentifier=57351, DcmDspDidUsed=true, DcmDspDidUsePort=USE_DATA_ELEMENT_SPECIFIC_INTERFACES, DcmDspDidInfoRef=DidInfo_BT_Power_Class_E007
          BT_Power_Class (DcmDspDidSignal): DcmDspDidDataPos=0, DcmDspDidDataRef=BT_Power_Class_E007_BT_Power_Class
        AME_Set_FM_Frequency_FD50 (DcmDspDid):
          DcmDspDidIdentifier = 64848
          DcmDspDidUsed = true
          DcmDspDidUsePort = USE_DATA_ELEMENT_SPECIFIC_INTERFACES
          DcmDspDidInfoRef = DidInfo_AME_Set_FM_Frequency_FD50
          FM_Frequency (DcmDspDidSignal): DcmDspDidDataPos=0, DcmDspDidDataRef=AME_Set_FM_Frequency_FD50_FM_Frequency
        AME_Read_FAN_speed_FD11_FAN_Speed (DcmDspData):
          DcmDspDataSize = 8
          DcmDspDataType = UINT8
          DcmDspDataUsePort = USE_DATA_ASYNCH_CLIENT_SERVER
          DcmDspDataInfoRef = DataInfo_AME_Read_FAN_speed_FD11_FAN_Speed
        Set_debug_on_off_control_FDF0 (DcmDspDid):
          DcmDspDidIdentifier = 65008
          DcmDspDidUsed = true
          DcmDspDidUsePort = USE_DATA_ELEMENT_SPECIFIC_INTERFACES
          DcmDspDidInfoRef = DidInfo_Set_debug_on_off_control_FDF0
          CombinedDataElement (DcmDspDidSignal): DcmDspDidDataPos=0, DcmDspDidDataRef=Set_debug_on_off_control_FDF0_CombinedDataElement
        AME_ReadGPSSNR_FD73_GPSSNR (DcmDspData): DcmDspDataSize=8, DcmDspDataType=UINT8, DcmDspDataUsePort=USE_DATA_ASYNCH_CLIENT_SERVER, DcmDspDataInfoRef=DataInfo_AME_ReadGPSSNR_FD73_GPSSNR
        DidInfo_AME_Route_MIC_To_Internal_Speaker_FD36 (DcmDspDidInfo)
          DcmDspDidAccess
            DcmDspDidWrite
        DidInfo_Vehicle_Identification_Number_F190 (DcmDspDidInfo)
          DcmDspDidAccess
            DcmDspDidWrite: DcmDspDidWriteSessionRef=DcmDspSession/Extended, DcmDspDidWriteSecurityLevelRef=UnlockedL1
            DcmDspDidRead
        DataInfo_AM_signal_Strength_E011_AM_signal_Strength (DcmDspDataInfo): DcmDspDataFixedLength=true
        ECU_Serial_Number_F18C (DcmDspDid):
          DcmDspDidIdentifier = 61836
          DcmDspDidUsed = true
          DcmDspDidUsePort = USE_DATA_ELEMENT_SPECIFIC_INTERFACES
          DcmDspDidInfoRef = DidInfo_ECU_Serial_Number_F18C
          ECU_Serial_Number (DcmDspDidSignal): DcmDspDidDataPos=0, DcmDspDidDataRef=ECU_Serial_Number_F18C_ECU_Serial_Number
        DataInfo_AME_Read_FAN_speed_FD11_FAN_Speed (DcmDspDataInfo): DcmDspDataFixedLength=true
        DidInfo_AME_Read_Detection_Input_Info_FD92 (DcmDspDidInfo)
          DcmDspDidAccess
            DcmDspDidRead
        DataInfo_AME_Route_MIC_To_Internal_Speaker_FD36_Control (DcmDspDataInfo): DcmDspDataFixedLength=true
        System_Supplier_ECU_Hardware_Version_Number_F193 (DcmDspDid):
          DcmDspDidIdentifier = 61843
          DcmDspDidUsed = true
          DcmDspDidUsePort = USE_DATA_ELEMENT_SPECIFIC_INTERFACES
          DcmDspDidInfoRef = DidInfo_System_Supplier_ECU_Hardware_Version_Number_F193
          Hardware_Version_Number (DcmDspDidSignal): DcmDspDidDataPos=0, DcmDspDidDataRef=System_Supplier_ECU_Hardware_Version_Number_F193_Hardware_Version_Number
        Vehicle_Identification_Number_F190_VIN (DcmDspData):
          DcmDspDataSize = 136
          DcmDspDataType = UINT8_N
          DcmDspDataUsePort = USE_DATA_ASYNCH_CLIENT_SERVER
          DcmDspDataInfoRef = DataInfo_Vehicle_Identification_Number_F190_VIN
        DidInfo_AME_Set_FM_Frequency_FD50 (DcmDspDidInfo)
          DcmDspDidAccess
            DcmDspDidWrite
        4 x DcmDspDid, all with DcmDspDidUsed=true, DcmDspDidUsePort=USE_DATA_ELEMENT_SPECIFIC_INTERFACES:
          System_Supplier_ECU_Software_Version_Number_F195: DcmDspDidIdentifier=61845, DcmDspDidInfoRef=DidInfo_System_Supplier_ECU_Software_Version_Number_F195
            INVALID_SHORTNAME_Software_Version_Number (DcmDspDidSignal): DcmDspDidDataPos=0, DcmDspDidDataRef=System_Supplier_ECU_Software_Version_Number_F195_Software_Version_Number
          Operating_Voltage_Value_D003: DcmDspDidIdentifier=53251, DcmDspDidInfoRef=DidInfo_Operating_Voltage_Value_D003
            Operating_Voltage_Value (DcmDspDidSignal): DcmDspDidDataPos=0, DcmDspDidDataRef=Operating_Voltage_Value_D003_Operating_Voltage_Value
          AME_TBOX_communication_status_check_FD80: DcmDspDidIdentifier=64896, DcmDspDidInfoRef=DidInfo_AME_TBOX_communication_status_check_FD80
            TBOX_status (DcmDspDidSignal): DcmDspDidDataPos=0, DcmDspDidDataRef=AME_TBOX_communication_status_check_FD80_TBOX_status
          AME_Read_harman_manufactory_part_number_FD06: DcmDspDidIdentifier=64774, DcmDspDidInfoRef=DidInfo_AME_Read_harman_manufactory_part_number_FD06
            Harman_Manufactory_Part_Number (DcmDspDidSignal): DcmDspDidDataPos=0, DcmDspDidDataRef=AME_Read_harman_manufactory_part_number_FD06_Harman_Manufactory_Part_Number
        DataInfo_System_Supplier_Identifier_F18A_System_Supplier_Identifier (DcmDspDataInfo): DcmDspDataFixedLength=true
        AME_Read_FAN_speed_FD11 (DcmDspDid):
          DcmDspDidIdentifier = 64785
          DcmDspDidUsed = true
          DcmDspDidUsePort = USE_DATA_ELEMENT_SPECIFIC_INTERFACES
          DcmDspDidInfoRef = DidInfo_AME_Read_FAN_speed_FD11
          FAN_Speed (DcmDspDidSignal): DcmDspDidDataPos=0, DcmDspDidDataRef=AME_Read_FAN_speed_FD11_FAN_Speed
        DataInfo_Select_Speaker_Test_Tone_FD34_Select_tone (DcmDspDataInfo): DcmDspDataFixedLength=true
        DidInfo_AME_Set_External_Output_Status_FD93 (DcmDspDidInfo)
          DcmDspDidAccess
            DcmDspDidWrite
        DidInfo_AME_Read_FAN_speed_FD11 (DcmDspDidInfo)
          DcmDspDidAccess
            DcmDspDidRead
        AME_Play_BT_Audio_Control_FD64_Reserved_Byte (DcmDspData):
          DcmDspDataSize = 8
          DcmDspDataType = UINT8
          DcmDspDataUsePort = USE_DATA_ASYNCH_CLIENT_SERVER
          DcmDspDataInfoRef = DataInfo_AME_Play_BT_Audio_Control_FD64_Reserved_Byte
        DataInfo_AME_Set_FM_Frequency_FD50_FM_Frequency (DcmDspDataInfo): DcmDspDataFixedLength=true
        DataInfo_AME_Read_GPS_Info_FD72_Number_of_used_satellite (DcmDspDataInfo): DcmDspDataFixedLength=true
        3 x DcmDspData, all with DcmDspDataUsePort=USE_DATA_ASYNCH_CLIENT_SERVER:
          AME_Read_GPS_Info_FD72_Number_of_used_satellite: DcmDspDataSize=8, DcmDspDataType=UINT8, DcmDspDataInfoRef=DataInfo_AME_Read_GPS_Info_FD72_Number_of_used_satellite
          AME_Set_WIFI_Mode_FD67_WiFi_Mode: DcmDspDataSize=8, DcmDspDataType=UINT8, DcmDspDataInfoRef=DataInfo_AME_Set_WIFI_Mode_FD67_WiFi_Mode
          VehicleNetworkConfiguration_F1A1_VehicleNetworkConfiguration: DcmDspDataSize=136, DcmDspDataType=UINT8_N, DcmDspDataInfoRef=DataInfo_VehicleNetworkConfiguration_F1A1_VehicleNetworkConfiguration
        DidInfo_Set_debug_on_off_control_FDF0 (DcmDspDidInfo)
          DcmDspDidAccess
            DcmDspDidWrite
            DcmDspDidRead
        DidInfo_Tbox_Last_connection_lost_time_stamp_E018 (DcmDspDidInfo)
          DcmDspDidAccess
            DcmDspDidRead
        3 x DcmDspDid, all with DcmDspDidUsed=true, DcmDspDidUsePort=USE_DATA_ELEMENT_SPECIFIC_INTERFACES:
          AME_Read_Head_Unit_Connector_Status_FD90: DcmDspDidIdentifier=64912, DcmDspDidInfoRef=DidInfo_AME_Read_Head_Unit_Connector_Status_FD90
            CombinedDataElement (DcmDspDidSignal): DcmDspDidDataPos=0, DcmDspDidDataRef=AME_Read_Head_Unit_Connector_Status_FD90_CombinedDataElement
          Number_of_installed_speakers_E01C: DcmDspDidIdentifier=57372, DcmDspDidInfoRef=DidInfo_Number_of_installed_speakers_E01C
            Number_of_installed_speakers (DcmDspDidSignal): DcmDspDidDataPos=0, DcmDspDidDataRef=Number_of_installed_speakers_E01C_Number_of_installed_speakers
          Tbox_Gateway_sub_mask_E017: DcmDspDidIdentifier=57367, DcmDspDidInfoRef=DidInfo_Tbox_Gateway_sub_mask_E017
            Tbox_Gateway_sub_mask (DcmDspDidSignal): DcmDspDidDataPos=0, DcmDspDidDataRef=Tbox_Gateway_sub_mask_E017_Tbox_Gateway_sub_mask
        DidInfo_Switch_HU_boot_mode_FDF1 (DcmDspDidInfo)
          DcmDspDidAccess
            DcmDspDidWrite
        AME_Write_harman_manufactory_part_number_FD07_Harman_Manufactory_Part_Number (DcmDspData):
          DcmDspDataSize = 224
          DcmDspDataType = UINT8_N
          DcmDspDataUsePort = USE_DATA_ASYNCH_CLIENT_SERVER
          DcmDspDataInfoRef = DataInfo_AME_Write_harman_manufactory_part_number_FD07_Harman_Manufactory_Part_Number
        DataInfo_DTC_Occurrence_Timer_D005_Occure_Time_Inforamation (DcmDspDataInfo): DcmDspDataFixedLength=true
        AME_Set_External_Output_Status_FD93 (DcmDspDid):
          DcmDspDidIdentifier = 64915
          DcmDspDidUsed = true
          DcmDspDidUsePort = USE_DATA_ELEMENT_SPECIFIC_INTERFACES
          DcmDspDidInfoRef = DidInfo_AME_Set_External_Output_Status_FD93
          HW (DcmDspDidSignal): DcmDspDidDataPos=0, DcmDspDidDataRef=AME_Set_External_Output_Status_FD93_HW
          Status (DcmDspDidSignal): DcmDspDidDataPos=8, DcmDspDidDataRef=AME_Set_External_Output_Status_FD93_Status
        Present_GPS_coordinates_shift_data_E003 (DcmDspDid):
          DcmDspDidIdentifier = 57347
          DcmDspDidUsed = true
          DcmDspDidUsePort = USE_DATA_ELEMENT_SPECIFIC_INTERFACES
          DcmDspDidInfoRef = DidInfo_Present_GPS_coordinates_shift_data_E003
          GPS_coordinates (DcmDspDidSignal): DcmDspDidDataPos=0, DcmDspDidDataRef=Present_GPS_coordinates_shift_data_E003_GPS_coordinates
        Support_FM_frequency_Min_E00F_Support_FM_frequency_Min (DcmDspData):
          DcmDspDataSize = 32
          DcmDspDataType = UINT32
          DcmDspDataUsePort = USE_DATA_ASYNCH_CLIENT_SERVER
          DcmDspDataInfoRef = DataInfo_Support_FM_frequency_Min_E00F_Support_FM_frequency_Min
        AME_Set_HMI_Language_FD21 (DcmDspDid):
          DcmDspDidIdentifier = 64801
          DcmDspDidUsed = true
          DcmDspDidUsePort = USE_DATA_ELEMENT_SPECIFIC_INTERFACES
          DcmDspDidInfoRef = DidInfo_AME_Set_HMI_Language_FD21
          Set_HMI_Language (DcmDspDidSignal): DcmDspDidDataPos=0, DcmDspDidDataRef=AME_Set_HMI_Language_FD21_Set_HMI_Language
        AME_Ethernet_IP_Ping_Function_FD6E_IPAddress_Byte2 (DcmDspData):
          DcmDspDataSize = 8
          DcmDspDataType = UINT8
          DcmDspDataUsePort = USE_DATA_ASYNCH_CLIENT_SERVER
          DcmDspDataInfoRef = DataInfo_AME_Ethernet_IP_Ping_Function_FD6E_IPAddress_Byte2
        Tbox_Gateway_sub_mask_E017_Tbox_Gateway_sub_mask (DcmDspData):
          DcmDspDataSize = 128
          DcmDspDataType = UINT8_N
          DcmDspDataUsePort = USE_DATA_ASYNCH_CLIENT_SERVER
          DcmDspDataInfoRef = DataInfo_Tbox_Gateway_sub_mask_E017_Tbox_Gateway_sub_mask
        AME_Connectivy_OnOff_Control_FD62 (DcmDspDid):
          DcmDspDidIdentifier = 64866
          DcmDspDidUsed = true
          DcmDspDidUsePort = USE_DATA_ELEMENT_SPECIFIC_INTERFACES
          DcmDspDidInfoRef = DidInfo_AME_Connectivy_OnOff_Control_FD62
          BT_WiFi (DcmDspDidSignal): DcmDspDidDataPos=0, DcmDspDidDataRef=AME_Connectivy_OnOff_Control_FD62_BT_WiFi
          ON_OFF (DcmDspDidSignal): DcmDspDidDataPos=8, DcmDspDidDataRef=AME_Connectivy_OnOff_Control_FD62_ON_OFF
        4 x DcmDspData, all with DcmDspDataSize=8, DcmDspDataType=UINT8, DcmDspDataUsePort=USE_DATA_ASYNCH_CLIENT_SERVER:
          AME_Ethernet_IP_Ping_Function_FD6E_IPAddress_Byte1: DcmDspDataInfoRef=DataInfo_AME_Ethernet_IP_Ping_Function_FD6E_IPAddress_Byte1
          AME_Ethernet_IP_Ping_Function_FD6E_IPAddress_Byte4: DcmDspDataInfoRef=DataInfo_AME_Ethernet_IP_Ping_Function_FD6E_IPAddress_Byte4
          AME_Enter_NAV_Demo_Mode_FD70_Demo_Mode: DcmDspDataInfoRef=DataInfo_AME_Enter_NAV_Demo_Mode_FD70_Demo_Mode
          AME_Ethernet_IP_Ping_Function_FD6E_IPAddress_Byte3: DcmDspDataInfoRef=DataInfo_AME_Ethernet_IP_Ping_Function_FD6E_IPAddress_Byte3
        DataInfo_AME_Input_Output_OnOff_control_FD18_OnOffValue (DcmDspDataInfo): DcmDspDataFixedLength=true
        AME_Input_Output_OnOff_control_FD18 (DcmDspDid):
          DcmDspDidIdentifier = 64792
          DcmDspDidUsed = true
          DcmDspDidUsePort = USE_DATA_ELEMENT_SPECIFIC_INTERFACES
          DcmDspDidInfoRef = DidInfo_AME_Input_Output_OnOff_control_FD18
          OnOffModule (DcmDspDidSignal): DcmDspDidDataPos=0, DcmDspDidDataRef=AME_Input_Output_OnOff_control_FD18_OnOffModule
          OnOffValue (DcmDspDidSignal): DcmDspDidDataPos=8, DcmDspDidDataRef=AME_Input_Output_OnOff_control_FD18_OnOffValue
        DataInfo_AME_Write_harman_manufactory_part_number_FD07_Harman_Manufactory_Part_Number (DcmDspDataInfo): DcmDspDataFixedLength=true
        DataInfo_AME_Set_AM_Frequency_FD52_AM_Frequency (DcmDspDataInfo): DcmDspDataFixedLength=true
        DidInfo_Support_AM_frequency_Min_E00D (DcmDspDidInfo)
          DcmDspDidAccess
            DcmDspDidRead
        Bluetooth_Status_E006_Bluetooth_Status (DcmDspData):
          DcmDspDataSize = 8
          DcmDspDataType = UINT8
          DcmDspDataUsePort = USE_DATA_ASYNCH_CLIENT_SERVER
          DcmDspDataInfoRef = DataInfo_Bluetooth_Status_E006_Bluetooth_Status
        DidInfo_FM_signal_Strength_E012 (DcmDspDidInfo)
          DcmDspDidAccess
            DcmDspDidRead
        Bluetooth_Current_Discoverability_modes_E005_Bluetooth_Current_Discoverability_modes (DcmDspData):
          DcmDspDataSize = 8
          DcmDspDataType = UINT8
          DcmDspDataUsePort = USE_DATA_ASYNCH_CLIENT_SERVER
          DcmDspDataInfoRef = DataInfo_Bluetooth_Current_Discoverability_modes_E005_Bluetooth_Current_Discoverability_modes
        AME_BT_Auto_Pairing_FD63_BT_Chip (DcmDspData):
          DcmDspDataSize = 8
          DcmDspDataType = UINT8
          DcmDspDataUsePort = USE_DATA_ASYNCH_CLIENT_SERVER
          DcmDspDataInfoRef = DataInfo_AME_BT_Auto_Pairing_FD63_BT_Chip
        DataInfo_AME_Connectivy_OnOff_Control_FD62_BT_WiFi (DcmDspDataInfo): DcmDspDataFixedLength=true
        DataInfo_AME_Set_FAN_speed_FD12_FAN_Speed (DcmDspDataInfo): DcmDspDataFixedLength=true
        DidInfo_AME_Mirror_Link_connection_FD6D (DcmDspDidInfo)
          DcmDspDidAccess
            DcmDspDidWrite: DcmDspDidWriteSessionRef=DcmDspSession/Extended
        AME_Write_MAC_Address_FD61 (DcmDspDid):
          DcmDspDidIdentifier = 64865
          DcmDspDidUsed = true
          DcmDspDidUsePort = USE_DATA_ELEMENT_SPECIFIC_INTERFACES
          DcmDspDidInfoRef = DidInfo_AME_Write_MAC_Address_FD61
          7 x DcmDspDidSignal:
            subID: DcmDspDidDataPos=0, DcmDspDidDataRef=AME_Write_MAC_Address_FD61_subID
            A0: DcmDspDidDataPos=8, DcmDspDidDataRef=AME_Write_MAC_Address_FD61_A0
            A1: DcmDspDidDataPos=16, DcmDspDidDataRef=AME_Write_MAC_Address_FD61_A1
            A2: DcmDspDidDataPos=24, DcmDspDidDataRef=AME_Write_MAC_Address_FD61_A2
            A3: DcmDspDidDataPos=32, DcmDspDidDataRef=AME_Write_MAC_Address_FD61_A3
            A4: DcmDspDidDataPos=40, DcmDspDidDataRef=AME_Write_MAC_Address_FD61_A4
            A5: DcmDspDidDataPos=48, DcmDspDidDataRef=AME_Write_MAC_Address_FD61_A5
        C_matrix_Version_of_the_ECU_product_F1A2 (DcmDspDid):
          DcmDspDidIdentifier = 61858
          DcmDspDidUsed = true
          DcmDspDidUsePort = USE_DATA_ELEMENT_SPECIFIC_INTERFACES
          DcmDspDidInfoRef = DidInfo_C_matrix_Version_of_the_ECU_product_F1A2
          C_matrix_Version (DcmDspDidSignal): DcmDspDidDataPos=0, DcmDspDidDataRef=C_matrix_Version_of_the_ECU_product_F1A2_C_matrix_Version
        DataInfo_Tbox_Last_connection_lost_time_stamp_E018_Tbox_Last_connection_lost_time_stamp (DcmDspDataInfo): DcmDspDataFixedLength=true
        DataInfo_AME_Route_MIC_To_Internal_Speaker_FD36_Mic (DcmDspDataInfo): DcmDspDataFixedLength=true
        DidInfo_AME_Connectivy_OnOff_Control_FD62 (DcmDspDidInfo)
          DcmDspDidAccess
            DcmDspDidWrite
        Switch_HU_boot_mode_FDF1 (DcmDspDid):
          DcmDspDidIdentifier = 65009
          DcmDspDidUsed = true
          DcmDspDidUsePort = USE_DATA_ELEMENT_SPECIFIC_INTERFACES
          DcmDspDidInfoRef = DidInfo_Switch_HU_boot_mode_FDF1
          Boot_Mode (DcmDspDidSignal): DcmDspDidDataPos=0, DcmDspDidDataRef=Switch_HU_boot_mode_FDF1_Boot_Mode
        AME_Read_MAC_Address_FD60 (DcmDspDid):
          DcmDspDidIdentifier = 64864
          DcmDspDidUsed = true
          DcmDspDidUsePort = USE_DATA_ELEMENT_SPECIFIC_INTERFACES
          DcmDspDidInfoRef = DidInfo_AME_Read_MAC_Address_FD60
          CombinedDataElement (DcmDspDidSignal): DcmDspDidDataPos=0, DcmDspDidDataRef=AME_Read_MAC_Address_FD60_CombinedDataElement
        DataInfo_AME_TBOX_communication_status_check_FD80_TBOX_status (DcmDspDataInfo): DcmDspDataFixedLength=true
        AME_Write_MAC_Address_FD61_subID (DcmDspData):
          DcmDspDataSize = 8
          DcmDspDataType = UINT8
          DcmDspDataUsePort = USE_DATA_ASYNCH_CLIENT_SERVER
          DcmDspDataInfoRef = DataInfo_AME_Write_MAC_Address_FD61_subID
        AME_Read_AME_diagnostic_version_FD08 (DcmDspDid):
          DcmDspDidIdentifier = 64776
          DcmDspDidUsed = true
          DcmDspDidUsePort = USE_DATA_ELEMENT_SPECIFIC_INTERFACES
          DcmDspDidInfoRef = DidInfo_AME_Read_AME_diagnostic_version_FD08
          CombinedDataElement (DcmDspDidSignal): DcmDspDidDataPos=0, DcmDspDidDataRef=AME_Read_AME_diagnostic_version_FD08_CombinedDataElement
        BT_active_profile_list_E008_BT_active_profile_list (DcmDspData):
          DcmDspDataSize = 8
          DcmDspDataType = UINT8
          DcmDspDataUsePort = USE_DATA_ASYNCH_CLIENT_SERVER
          DcmDspDataInfoRef = DataInfo_BT_active_profile_list_E008_BT_active_profile_list
        DidInfo_AME_TrackMedia_Audio_Source_Play_FD41 (DcmDspDidInfo)
          DcmDspDidAccess
            DcmDspDidWrite
        DataInfo_AME_Select_Speaker_Zone_FD33_Select_Speaker_Zone (DcmDspDataInfo): DcmDspDataFixedLength=true
        VehicleNetworkConfiguration_F1A1 (DcmDspDid):
          DcmDspDidIdentifier = 61857
          DcmDspDidUsed = true
          DcmDspDidUsePort = USE_DATA_ELEMENT_SPECIFIC_INTERFACES
          DcmDspDidInfoRef = DidInfo_VehicleNetworkConfiguration_F1A1
          VehicleNetworkConfiguration (DcmDspDidSignal): DcmDspDidDataPos=0, DcmDspDidDataRef=VehicleNetworkConfiguration_F1A1_VehicleNetworkConfiguration
        3 x DcmDspData, all with DcmDspDataUsePort=USE_DATA_ASYNCH_CLIENT_SERVER:
          Tbox_Last_connection_lost_time_stamp_E018_Tbox_Last_connection_lost_time_stamp: DcmDspDataSize=128, DcmDspDataType=UINT8_N, DcmDspDataInfoRef=DataInfo_Tbox_Last_connection_lost_time_stamp_E018_Tbox_Last_connection_lost_time_stamp
          AME_Read_GYRO_Status_FD71_GYRO_Status: DcmDspDataSize=8, DcmDspDataType=UINT8, DcmDspDataInfoRef=DataInfo_AME_Read_GYRO_Status_FD71_GYRO_Status
          AME_Read_SW_and_HW_Version_FD04_CombinedDataElement: DcmDspDataSize=400, DcmDspDataType=UINT8_N, DcmDspDataInfoRef=DataInfo_AME_Read_SW_and_HW_Version_FD04_CombinedDataElement
        DidInfo_Operating_Voltage_Value_D003 (DcmDspDidInfo)
          DcmDspDidAccess
            DcmDspDidRead
        Engine_Speed_D002 (DcmDspDid): DcmDspDidIdentifier=53250, DcmDspDidUsed=true, DcmDspDidUsePort=USE_DATA_ELEMENT_SPECIFIC_INTERFACES, DcmDspDidInfoRef=DidInfo_Engine_Speed_D002
          Engine_Speed (DcmDspDidSignal): DcmDspDidDataPos=0, DcmDspDidDataRef=Engine_Speed_D002_Engine_Speed
        Screen_resolution_E002 (DcmDspDid):
          DcmDspDidIdentifier = 57346
          DcmDspDidUsed = true
          DcmDspDidUsePort = USE_DATA_ELEMENT_SPECIFIC_INTERFACES
          DcmDspDidInfoRef = DidInfo_Screen_resolution_E002
          Height (DcmDspDidSignal): DcmDspDidDataPos=16, DcmDspDidDataRef=Screen_resolution_E002_Height
          Width (DcmDspDidSignal): DcmDspDidDataPos=0, DcmDspDidDataRef=Screen_resolution_E002_Width
        System_Supplier_Identifier_F18A_System_Supplier_Identifier (DcmDspData):
          DcmDspDataSize = 80
          DcmDspDataType = UINT8_N
          DcmDspDataUsePort = USE_DATA_ASYNCH_CLIENT_SERVER
          DcmDspDataInfoRef = DataInfo_System_Supplier_Identifier_F18A_System_Supplier_Identifier
        DataInfo_AME_Read_system_voltage_FD14_CombinedDataElement (DcmDspDataInfo): DcmDspDataFixedLength=true
        DataInfo_Tbox_IP_Address_E016_Tbox_IP_Address (DcmDspDataInfo): DcmDspDataFixedLength=true
        DidInfo_AME_Read_GPS_Info_FD72 (DcmDspDidInfo)
          DcmDspDidAccess
            DcmDspDidRead
        HUT_self_check (DcmDspRoutine):
          DcmDspRequestResultsRoutineSupported = true
          DcmDspStopRoutineSupported = true
          DcmDspRoutineIdentifier = 57601
          DcmDspRoutineFixedLength = false
          DcmDspRoutineUsePort = true
          DcmDspRoutineUsed = true
          DcmDspRoutineInfoRef = RoutineInfo_HUT_self_check
        DataInfo_AME_Switch_Source_FD40_SelectAudioBufferChannelOutput (DcmDspDataInfo): DcmDspDataFixedLength=true
        DidInfo_BT_firmware_version_E009 (DcmDspDidInfo)
          DcmDspDidAccess
            DcmDspDidRead
        DataInfo_AME_Read_Head_Unit_Connector_Status_FD90_CombinedDataElement (DcmDspDataInfo): DcmDspDataFixedLength=true
        DidInfo_System_Supplier_ECU_Hardware_Version_Number_F193 (DcmDspDidInfo)
          DcmDspDidAccess
            DcmDspDidRead
        DataInfo_Support_FM_frequency_Min_E00F_Support_FM_frequency_Min (DcmDspDataInfo): DcmDspDataFixedLength=true
        Odometer_D004_Odometer (DcmDspData): DcmDspDataSize=24, DcmDspDataType=UINT8_N, DcmDspDataUsePort=USE_DATA_ASYNCH_CLIENT_SERVER, DcmDspDataInfoRef=DataInfo_Odometer_D004_Odometer
        DidInfo_AM_signal_Strength_E011 (DcmDspDidInfo)
          DcmDspDidAccess
            DcmDspDidRead
        AME_Set_External_Output_Status_FD93_Status (DcmDspData):
          DcmDspDataSize = 8
          DcmDspDataType = UINT8
          DcmDspDataUsePort = USE_DATA_ASYNCH_CLIENT_SERVER
          DcmDspDataInfoRef = DataInfo_AME_Set_External_Output_Status_FD93_Status
        DidInfo_Present_GPS_coordinates_shift_data_E003 (DcmDspDidInfo)
          DcmDspDidAccess
            DcmDspDidRead
        DidInfo_AME_Set_Volume_FD30 (DcmDspDidInfo)
          DcmDspDidAccess
            DcmDspDidWrite
        DataInfo_Number_of_installed_cameras_E001_Number_of_installed_cameras (DcmDspDataInfo): DcmDspDataFixedLength=true
        AME_Route_Video_To_HMI_FD37_Route_Vedio_To_HMI (DcmDspData):
          DcmDspDataSize = 8
          DcmDspDataType = UINT8
          DcmDspDataUsePort = USE_DATA_ASYNCH_CLIENT_SERVER
          DcmDspDataInfoRef = DataInfo_AME_Route_Video_To_HMI_FD37_Route_Vedio_To_HMI
        AME_Read_system_voltage_FD14 (DcmDspDid):
          DcmDspDidIdentifier = 64788
          DcmDspDidUsed = true
          DcmDspDidUsePort = USE_DATA_ELEMENT_SPECIFIC_INTERFACES
          DcmDspDidInfoRef = DidInfo_AME_Read_system_voltage_FD14
          CombinedDataElement (DcmDspDidSignal): DcmDspDidDataPos=0, DcmDspDidDataRef=AME_Read_system_voltage_FD14_CombinedDataElement
        DataInfo_Wi_Fi_Module_Hardware_Part_Number_E015_Wi_Fi_Module_Hardware_Part_Number (DcmDspDataInfo): DcmDspDataFixedLength=true
        C_matrix_Version_of_the_ECU_product_F1A2_C_matrix_Version (DcmDspData):
          DcmDspDataSize = 80
          DcmDspDataType = UINT8_N
          DcmDspDataUsePort = USE_DATA_ASYNCH_CLIENT_SERVER
          DcmDspDataInfoRef = DataInfo_C_matrix_Version_of_the_ECU_product_F1A2_C_matrix_Version
        DataInfo_Odometer_D004_Odometer (DcmDspDataInfo): DcmDspDataFixedLength=true
        Support_FM_frequency_Max_E010_Support_FM_frequency_Max (DcmDspData):
          DcmDspDataSize = 32
          DcmDspDataType = UINT32
          DcmDspDataUsePort = USE_DATA_ASYNCH_CLIENT_SERVER
          DcmDspDataInfoRef = DataInfo_Support_FM_frequency_Max_E010_Support_FM_frequency_Max
        DataInfo_Screen_resolution_E002_Height (DcmDspDataInfo): DcmDspDataFixedLength=true
        3 x DcmDspData, all with DcmDspDataUsePort=USE_DATA_ASYNCH_CLIENT_SERVER:
          INVALID_SHORTNAME_AME_Reset_Factory_Mode_FD05_Reset_Factory_Mode: DcmDspDataSize=8, DcmDspDataType=UINT8, DcmDspDataInfoRef=DataInfo_AME_Reset_Factory_Mode_FD05_Reset_Factory_Mode
          AME_Select_Audio_Buffer_Channel_Output_FD39_SelectAudioBufferChannelOutput: DcmDspDataSize=8, DcmDspDataType=UINT8, DcmDspDataInfoRef=DataInfo_AME_Select_Audio_Buffer_Channel_Output_FD39_SelectAudioBufferChannelOutput
          Screen_resolution_E002_Height: DcmDspDataSize=16, DcmDspDataType=UINT16, DcmDspDataInfoRef=DataInfo_Screen_resolution_E002_Height
        Tbox_IP_Address_E016 (DcmDspDid):
          DcmDspDidIdentifier = 57366
          DcmDspDidUsed = true
          DcmDspDidUsePort = USE_DATA_ELEMENT_SPECIFIC_INTERFACES
          DcmDspDidInfoRef = DidInfo_Tbox_IP_Address_E016
          Tbox_IP_Address (DcmDspDidSignal): DcmDspDidDataPos=0, DcmDspDidDataRef=Tbox_IP_Address_E016_Tbox_IP_Address
        DidInfo_Audio_jack_status_E00A (DcmDspDidInfo)
          DcmDspDidAccess
            DcmDspDidRead
        DidInfo_AME_Read_system_voltage_FD14 (DcmDspDidInfo)
          DcmDspDidAccess
            DcmDspDidRead
        DataInfo_AME_Ethernet_IP_Ping_Function_FD6E_Ethernet_Channel (DcmDspDataInfo): DcmDspDataFixedLength=true
        AME_Read_MAC_Address_FD60_CombinedDataElement (DcmDspData):
          DcmDspDataSize = 48
          DcmDspDataType = UINT8_N
          DcmDspDataUsePort = USE_DATA_ASYNCH_CLIENT_SERVER
          DcmDspDataInfoRef = DataInfo_AME_Read_MAC_Address_FD60_CombinedDataElement
        DataInfo_Vehicle_Speed_D001_Vehicle_Speed (DcmDspDataInfo): DcmDspDataFixedLength=true
        Wi_Fi_Module_Firmware_Version_E014_Wi_Fi_Module_Firmware_Version (DcmDspData):
          DcmDspDataSize = 128
          DcmDspDataType = UINT8_N
          DcmDspDataUsePort = USE_DATA_ASYNCH_CLIENT_SERVER
          DcmDspDataInfoRef = DataInfo_Wi_Fi_Module_Firmware_Version_E014_Wi_Fi_Module_Firmware_Version
        AME_Mirror_Link_connection_FD6D_Mirror_Link_connection (DcmDspData):
          DcmDspDataSize = 8
          DcmDspDataType = UINT8
          DcmDspDataUsePort = USE_DATA_ASYNCH_CLIENT_SERVER
          DcmDspDataInfoRef = DataInfo_AME_Mirror_Link_connection_FD6D_Mirror_Link_connection
        DidInfo_DTC_Occurrence_Timer_D005 (DcmDspDidInfo)
          DcmDspDidAccess
            DcmDspDidRead
        DataInfo_Bluetooth_Status_E006_Bluetooth_Status (DcmDspDataInfo): DcmDspDataFixedLength=true
        DTC_Occurrence_Timer_D005 (DcmDspDid):
          DcmDspDidIdentifier = 53253
          DcmDspDidUsed = true
          DcmDspDidUsePort = USE_DATA_ELEMENT_SPECIFIC_INTERFACES
          DcmDspDidInfoRef = DidInfo_DTC_Occurrence_Timer_D005
          Occure_Time_Inforamation (DcmDspDidSignal): DcmDspDidDataPos=0, DcmDspDidDataRef=DTC_Occurrence_Timer_D005_Occure_Time_Inforamation
        INVALID_SHORTNAME_AME_Reset_Factory_Mode_FD05 (DcmDspDid):
          DcmDspDidIdentifier = 64773
          DcmDspDidUsed = true
          DcmDspDidUsePort = USE_DATA_ELEMENT_SPECIFIC_INTERFACES
          DcmDspDidInfoRef = DidInfo_AME_Reset_Factory_Mode_FD05
          Reset_Factory_Mode (DcmDspDidSignal): DcmDspDidDataPos=0, DcmDspDidDataRef=INVALID_SHORTNAME_AME_Reset_Factory_Mode_FD05_Reset_Factory_Mode
        DidInfo_AME_Select_Speaker_Zone_FD33 (DcmDspDidInfo)
          DcmDspDidAccess
            DcmDspDidWrite
        DataInfo_AME_Set_WIFI_Mode_FD67_WiFi_Mode (DcmDspDataInfo): DcmDspDataFixedLength=true
        DidInfo_Tbox_IP_Address_E016 (DcmDspDidInfo)
          DcmDspDidAccess
            DcmDspDidRead
        DataInfo_AME_Reset_Factory_Mode_FD05_Reset_Factory_Mode (DcmDspDataInfo): DcmDspDataFixedLength=true
        Tbox_geographical_coordinates_when_connection_lost_E019 (DcmDspDid):
          DcmDspDidIdentifier = 57369
          DcmDspDidUsed = true
          DcmDspDidUsePort = USE_DATA_ELEMENT_SPECIFIC_INTERFACES
          DcmDspDidInfoRef = DidInfo_Tbox_geographical_coordinates_when_connection_lost_E019
          Tbox_geographical_coordinates_when_connection_lost (DcmDspDidSignal):
            DcmDspDidDataPos = 0
            DcmDspDidDataRef = Tbox_geographical_coordinates_when_connection_lost_E019_Tbox_geographical_coordinates_when_connection_lost
        DataInfo_AME_Read_Detection_Input_Info_FD92_CombinedDataElement (DcmDspDataInfo): DcmDspDataFixedLength=true
        DidInfo_AME_Set_HMI_Language_FD21 (DcmDspDidInfo)
          DcmDspDidAccess
            DcmDspDidWrite
        Vehicle_Speed_D001_Vehicle_Speed (DcmDspData):
          DcmDspDataSize = 16
          DcmDspDataType = UINT16
          DcmDspDataUsePort = USE_DATA_ASYNCH_CLIENT_SERVER
          DcmDspDataInfoRef = DataInfo_Vehicle_Speed_D001_Vehicle_Speed
        DidInfo_Wi_Fi_Module_Hardware_Part_Number_E015 (DcmDspDidInfo)
          DcmDspDidAccess
            DcmDspDidRead
        AME_Read_GYRO_Status_FD71 (DcmDspDid):
          DcmDspDidIdentifier = 64881
          DcmDspDidUsed = true
          DcmDspDidUsePort = USE_DATA_ELEMENT_SPECIFIC_INTERFACES
          DcmDspDidInfoRef = DidInfo_AME_Read_GYRO_Status_FD71
          GYRO_Status (DcmDspDidSignal): DcmDspDidDataPos=0, DcmDspDidDataRef=AME_Read_GYRO_Status_FD71_GYRO_Status
        DataInfo_Number_of_installed_speakers_E01C_Number_of_installed_speakers (DcmDspDataInfo): DcmDspDataFixedLength=true
        DataInfo_FM_signal_Strength_E012_FM_signal_Strength (DcmDspDataInfo): DcmDspDataFixedLength=true
        Wi_Fi_Module_Firmware_Version_E014 (DcmDspDid):
          DcmDspDidIdentifier = 57364
          DcmDspDidUsed = true
          DcmDspDidUsePort = USE_DATA_ELEMENT_SPECIFIC_INTERFACES
          DcmDspDidInfoRef = DidInfo_Wi_Fi_Module_Firmware_Version_E014
          Wi_Fi_Module_Firmware_Version (DcmDspDidSignal): DcmDspDidDataPos=0, DcmDspDidDataRef=Wi_Fi_Module_Firmware_Version_E014_Wi_Fi_Module_Firmware_Version
        Number_of_installed_cameras_E001_Number_of_installed_cameras (DcmDspData):
          DcmDspDataSize = 8
          DcmDspDataType = UINT8
          DcmDspDataUsePort = USE_DATA_ASYNCH_CLIENT_SERVER
          DcmDspDataInfoRef = DataInfo_Number_of_installed_cameras_E001_Number_of_installed_cameras
        DidInfo_Support_FM_frequency_Min_E00F (DcmDspDidInfo)
          DcmDspDidAccess
            DcmDspDidRead
        3 x DcmDspDid, all with DcmDspDidUsed=true, DcmDspDidUsePort=USE_DATA_ELEMENT_SPECIFIC_INTERFACES:
          AME_Select_Speaker_Zone_FD33: DcmDspDidIdentifier=64819, DcmDspDidInfoRef=DidInfo_AME_Select_Speaker_Zone_FD33
            Select_Speaker_Zone (DcmDspDidSignal): DcmDspDidDataPos=0, DcmDspDidDataRef=AME_Select_Speaker_Zone_FD33_Select_Speaker_Zone
          AME_Play_BT_Audio_Control_FD64: DcmDspDidIdentifier=64868, DcmDspDidInfoRef=DidInfo_AME_Play_BT_Audio_Control_FD64
            Reserved_Byte (DcmDspDidSignal): DcmDspDidDataPos=0, DcmDspDidDataRef=AME_Play_BT_Audio_Control_FD64_Reserved_Byte
          AME_Switch_BIOS_Mode_FD02: DcmDspDidIdentifier=64770, DcmDspDidInfoRef=DidInfo_AME_Switch_BIOS_Mode_FD02
            Switch_BIOS (DcmDspDidSignal): DcmDspDidDataPos=0, DcmDspDidDataRef=AME_Switch_BIOS_Mode_FD02_Switch_BIOS
        DataInfo_AME_Write_MAC_Address_FD61_subID (DcmDspDataInfo): DcmDspDataFixedLength=true
        AME_Ethernet_IP_Ping_Function_FD6E (DcmDspDid):
          DcmDspDidIdentifier = 64878
          DcmDspDidUsed = true
          DcmDspDidUsePort = USE_DATA_ELEMENT_SPECIFIC_INTERFACES
          DcmDspDidInfoRef = DidInfo_AME_Ethernet_IP_Ping_Function_FD6E
          5 x DcmDspDidSignal:
            IPAddress_Byte3: DcmDspDidDataPos=24, DcmDspDidDataRef=AME_Ethernet_IP_Ping_Function_FD6E_IPAddress_Byte3
            IPAddress_Byte4: DcmDspDidDataPos=32, DcmDspDidDataRef=AME_Ethernet_IP_Ping_Function_FD6E_IPAddress_Byte4
            Ethernet_Channel: DcmDspDidDataPos=0, DcmDspDidDataRef=AME_Ethernet_IP_Ping_Function_FD6E_Ethernet_Channel
            IPAddress_Byte1: DcmDspDidDataPos=8, DcmDspDidDataRef=AME_Ethernet_IP_Ping_Function_FD6E_IPAddress_Byte1
            IPAddress_Byte2: DcmDspDidDataPos=16, DcmDspDidDataRef=AME_Ethernet_IP_Ping_Function_FD6E_IPAddress_Byte2
        DidInfo_Bluetooth_Status_E006 (DcmDspDidInfo)
          DcmDspDidAccess
            DcmDspDidRead
        3 x DcmDspDataInfo:
          DataInfo_AME_Read_SW_and_HW_Version_FD04_CombinedDataElement: DcmDspDataFixedLength=false
          DataInfo_AME_Enter_NAV_Demo_Mode_FD70_Demo_Mode: DcmDspDataFixedLength=true
          DataInfo_Audio_jack_status_E00A_Audio_jack_status: DcmDspDataFixedLength=true
        AME_Input_Output_OnOff_control_FD18_OnOffModule (DcmDspData):
          DcmDspDataSize = 8
          DcmDspDataType = UINT8
          DcmDspDataUsePort = USE_DATA_ASYNCH_CLIENT_SERVER
          DcmDspDataInfoRef = DataInfo_AME_Input_Output_OnOff_control_FD18_OnOffModule
        AM_signal_Strength_E011 (DcmDspDid):
          DcmDspDidIdentifier = 57361
          DcmDspDidUsed = true
          DcmDspDidUsePort = USE_DATA_ELEMENT_SPECIFIC_INTERFACES
          DcmDspDidInfoRef = DidInfo_AM_signal_Strength_E011
          AM_signal_Strength (DcmDspDidSignal): DcmDspDidDataPos=0, DcmDspDidDataRef=AM_signal_Strength_E011_AM_signal_Strength
        DataInfo_AME_Display_Color_Bar_Control_FD38_Display_Color_Bar_Control (DcmDspDataInfo): DcmDspDataFixedLength=true
        AME_Set_Mute_Control_FD31_Set_Mute_Control (DcmDspData):
          DcmDspDataSize = 8
          DcmDspDataType = UINT8
          DcmDspDataUsePort = USE_DATA_ASYNCH_CLIENT_SERVER
          DcmDspDataInfoRef = DataInfo_AME_Set_Mute_Control_FD31_Set_Mute_Control
        DidInfo_AME_Set_AM_Frequency_FD52 (DcmDspDidInfo)
          DcmDspDidAccess
            DcmDspDidWrite
        DataInfo_ECU_Serial_Number_F18C_ECU_Serial_Number (DcmDspDataInfo): DcmDspDataFixedLength=true
        Tbox_Last_connection_lost_time_stamp_E018 (DcmDspDid):
          DcmDspDidIdentifier = 57368
          DcmDspDidUsed = true
          DcmDspDidUsePort = USE_DATA_ELEMENT_SPECIFIC_INTERFACES
          DcmDspDidInfoRef = DidInfo_Tbox_Last_connection_lost_time_stamp_E018
          Tbox_Last_connection_lost_time_stamp (DcmDspDidSignal): DcmDspDidDataPos=0, DcmDspDidDataRef=Tbox_Last_connection_lost_time_stamp_E018_Tbox_Last_connection_lost_time_stamp
        DcmDspSession
          Default (DcmDspSessionRow): DcmDspSessionLevel=1, DcmDspSessionP2ServerMax=0.05, DcmDspSessionP2StarServerMax=5, DcmDspSessionForBoot=DCM_NO_BOOT
          Extended (DcmDspSessionRow): DcmDspSessionLevel=3, DcmDspSessionP2ServerMax=0.05, DcmDspSessionP2StarServerMax=5, DcmDspSessionForBoot=DCM_NO_BOOT
        AME_Read_Detection_Input_Info_FD92 (DcmDspDid):
          DcmDspDidIdentifier = 64914
          DcmDspDidUsed = true
          DcmDspDidUsePort = USE_DATA_ELEMENT_SPECIFIC_INTERFACES
          DcmDspDidInfoRef = DidInfo_AME_Read_Detection_Input_Info_FD92
          CombinedDataElement (DcmDspDidSignal): DcmDspDidDataPos=0, DcmDspDidDataRef=AME_Read_Detection_Input_Info_FD92_CombinedDataElement
        DataInfo_Switch_HU_boot_mode_FDF1_Boot_Mode (DcmDspDataInfo): DcmDspDataFixedLength=true
        DidInfo_AME_Read_MAC_Address_FD60 (DcmDspDidInfo)
          DcmDspDidAccess
            DcmDspDidRead
        AME_Set_HMI_Language_FD21_Set_HMI_Language (DcmDspData):
          DcmDspDataSize = 8
          DcmDspDataType = UINT8
          DcmDspDataUsePort = USE_DATA_ASYNCH_CLIENT_SERVER
          DcmDspDataInfoRef = DataInfo_AME_Set_HMI_Language_FD21_Set_HMI_Language
        DcmDspMemory: DcmDspUseMemoryId=false
          DcmDspMemoryIdInfo
            DcmDspReadMemoryRangeInfo: DcmDspReadMemoryRangeHigh=0, DcmDspReadMemoryRangeLow=0
            DcmDspWriteMemoryRangeInfo: DcmDspWriteMemoryRangeHigh=0, DcmDspWriteMemoryRangeLow=0
        DidInfo_DID_StartApplication (DcmDspDidInfo)
          DcmDspDidAccess
            DcmDspDidRead
            DcmDspDidWrite
        DataInfo_DID_StartApplication (DcmDspDataInfo): DcmDspDataFixedLength=true
        Data_DID_StartApplication (DcmDspData): DcmDspDataSize=16, DcmDspDataUsePort=USE_DATA_SYNCH_CLIENT_SERVER, DcmDspDataType=UINT16, DcmDspDataInfoRef=DataInfo_DID_StartApplication
        DID_StartApplication (DcmDspDid): DcmDspDidIdentifier=85, DcmDspDidUsed=true, DcmDspDidUsePort=USE_DATA_ELEMENT_SPECIFIC_INTERFACES, DcmDspDidInfoRef=DidInfo_DID_StartApplication
          DcmDspDidSignal_Data_DID_StartApplication (DcmDspDidSignal): DcmDspDidDataPos=0, DcmDspDidDataRef=Data_DID_StartApplication
      DcmPageBufferCfg: DcmPagedBufferEnabled=true
  module config CanIf: implementation-config-variant=VARIANT-PRE-COMPILE, module-description=CanIf_Impl
    CanIfCtrlDrvCfg_7d254554 (CanIfCtrlDrvCfg): CanIfCtrlDrvTxCancellation=false, CanIfCtrlDrvInitHohConfigRef=CanIfInitHohCfg, CanIfCtrlDrvNameRef=CanGeneral
      CT_CAN_d43e43a4 (CanIfCtrlCfg): CanIfCtrlId=0, CanIfCtrlWakeupSupport=false, CanIfCtrlJ1939DynAddrSupport=DISABLED, CanIfCtrlCanCtrlRef=CanConfigSet/CT_CAN_d43e43a4
    CanIfDispatchCfg:
      CanIfDispatchUserCtrlBusOffName = CanSM_ControllerBusOff
      CanIfDispatchUserCtrlBusOffUL = CAN_SM
      CanIfDispatchUserCtrlModeIndicationName = CanSM_ControllerModeIndication
      CanIfDispatchUserCtrlModeIndicationUL = CAN_SM
    CanIfInitCfg
      CanIfInitHohCfg: CanIfInitRefCfgSet=CanConfigSet
        CN_CAN_23287e84_Rx (CanIfHrhCfg): CanIfHrhSoftwareFilter=true, CanIfHrhCanCtrlIdRef=CanIfCtrlDrvCfg_7d254554/CT_CAN_d43e43a4, CanIfHrhIdSymRef=CanConfigSet/CN_CAN_23287e84_Rx
        CN_CAN_fe6ecc87_Tx (CanIfHthCfg): CanIfHthCanCtrlIdRef=CanIfCtrlDrvCfg_7d254554/CT_CAN_d43e43a4, CanIfHthIdSymRef=CanConfigSet/CN_CAN_fe6ecc87_Tx
      msg_TxCycle10_0_oCAN_9c370e88_Tx (CanIfTxPduCfg):
        CanIfTxPduCanId = 616
        CanIfTxPduCanIdType = STANDARD_CAN
        CanIfTxPduDlc = 7
        CanIfTxPduUserTxConfirmationName = NULL_PTR
        CanIfTxPduUserTxConfirmationUL = NONE
        CanIfTxPduId = 8
        CanIfTxPduReadNotifyStatus = false
        CanIfTxPduType = STATIC
        CanIfTxPduBufferRef = CanIfInitCfg/CHNL_346f2748
        CanIfTxPduRef = EcucPduCollection/msg_TxCycle10_0_oCAN_2d7b6a87_Tx
      msg_RxCycle100_0_oCAN_e369bba0_Rx (CanIfRxPduCfg):
        CanIfRxPduCanId = 528
        CanIfRxPduCanIdType = STANDARD_CAN
        CanIfRxPduDlc = 1
        CanIfRxPduUserRxIndicationName = PduR_CanIfRxIndication
        CanIfRxPduUserRxIndicationUL = PDUR
        CanIfRxPduId = 8
        CanIfRxPduReadData = false
        CanIfRxPduReadNotifyStatus = false
        CanIfRxPduDlcCheck = true
        CanIfRxPduHrhIdRef = CanIfInitHohCfg/CN_CAN_23287e84_Rx
        CanIfRxPduRef = EcucPduCollection/msg_RxCycle100_0_oCAN_c71398f9_Rx
      msg_RxCycle_E2eProf1C_500_10_oCAN_223145ae_Rx (CanIfRxPduCfg):
        CanIfRxPduCanId = 288
        CanIfRxPduCanIdType = STANDARD_CAN
        CanIfRxPduDlc = 8
        CanIfRxPduUserRxIndicationName = PduR_CanIfRxIndication
        CanIfRxPduUserRxIndicationUL = PDUR
        CanIfRxPduId = 9
        CanIfRxPduReadData = false
        CanIfRxPduReadNotifyStatus = false
        CanIfRxPduDlcCheck = true
        CanIfRxPduHrhIdRef = CanIfInitHohCfg/CN_CAN_23287e84_Rx
        CanIfRxPduRef = EcucPduCollection/msg_RxCycle_E2eProf1C_500_10_oCAN_23e9789c_Rx
      msg_TxCycle_E2eProf1C_500_30_oCAN_f209e413_Tx (CanIfTxPduCfg):
        CanIfTxPduCanId = 888
        CanIfTxPduCanIdType = STANDARD_CAN
        CanIfTxPduDlc = 8
        CanIfTxPduUserTxConfirmationName = NULL_PTR
        CanIfTxPduUserTxConfirmationUL = NONE
        CanIfTxPduId = 6
        CanIfTxPduReadNotifyStatus = false
        CanIfTxPduType = STATIC
        CanIfTxPduBufferRef = CanIfInitCfg/CHNL_346f2748
        CanIfTxPduRef = EcucPduCollection/msg_TxCycle_E2eProf1C_500_30_oCAN_995018f6_Tx
      msg_diag_Response_MyECU_Tp_oCAN_ee3092c6_Tx (CanIfTxPduCfg):
        CanIfTxPduCanId = 1554
        CanIfTxPduCanIdType = STANDARD_CAN
        CanIfTxPduDlc = 8
        CanIfTxPduUserTxConfirmationName = CanTp_TxConfirmation
        CanIfTxPduUserTxConfirmationUL = CAN_TP
        CanIfTxPduId = 3
        CanIfTxPduReadNotifyStatus = false
        CanIfTxPduType = STATIC
        CanIfTxPduBufferRef = CanIfInitCfg/CHNL_346f2748
        CanIfTxPduRef = msg_diag_Response_MyECU_Tp_oCAN_eec7d8e8_Tx
      msg_diag_RequestGlobal_Tp_oCAN_37844e48_Rx (CanIfRxPduCfg):
        CanIfRxPduCanId = 1556
        CanIfRxPduCanIdType = STANDARD_CAN
        CanIfRxPduDlc = 8
        CanIfRxPduUserRxIndicationName = CanTp_RxIndication
        CanIfRxPduUserRxIndicationType = PDUID_PDUINFOPTR
        CanIfRxPduUserRxIndicationUL = CAN_TP
        CanIfRxPduId = 2
        CanIfRxPduReadData = false
        CanIfRxPduReadNotifyStatus = false
        CanIfRxPduDlcCheck = true
        CanIfRxPduHrhIdRef = CanIfInitHohCfg/CN_CAN_23287e84_Rx
        CanIfRxPduRef = msg_diag_RequestGlobal_Tp_oCAN_2ced7a67_Rx
      4 x CanIfTxPduCfg, all with CanIfTxPduCanIdType=STANDARD_CAN, CanIfTxPduReadNotifyStatus=false, CanIfTxPduType=STATIC, CanIfTxPduBufferRef=CanIfInitCfg/CHNL_346f2748:
        msg_TxEvent_10_oCAN_b963731b_Tx: CanIfTxPduCanId=360, CanIfTxPduDlc=7, CanIfTxPduUserTxConfirmationName=NULL_PTR, CanIfTxPduUserTxConfirmationUL=NONE, CanIfTxPduId=9, CanIfTxPduRef=EcucPduCollection/msg_TxEvent_10_oCAN_b9443fef_Tx
        msg_XCP_Response_MyECU_oCAN_7223ed6d_Tx: CanIfTxPduCanId=1796, CanIfTxPduDlc=8, CanIfTxPduUserTxConfirmationName=PduR_CanIfTxConfirmation, CanIfTxPduUserTxConfirmationUL=PDUR, CanIfTxPduId=0, CanIfTxPduRef=EcucPduCollection/msg_XCP_Response_MyECU_oCAN_5d942f8b_Tx
        msg_StartAppl_Tx_MyECU_oCAN_b6f80cd2_Tx: CanIfTxPduCanId=1280, CanIfTxPduDlc=8, CanIfTxPduUserTxConfirmationName=NULL_PTR, CanIfTxPduUserTxConfirmationUL=NONE, CanIfTxPduId=4, CanIfTxPduRef=EcucPduCollection/msg_StartAppl_Tx_MyECU_oCAN_c14d78df_Tx
        msg_TxCycle1000_10_oCAN_fd90faa0_Tx: CanIfTxPduCanId=872, CanIfTxPduDlc=2, CanIfTxPduUserTxConfirmationName=NULL_PTR, CanIfTxPduUserTxConfirmationUL=NONE, CanIfTxPduId=7, CanIfTxPduRef=EcucPduCollection/msg_TxCycle1000_10_oCAN_6dd6f284_Tx
      msg_StartAppl_Rx_MyECU_oCAN_2369e80d_Rx (CanIfRxPduCfg):
        CanIfRxPduCanId = 1281
        CanIfRxPduCanIdType = STANDARD_CAN
        CanIfRxPduDlc = 8
        CanIfRxPduUserRxIndicationName = PduR_CanIfRxIndication
        CanIfRxPduUserRxIndicationUL = PDUR
        CanIfRxPduId = 5
        CanIfRxPduReadData = false
        CanIfRxPduReadNotifyStatus = false
        CanIfRxPduDlcCheck = true
        CanIfRxPduHrhIdRef = CanIfInitHohCfg/CN_CAN_23287e84_Rx
        CanIfRxPduRef = EcucPduCollection/msg_StartAppl_Rx_MyECU_oCAN_fe93a56e_Rx
      msg_diag_Response_MyECU_Slave3_oCAN_df0f7cb5_Tx (CanIfTxPduCfg):
        CanIfTxPduCanId = 1555
        CanIfTxPduCanIdType = STANDARD_CAN
        CanIfTxPduDlc = 8
        CanIfTxPduId = 2
        CanIfTxPduReadNotifyStatus = false
        CanIfTxPduType = STATIC
        CanIfTxPduUserTxConfirmationUL = PDUR
        CanIfTxPduUserTxConfirmationName = PduR_CanIfTxConfirmation
        CanIfTxPduBufferRef = CanIfInitCfg/CHNL_346f2748
        CanIfTxPduRef = EcucPduCollection/msg_diag_Response_MyECU_Slave3_oCAN_659398e3_Tx
      4 x CanIfRxPduCfg, all with CanIfRxPduCanIdType=STANDARD_CAN, CanIfRxPduReadData=false, CanIfRxPduReadNotifyStatus=false, CanIfRxPduDlcCheck=true, CanIfRxPduHrhIdRef=CanIfInitHohCfg/CN_CAN_23287e84_Rx:
        msg_diag_Request_MyECU_Tp_oCAN_0b2d11a0_Rx: CanIfRxPduCanId=1552, CanIfRxPduDlc=8, CanIfRxPduUserRxIndicationName=CanTp_RxIndication, CanIfRxPduUserRxIndicationType=PDUID_PDUINFOPTR, CanIfRxPduUserRxIndicationUL=CAN_TP, CanIfRxPduId=4, CanIfRxPduRef=msg_diag_Request_MyECU_Tp_oCAN_44a1d668_Rx
        msg_XCP_Request_MyECU_oCAN_3fb53b34_Rx: CanIfRxPduCanId=1795, CanIfRxPduDlc=8, CanIfRxPduUserRxIndicationName=PduR_CanIfRxIndication, CanIfRxPduUserRxIndicationUL=PDUR, CanIfRxPduId=1, CanIfRxPduRef=EcucPduCollection/msg_XCP_Request_MyECU_oCAN_24ce420e_Rx
        msg_RxCycle500_20_oCAN_a62cdda0_Rx: CanIfRxPduCanId=272, CanIfRxPduDlc=6, CanIfRxPduUserRxIndicationName=PduR_CanIfRxIndication, CanIfRxPduUserRxIndicationUL=PDUR, CanIfRxPduId=10, CanIfRxPduRef=EcucPduCollection/msg_RxCycle500_20_oCAN_266969e8_Rx
        msg_RxEvent_20_oCAN_8771683b_Rx: CanIfRxPduCanId=784, CanIfRxPduDlc=4, CanIfRxPduUserRxIndicationName=PduR_CanIfRxIndication, CanIfRxPduUserRxIndicationUL=PDUR, CanIfRxPduId=7, CanIfRxPduRef=EcucPduCollection/msg_RxEvent_20_oCAN_13517c6b_Rx
      msg_diag_Uudt_Response_MyECU_oCAN_6917a2df_Tx (CanIfTxPduCfg):
        CanIfTxPduCanId = 1558
        CanIfTxPduCanIdType = STANDARD_CAN
        CanIfTxPduDlc = 8
        CanIfTxPduUserTxConfirmationName = PduR_CanIfTxConfirmation
        CanIfTxPduUserTxConfirmationUL = PDUR
        CanIfTxPduId = 1
        CanIfTxPduReadNotifyStatus = false
        CanIfTxPduType = STATIC
        CanIfTxPduBufferRef = CanIfInitCfg/CHNL_346f2748
        CanIfTxPduRef = EcucPduCollection/msg_diag_Uudt_Response_MyECU_oCAN_e0fa8c3a_Tx
      GlobalTimeMaster_oCAN_aa79fe59_Rx (CanIfRxPduCfg):
        CanIfRxPduCanId = 896
        CanIfRxPduCanIdType = STANDARD_CAN
        CanIfRxPduDlc = 8
        CanIfRxPduId = 6
        CanIfRxPduReadData = false
        CanIfRxPduReadNotifyStatus = false
        CanIfRxPduUserRxIndicationName = NULL_PTR
        CanIfRxPduUserRxIndicationUL = NONE
        CanIfRxPduDlcCheck = true
        CanIfRxPduHrhIdRef = CanIfInitHohCfg/CN_CAN_23287e84_Rx
        CanIfRxPduRef = EcucPduCollection/GlobalTimeMaster_oCAN_48f281bc_Rx
      msg_diag_Request_MyECU_Slave3_oCAN_b0f04ace_Rx (CanIfRxPduCfg):
        CanIfRxPduCanId = 1553
        CanIfRxPduCanIdType = STANDARD_CAN
        CanIfRxPduDlc = 8
        CanIfRxPduId = 3
        CanIfRxPduReadData = false
        CanIfRxPduReadNotifyStatus = false
        CanIfRxPduUserRxIndicationName = NULL_PTR
        CanIfRxPduUserRxIndicationUL = NONE
        CanIfRxPduDlcCheck = true
        CanIfRxPduHrhIdRef = CanIfInitHohCfg/CN_CAN_23287e84_Rx
        CanIfRxPduRef = EcucPduCollection/msg_diag_Request_MyECU_Slave3_oCAN_87f08505_Rx
      CHNL_346f2748 (CanIfBufferCfg):
        CanIfBufferSize = 10
        CanIfTxBufferHandlingType = PRIO_BY_CANID
        CanIfTxBufferMappedTxPdus = 10
        CanIfTxBufferMaxPduLength = 8
        CanIfBufferHthRef = CanIfInitHohCfg/CN_CAN_fe6ecc87_Tx
      NmOsekRxPdu_NmOsekChannelConfig (CanIfRxPduCfg):
        CanIfRxPduCanIdType = STANDARD_CAN
        CanIfRxPduDlc = 8
        CanIfRxPduId = 0
        CanIfRxPduReadData = false
        CanIfRxPduReadNotifyStatus = false
        CanIfRxPduUserRxIndicationName = NmOsek_RxIndication_0
        CanIfRxPduUserRxIndicationUL = APPL
        CanIfRxPduDlcCheck = true
        CanIfRxPduUserRxIndicationType = PDUID_SDUDATAPTR_CANID
        CanIfRxPduHrhIdRef = CanIfInitHohCfg/CN_CAN_23287e84_Rx
        CanIfRxPduRef = Pdu_NmOsek_Rx
        CanIfRxPduCanIdRange: CanIfRxPduCanIdRangeLowerCanId=1024, CanIfRxPduCanIdRangeUpperCanId=1279
      CanIfTxPduCfg:
        CanIfTxPduCanId = 1029
        CanIfTxPduCanIdType = STANDARD_CAN
        CanIfTxPduDlc = 8
        CanIfTxPduId = 5
        CanIfTxPduReadNotifyStatus = false
        CanIfTxPduType = STATIC
        CanIfTxPduUserTxConfirmationUL = APPL
        CanIfTxPduUserTxConfirmationName = NmOsek_TxConfirmation_0
        CanIfTxPduBufferRef = CanIfInitCfg/CHNL_346f2748
        CanIfTxPduRef = Pdu_NmOsek_Tx
    CanIfPrivateCfg:
      CanIfPrivateSoftwareFilterType = LINEAR
      CanIfPrivateDlcCheck = true
      CanIfSupportTTCAN = false
      CanIfTransceiverMapping = false
      CanIfTransceiverHandling = false
      CanIfSupportExtendedIds = true
      CanIfSupportNmOsek = true
      CanIfTxBufferType = BYTE_QUEUE
      CanIfOptimizeOneController = true
      CanIfWakeupSupport = false
      CanIfStaticFdTxBufferSupport = false
      CanIfRxSearchConsiderMsgType = false
      CanIfMultipleBasicCANTxObjects = false
      CanIfTxBufferFifoSupport = false
      CanIfSetPduReceptionModeSupport = false
      CanIfDataChecksumRxSupport = false
      CanIfDataChecksumTxSupport = false
    CanIfPublicCfg:
      CanIfPublicPnSupport = false
      CanIfPublicCancelTransmitSupport = true
      CanIfPublicDevErrorDetect = true
      CanIfPublicHandleTypeEnum = UINT8
      CanIfPublicMultipleDrvSupport = false
      CanIfPublicNumberOfCanHwUnits = 1
      CanIfPublicReadRxPduDataApi = false
      CanIfPublicReadRxPduNotifyStatusApi = false
      CanIfPublicReadTxPduNotifyStatusApi = false
      CanIfPublicSetDynamicTxIdApi = false
      CanIfPublicTxBuffering = true
      CanIfPublicTxConfirmPollingSupport = false
      CanIfPublicVersionInfoApi = false
      CanIfPublicWakeupCheckValidSupport = false
      CanIfPnWakeupTxPduFilterSupport = false
      CanIfPnTrcvHandlingSupport = false
      CanIfJ1939DynAddrSupport = DISABLED
      CanIfSafeBswChecks = false
      CanIfSetBaudrateApi = false
  module config Can: implementation-config-variant=VARIANT-PRE-COMPILE, module-description=Can_Impl
    CanGeneral:
      CanIndex = 0
      CanChangeBaudrateApi = false
      CanDevErrorDetection = true
      CanHardwareCancellation = false
      CanIdenticalIdCancellation = false
      CanMainFunctionBusoffPeriod = 0.01
      CanMainFunctionModePeriod = 0.01
      CanMainFunctionWakeupPeriod = 0.01
      CanMultiplexedTransmission = false
      CanSetBaudrateApi = false
      CanTimeoutDuration = 0.01
      CanVersionInfoApi = false
      CanGenericPrecopy = false
      CanHardwareLoopCheck = true
      CanSecureTempBuffer = false
      CanRxFullCANSupport = false
      CanTxFullCANSupport = false
      CanRxBasicCANSupport = true
      CanUseNestedCANInterrupts = false
      CanHardwareCancelByAppl = false
      CanIndividualProcessing = false
      CanGenericConfirmation = false
      CanRxQueue = false
      CanSupportMixedID = false
      CanRxQueueSize = 10
      CanMultipleBasicCANObjects = false
      CanMultipleBasicCANTxObjects = false
      CanHardwareHandleType = UINT8
      CanOptimizeOneController = true
      CanInterruptCategory = CATEGORY2
      CanGetStatus = false
      CanInterruptLock = DRIVER
      CanWakeupSupport = false
      CanRamCheck = None
      CanOverrunNotification = DET
      CanReinitStart = false
      CanGenericPreTransmit = false
      CanFdSupport = NONE
      CanRuntimeMeasurementSupport = false
      CanMaxRxDataLen = 8
      CanMaxTxDataLen = 8
      CanUsePeripheralAccessApi = true
      CanMirrorModeSupport = false
      CanWorkaroundERR005829Enable = false
      CanTASDEnable = false
      CanSleepModeSelection = DISABLE_MODE
      CanEnableGlitchFilter = false
      CanCoreSelection = Cortex_A9
      CanSafeBswChecks = false
      CanUseOsInterruptControl = true
      CanSilentModeSupport = false
      CanCounterRef = SystemTimer
      CanMainFunctionRWPeriods: CanMainFunctionWritePeriod=0.01
    CanConfigSet
      CT_CAN_d43e43a4 (CanController):
        CanControllerActivation = true
        CanBusoffProcessing = INTERRUPT
        CanControllerBaseAddress = 1073889280
        CanControllerId = 0
        CanRxProcessing = INTERRUPT
        CanTxProcessing = INTERRUPT
        CanWakeupProcessing = INTERRUPT
        CanWakeupSupport = false
        CanWakeupSourceId = 0
        CanBaseAddress = FlexCAN_0
        CanChannelGlitchFilter = 127
        CanControllerDefaultBaudrate = CanControllerBaudrateConfig
        CanControllerSystemRef = CT_CAN
        CanWakeupSourceRef = EcuMCommonConfiguration/CN_CAN_fe6ecc87
        CanCpuClockRef = McuClockReferencePoint_ExtOSC
        CanControllerBaudrateConfig:
          CanControllerBaudRate = 500
          CanControllerBaudRateConfigID = 0
          CanControllerPropSeg = 4
          CanControllerSeg1 = 1
          CanControllerSeg2 = 2
          CanControllerSyncJumpWidth = 1
          CanBaudrateClock = 8000
          CanBaudratePrescaler = 2
          CanSamplingMode = OneSample
          CanClockSelection = OscillatorClock
          CanTASDValue = 16
        CanFilterMask: CanFilterMaskValue=0, CanFilterCodeValue=0, IsLocked=false
      CN_CAN_fe6ecc87_Tx (CanHardwareObject):
        CanHandleType = BASIC
        CanIdValue = 0
        CanObjectType = TRANSMIT
        CanIdType = STANDARD
        CanObjectId = 0
        CanHwProcessing = false
        CanObjectHwSize = 1
        CanObjectHwHandle = 8
        CanMaxDataLen = 8
        CanFdPaddingValue = 0
        CanObjectMultiplexedTransmission = false
        CanControllerRef = CanConfigSet/CT_CAN_d43e43a4
      CN_CAN_23287e84_Rx (CanHardwareObject):
        CanHandleType = BASIC
        CanIdType = STANDARD
        CanIdValue = 0
        CanObjectType = RECEIVE
        CanObjectId = 1
        CanHwProcessing = false
        CanObjectHwSize = 1
        CanObjectHwHandle = 0
        CanMaxDataLen = 8
        CanFdPaddingValue = 0
        CanObjectMultiplexedTransmission = false
        CanControllerRef = CanConfigSet/CT_CAN_d43e43a4
        CanFilterMaskRef = CanFilterMask
  module config CanTp: implementation-config-variant=VARIANT-PRE-COMPILE, module-description=CanTp_Impl
    CanTpGeneral:
      CanTpChangeParameterApi = false
      CanTpDevErrorDetect = true
      CanTpPaddingByte = 204
      CanTpReadParameterApi = false
      CanTpVersionInfoApi = false
      CanTpPaddingActive = true
      CanTpHavePaddingByte = false
      CanTpNumRxChannels = 0
      CanTpNumTxChannels = 0
      CanTpEnableSplitMainFunction = false
      CanTpSupportStandardAddressing = true
      CanTpSupportExtendedAddressing = true
      CanTpSupportMixed11Addressing = true
      CanTpOnlyNotifyInformedAppl = true
      CanTpRc = false
      CanTpTc = true
      CanTpSafeBswChecks = false
      CanTpEnableConstantBS = true
      CanTpEnableTransmitQueue = false
      CanTpUseOnlyFirstFc = true
      CanTpEnableSynchronousTransmit = true
    CanTpConfig: CanTpMainFunctionPeriod=0.005
      TPCH_5a4d0643 (CanTpChannel): CanTpChannelMode=CANTP_MODE_FULL_DUPLEX
        CanTpRxNSdu_456adda8 (CanTpRxNSdu):
          CanTpRxAddressingFormat = CANTP_STANDARD
          CanTpRxDl = 8
          CanTpRxTaType = CANTP_FUNCTIONAL
          CanTpNbr = 0.1
          CanTpRxNSduId = 0
          CanTpRxPaddingActivation = CANTP_ON
          CanTpRxNSduRef = EcucPduCollection/msg_diag_RequestGlobal_oCAN_e06c7e2d_Rx
          CanTpRxNPdu_e872022a (CanTpRxNPdu): CanTpRxNPduId=1, CanTpRxNPduRef=msg_diag_RequestGlobal_Tp_oCAN_2ced7a67_Rx
      TPCH_6f424b54 (CanTpChannel): CanTpChannelMode=CANTP_MODE_FULL_DUPLEX
        CanTpRxNSdu_dab96b77 (CanTpRxNSdu):
          CanTpRxAddressingFormat = CANTP_STANDARD
          CanTpRxDl = 8
          CanTpRxTaType = CANTP_PHYSICAL
          CanTpNbr = 0.1
          CanTpRxNSduId = 1
          CanTpRxPaddingActivation = CANTP_ON
          CanTpBs = 8
          CanTpNar = 0.1
          CanTpNcr = 0.5
          CanTpRxWftMax = 15
          CanTpSTmin = 0.02
          CanTpRxNSduRef = EcucPduCollection/msg_diag_Request_MyECU_oCAN_ca029ee7_Rx
          CanTpTxFcNPdu_29945216 (CanTpTxFcNPdu): CanTpTxFcNPduConfirmationPduId=0, CanTpTxFcNPduRef=msg_diag_Response_MyECU_Tp_oCAN_eec7d8e8_Tx
          CanTpRxNPdu_29945216 (CanTpRxNPdu): CanTpRxNPduId=0, CanTpRxNPduRef=msg_diag_Request_MyECU_Tp_oCAN_44a1d668_Rx
        CanTpTxNSdu_dab96b77 (CanTpTxNSdu):
          CanTpTxAddressingFormat = CANTP_STANDARD
          CanTpTxDl = 8
          CanTpTxTaType = CANTP_PHYSICAL
          CanTpNas = 0.1
          CanTpNcs = 0.2
          CanTpTc = false
          CanTpTxNSduId = 0
          CanTpTxPaddingActivation = CANTP_ON
          CanTpNbs = 0.5
          CanTpTxNSduRef = EcucPduCollection/msg_diag_Response_MyECU_oCAN_84acb98b_Tx
          CanTpTxNPdu_0b6e86e4 (CanTpTxNPdu): CanTpTxNPduConfirmationPduId=0, CanTpTxNPduRef=msg_diag_Response_MyECU_Tp_oCAN_eec7d8e8_Tx
          CanTpRxFcNPdu_0b6e86e4 (CanTpRxFcNPdu): CanTpRxFcNPduId=0, CanTpRxFcNPduRef=msg_diag_Request_MyECU_Tp_oCAN_44a1d668_Rx
  module config Det: implementation-config-variant=VARIANT-PRE-COMPILE, module-description=Det_Impl
    DetGeneral:
      DetVersionInfoApi = false
      DetEnableDet = true
      DetExtDebugSupport = true
      DetGlobalFilterSize = 10
      DetBreakFilterSize = 0
      DetLogBufferSize = 0
      DetReportErrorRecursionLimit = 0
      DetReportRuntimeErrorRecursionLimit = 0
      DetReportTransientFaultRecursionLimit = 0
      DetDltFilterSize = 0
    DetConfigSet
  module config PduR: implementation-config-variant=VARIANT-PRE-COMPILE, module-description=PduR_Impl
    PduRGeneral:
      PduRDevErrorDetect = true
      PduRVersionInfoApi = false
      PduRMetaDataSupport = false
      PduRPduCallback = false
      PduRSwitching = false
      PduRSafeBswChecks = false
      PduREnableDeferredTransmission = false
      PduREnableDeferredReception = false
      PduRSupportMulticore = false
      PduRGeneration:
        PduROutOfBoundsWriteProtectionStrategy = NONE
        PduROutOfBoundsWriteSanitizer = false
        PduROutOfBoundsReadSanitizer = false
        PduRNumericalDataTypeMinimizationStrategy = WITH_CAST
        PduRReduceConstantData2Define = false
        PduRBoolDataInArrayOfStructStrategy = BITMASKING
        PduRDeduplicateIndirectedData = true
        PduRDataDeduplicationStrategy = WITH_CAST
        PduRReduceBoolDataByNegationThreshold = 2
        PduRReduceBoolDataByNumericalComparisonThreshold = 2
        PduRReduceBoolDataByNumericalRelationThreshold = 2
        PduRReduceBoolDataByNumericalOperandStrategy = WITH_ANY_VALUE
        PduRReduceNumericalDataByOffsetThreshold = 2
        PduRReduceNumericalDataByArraySubtractionThreshold = 2
        PduRReduceDataByStreaming = false
        PduRShortSymbols = false
        PduRInterfacesForDeactivatedData = false
        PduRReferringKeysInComments = false
    PduRRoutingTables: PduRConfigurationId=0
      PduRRoutingTable
        20 x PduRRoutingPath, all with PduRLockRef=PduRLock_PduRExclusiveArea:
          msg_TxCycle_E2eProf1C_500_30_oCAN_eeefc687_Tx: PduRRoutingPathCommunicationType=COMMUNICATION_INTERFACE
            msg_TxCycle_E2eProf1C_500_30_oCAN_995018f6_Tx (PduRDestPdu):
              PduRDestPduHandleId = 4
              PduRDestPduDirection = TRANSMIT
              PduRDestPduRoutingType = API_FORWARDING
              PduRDestPduDataProcessing = IMMEDIATE
              PduRPduLengthHandlingStrategy = UNUSED
              PduRDestPduDataProvision = PDUR_DIRECT
              PduRTransmissionConfirmation = false
              PduRDestPduRef = EcucPduCollection/msg_TxCycle_E2eProf1C_500_30_oCAN_995018f6_Tx
              PduRDestPduPduRBswModulesRef = PduR/CanIf
            PduRSrcPdu_c3d2922e (PduRSrcPdu):
              PduRSourcePduHandleId = 4
              PduRSrcPduDirection = TRANSMIT
              PduRSrcPduRef = EcucPduCollection/msg_TxCycle_E2eProf1C_500_30_oCAN_eeefc687_Tx
              PduRSrcPduPduRBswModulesRef = PduR/Com
          msg_diag_RequestGlobal_oCAN_e06c7e2d_Rx: PduRRoutingPathCommunicationType=TRANSPORT_PROTOCOL
            msg_diag_RequestGlobal_oCAN_e06c7e2d_Rx_c958f031_Rx (PduRDestPdu):
              PduRDestPduHandleId = 0
              PduRDestPduDirection = RECEIVE
              PduRDestPduRoutingType = API_FORWARDING
              PduRDestPduDataProcessing = IMMEDIATE
              PduRPduLengthHandlingStrategy = UNUSED
              PduRDestPduRef = msg_diag_RequestGlobal_oCAN_2eba11fb_Rx
              PduRDestPduPduRBswModulesRef = PduR/Dcm
            PduRSrcPdu_c958f031 (PduRSrcPdu):
              PduRSourcePduHandleId = 0
              PduRSrcPduDirection = RECEIVE
              PduRSrcPduRef = EcucPduCollection/msg_diag_RequestGlobal_oCAN_e06c7e2d_Rx
              PduRSrcPduPduRBswModulesRef = PduR/CanTp
          msg_TxCycle10_0_oCAN_85bf3e37_Tx: PduRRoutingPathCommunicationType=COMMUNICATION_INTERFACE
            msg_TxCycle10_0_oCAN_2d7b6a87_Tx (PduRDestPdu):
              PduRDestPduHandleId = 2
              PduRDestPduDirection = TRANSMIT
              PduRDestPduRoutingType = API_FORWARDING
              PduRDestPduDataProcessing = IMMEDIATE
              PduRPduLengthHandlingStrategy = UNUSED
              PduRDestPduDataProvision = PDUR_DIRECT
              PduRTransmissionConfirmation = false
              PduRDestPduRef = EcucPduCollection/msg_TxCycle10_0_oCAN_2d7b6a87_Tx
              PduRDestPduPduRBswModulesRef = PduR/CanIf
            PduRSrcPdu_2e41d513 (PduRSrcPdu):
              PduRSourcePduHandleId = 2
              PduRSrcPduDirection = TRANSMIT
              PduRSrcPduRef = EcucPduCollection/msg_TxCycle10_0_oCAN_85bf3e37_Tx
              PduRSrcPduPduRBswModulesRef = PduR/Com
          msg_diag_Uudt_Response_MyECU_oCAN_f130d337_Tx: PduRRoutingPathCommunicationType=COMMUNICATION_INTERFACE
            PduRSrcPdu_ec58e685 (PduRSrcPdu):
              PduRSourcePduHandleId = 9
              PduRSrcPduDirection = TRANSMIT
              PduRSrcPduRef = EcucPduCollection/msg_diag_Uudt_Response_MyECU_oCAN_f130d337_Tx
              PduRSrcPduPduRBswModulesRef = PduR/Dcm
            msg_diag_Uudt_Response_MyECU_oCAN_e0fa8c3a_Tx (PduRDestPdu):
              PduRDestPduHandleId = 8
              PduRDestPduDirection = TRANSMIT
              PduRDestPduRoutingType = API_FORWARDING
              PduRDestPduDataProcessing = IMMEDIATE
              PduRPduLengthHandlingStrategy = UNUSED
              PduRDestPduDataProvision = PDUR_DIRECT
              PduRTransmissionConfirmation = true
              PduRDestPduRef = EcucPduCollection/msg_diag_Uudt_Response_MyECU_oCAN_e0fa8c3a_Tx
              PduRDestPduPduRBswModulesRef = PduR/CanIf
          msg_StartAppl_Tx_MyECU_oCAN_ad461e3f_Tx: PduRRoutingPathCommunicationType=COMMUNICATION_INTERFACE
            msg_StartAppl_Tx_MyECU_oCAN_c14d78df_Tx (PduRDestPdu):
              PduRDestPduHandleId = 1
              PduRDestPduDirection = TRANSMIT
              PduRDestPduRoutingType = API_FORWARDING
              PduRDestPduDataProcessing = IMMEDIATE
              PduRPduLengthHandlingStrategy = UNUSED
              PduRDestPduDataProvision = PDUR_DIRECT
              PduRTransmissionConfirmation = false
              PduRDestPduRef = EcucPduCollection/msg_StartAppl_Tx_MyECU_oCAN_c14d78df_Tx
              PduRDestPduPduRBswModulesRef = PduR/CanIf
            PduRSrcPdu_cd5f4416 (PduRSrcPdu):
              PduRSourcePduHandleId = 1
              PduRSrcPduDirection = TRANSMIT
              PduRSrcPduRef = EcucPduCollection/msg_StartAppl_Tx_MyECU_oCAN_ad461e3f_Tx
              PduRSrcPduPduRBswModulesRef = PduR/Com
          msg_RxEvent_20_oCAN_13517c6b_Rx: PduRRoutingPathCommunicationType=COMMUNICATION_INTERFACE
            msg_RxEvent_20_oCAN_13517c6b_Rx_37e6280b_Rx (PduRDestPdu):
              PduRDestPduHandleId = 4
              PduRDestPduDirection = RECEIVE
              PduRDestPduRoutingType = API_FORWARDING
              PduRDestPduDataProcessing = IMMEDIATE
              PduRPduLengthHandlingStrategy = UNUSED
              PduRTransmissionConfirmation = false
              PduRDestPduRef = EcucPduCollection/msg_RxEvent_20_oCAN_a1df81ad_Rx
              PduRDestPduPduRBswModulesRef = PduR/Com
            PduRSrcPdu_37e6280b (PduRSrcPdu):
              PduRSourcePduHandleId = 4
              PduRSrcPduDirection = RECEIVE
              PduRSrcPduRef = EcucPduCollection/msg_RxEvent_20_oCAN_13517c6b_Rx
              PduRSrcPduPduRBswModulesRef = PduR/CanIf
          msg_diag_Request_MyECU_oCAN_ca029ee7_Rx: PduRRoutingPathCommunicationType=TRANSPORT_PROTOCOL
            PduRSrcPdu_9fd2cbe7 (PduRSrcPdu):
              PduRSourcePduHandleId = 1
              PduRSrcPduDirection = RECEIVE
              PduRSrcPduRef = EcucPduCollection/msg_diag_Request_MyECU_oCAN_ca029ee7_Rx
              PduRSrcPduPduRBswModulesRef = PduR/CanTp
            msg_diag_Request_MyECU_oCAN_ca029ee7_Rx_9fd2cbe7_Rx (PduRDestPdu):
              PduRDestPduHandleId = 1
              PduRDestPduDirection = RECEIVE
              PduRDestPduRoutingType = API_FORWARDING
              PduRDestPduDataProcessing = IMMEDIATE
              PduRPduLengthHandlingStrategy = UNUSED
              PduRDestPduRef = msg_diag_Request_MyECU_oCAN_cd2e72ff_Rx
              PduRDestPduPduRBswModulesRef = PduR/Dcm
          msg_TxEvent_10_oCAN_b2cd4fc2_Tx: PduRRoutingPathCommunicationType=COMMUNICATION_INTERFACE
            msg_TxEvent_10_oCAN_b9443fef_Tx (PduRDestPdu):
              PduRDestPduHandleId = 5
              PduRDestPduDirection = TRANSMIT
              PduRDestPduRoutingType = API_FORWARDING
              PduRDestPduDataProcessing = IMMEDIATE
              PduRPduLengthHandlingStrategy = UNUSED
              PduRDestPduDataProvision = PDUR_DIRECT
              PduRTransmissionConfirmation = false
              PduRDestPduRef = EcucPduCollection/msg_TxEvent_10_oCAN_b9443fef_Tx
              PduRDestPduPduRBswModulesRef = PduR/CanIf
            PduRSrcPdu_36788591 (PduRSrcPdu):
              PduRSourcePduHandleId = 5
              PduRSrcPduDirection = TRANSMIT
              PduRSrcPduRef = EcucPduCollection/msg_TxEvent_10_oCAN_b2cd4fc2_Tx
              PduRSrcPduPduRBswModulesRef = PduR/Com
          msg_diag_Response_MyECU_oCAN_06426912_Tx: PduRRoutingPathCommunicationType=TRANSPORT_PROTOCOL
            msg_diag_Response_MyECU_oCAN_84acb98b_Tx (PduRDestPdu):
              PduRDestPduHandleId = 0
              PduRDestPduDirection = TRANSMIT
              PduRDestPduRoutingType = API_FORWARDING
              PduRDestPduDataProcessing = IMMEDIATE
              PduRPduLengthHandlingStrategy = UNUSED
              PduRDestPduRef = EcucPduCollection/msg_diag_Response_MyECU_oCAN_84acb98b_Tx
              PduRDestPduPduRBswModulesRef = PduR/CanTp
            PduRSrcPdu_f3446321 (PduRSrcPdu):
              PduRSourcePduHandleId = 8
              PduRSrcPduDirection = TRANSMIT
              PduRSrcPduRef = EcucPduCollection/msg_diag_Response_MyECU_oCAN_06426912_Tx
              PduRSrcPduPduRBswModulesRef = PduR/Dcm
          msg_RxCycle100_0_oCAN_c71398f9_Rx: PduRRoutingPathCommunicationType=COMMUNICATION_INTERFACE
            PduRSrcPdu_9e00b2d3 (PduRSrcPdu):
              PduRSourcePduHandleId = 1
              PduRSrcPduDirection = RECEIVE
              PduRSrcPduRef = EcucPduCollection/msg_RxCycle100_0_oCAN_c71398f9_Rx
              PduRSrcPduPduRBswModulesRef = PduR/CanIf
            msg_RxCycle100_0_oCAN_c71398f9_Rx_9e00b2d3_Rx (PduRDestPdu):
              PduRDestPduHandleId = 1
              PduRDestPduDirection = RECEIVE
              PduRDestPduRoutingType = API_FORWARDING
              PduRDestPduDataProcessing = IMMEDIATE
              PduRPduLengthHandlingStrategy = UNUSED
              PduRTransmissionConfirmation = false
              PduRDestPduRef = EcucPduCollection/msg_RxCycle100_0_oCAN_1e247d16_Rx
              PduRDestPduPduRBswModulesRef = PduR/Com
          msg_TxCycle1000_10_oCAN_d74aed68_Tx: PduRRoutingPathCommunicationType=COMMUNICATION_INTERFACE
            msg_TxCycle1000_10_oCAN_6dd6f284_Tx (PduRDestPdu):
              PduRDestPduHandleId = 3
              PduRDestPduDirection = TRANSMIT
              PduRDestPduRoutingType = API_FORWARDING
              PduRDestPduDataProcessing = IMMEDIATE
              PduRPduLengthHandlingStrategy = UNUSED
              PduRDestPduDataProvision = PDUR_DIRECT
              PduRTransmissionConfirmation = false
              PduRDestPduRef = EcucPduCollection/msg_TxCycle1000_10_oCAN_6dd6f284_Tx
              PduRDestPduPduRBswModulesRef = PduR/CanIf
            PduRSrcPdu_704563f1 (PduRSrcPdu):
              PduRSourcePduHandleId = 3
              PduRSrcPduDirection = TRANSMIT
              PduRSrcPduRef = EcucPduCollection/msg_TxCycle1000_10_oCAN_d74aed68_Tx
              PduRSrcPduPduRBswModulesRef = PduR/Com
          msg_RxCycle_E2eProf1C_500_10_oCAN_23e9789c_Rx: PduRRoutingPathCommunicationType=COMMUNICATION_INTERFACE
            msg_RxCycle_E2eProf1C_500_10_oCAN_23e9789c_Rx_01c8980f_Rx (PduRDestPdu):
              PduRDestPduHandleId = 3
              PduRDestPduDirection = RECEIVE
              PduRDestPduRoutingType = API_FORWARDING
              PduRDestPduDataProcessing = IMMEDIATE
              PduRPduLengthHandlingStrategy = UNUSED
              PduRTransmissionConfirmation = false
              PduRDestPduRef = EcucPduCollection/msg_RxCycle_E2eProf1C_500_10_oCAN_e8110737_Rx
              PduRDestPduPduRBswModulesRef = PduR/Com
            PduRSrcPdu_01c8980f (PduRSrcPdu):
              PduRSourcePduHandleId = 3
              PduRSrcPduDirection = RECEIVE
              PduRSrcPduRef = EcucPduCollection/msg_RxCycle_E2eProf1C_500_10_oCAN_23e9789c_Rx
              PduRSrcPduPduRBswModulesRef = PduR/CanIf
          msg_StartAppl_Rx_MyECU_oCAN_fe93a56e_Rx: PduRRoutingPathCommunicationType=COMMUNICATION_INTERFACE
            PduRSrcPdu_7a86d966 (PduRSrcPdu):
              PduRSourcePduHandleId = 5
              PduRSrcPduDirection = RECEIVE
              PduRSrcPduRef = EcucPduCollection/msg_StartAppl_Rx_MyECU_oCAN_fe93a56e_Rx
              PduRSrcPduPduRBswModulesRef = PduR/CanIf
            msg_StartAppl_Rx_MyECU_oCAN_fe93a56e_Rx_7a86d966_Rx (PduRDestPdu):
              PduRDestPduHandleId = 5
              PduRDestPduDirection = RECEIVE
              PduRDestPduRoutingType = API_FORWARDING
              PduRDestPduDataProcessing = IMMEDIATE
              PduRPduLengthHandlingStrategy = UNUSED
              PduRTransmissionConfirmation = false
              PduRDestPduRef = EcucPduCollection/msg_StartAppl_Rx_MyECU_oCAN_0da3c1e2_Rx
              PduRDestPduPduRBswModulesRef = PduR/Com
          msg_RxCycle500_20_oCAN_266969e8_Rx: PduRRoutingPathCommunicationType=COMMUNICATION_INTERFACE
            PduRSrcPdu_b1d1dd8a (PduRSrcPdu):
              PduRSourcePduHandleId = 2
              PduRSrcPduDirection = RECEIVE
              PduRSrcPduRef = EcucPduCollection/msg_RxCycle500_20_oCAN_266969e8_Rx
              PduRSrcPduPduRBswModulesRef = PduR/CanIf
            msg_RxCycle500_20_oCAN_266969e8_Rx_b1d1dd8a_Rx (PduRDestPdu):
              PduRDestPduHandleId = 2
              PduRDestPduDirection = RECEIVE
              PduRDestPduRoutingType = API_FORWARDING
              PduRDestPduDataProcessing = IMMEDIATE
              PduRPduLengthHandlingStrategy = UNUSED
              PduRTransmissionConfirmation = false
              PduRDestPduRef = EcucPduCollection/msg_RxCycle500_20_oCAN_a691adb3_Rx
              PduRDestPduPduRBswModulesRef = PduR/Com
          msg_diag_Request_MyECU_Slave3_oCAN_87f08505_Rx: PduRRoutingPathCommunicationType=COMMUNICATION_INTERFACE
            PduRDestPdu:
              PduRDestPduHandleId = 7
              PduRDestPduDirection = RECEIVE
              PduRDestPduRoutingType = API_FORWARDING
              PduRDestPduDataProcessing = IMMEDIATE
              PduRPduLengthHandlingStrategy = UNUSED
              PduRTransmissionConfirmation = false
              PduRDestPduRef = EcucPduCollection/msg_diag_Request_MyECU_Slave3_oCAN_87f08505_Rx
              PduRDestPduPduRBswModulesRef = Cdd_Com
            PduRSrcPdu:
              PduRSourcePduHandleId = 7
              PduRSrcPduDirection = RECEIVE
              PduRSrcPduRef = EcucPduCollection/msg_diag_Request_MyECU_Slave3_oCAN_87f08505_Rx
              PduRSrcPduPduRBswModulesRef = PduR/CanIf
          GlobalTimeMaster_oCAN_48f281bc_Rx: PduRRoutingPathCommunicationType=COMMUNICATION_INTERFACE
            PduRDestPdu_2 (PduRDestPdu):
              PduRDestPduHandleId = 0
              PduRDestPduDirection = RECEIVE
              PduRDestPduRoutingType = API_FORWARDING
              PduRDestPduDataProcessing = IMMEDIATE
              PduRPduLengthHandlingStrategy = UNUSED
              PduRTransmissionConfirmation = false
              PduRDestPduRef = EcucPduCollection/GlobalTimeMaster_oCAN_48f281bc_Rx
              PduRDestPduPduRBswModulesRef = Cdd_Com
            PduRSrcPdu_2 (PduRSrcPdu):
              PduRSourcePduHandleId = 0
              PduRSrcPduDirection = RECEIVE
              PduRSrcPduRef = EcucPduCollection/GlobalTimeMaster_oCAN_48f281bc_Rx
              PduRSrcPduPduRBswModulesRef = PduR/CanIf
          msg_diag_Response_MyECU_Slave3_oCAN_659398e3_Tx: PduRRoutingPathCommunicationType=COMMUNICATION_INTERFACE
            PduRSrcPdu_1 (PduRSrcPdu):
              PduRSourcePduHandleId = 7
              PduRSrcPduDirection = TRANSMIT
              PduRSrcPduRef = EcucPduCollection/msg_diag_Response_MyECU_Slave3_oCAN_659398e3_Tx
              PduRSrcPduPduRBswModulesRef = Cdd_Com
            PduRDestPdu_001 (PduRDestPdu):
              PduRDestPduHandleId = 7
              PduRDestPduDirection = TRANSMIT
              PduRDestPduRoutingType = API_FORWARDING
              PduRDestPduDataProcessing = IMMEDIATE
              PduRPduLengthHandlingStrategy = UNUSED
              PduRDestPduDataProvision = PDUR_DIRECT
              PduRTransmissionConfirmation = true
              PduRDestPduRef = EcucPduCollection/msg_diag_Response_MyECU_Slave3_oCAN_659398e3_Tx
              PduRDestPduPduRBswModulesRef = PduR/CanIf
          msg_XCP_Request_MyECU_oCAN_24ce420e_Rx: PduRRoutingPathCommunicationType=COMMUNICATION_INTERFACE
            PduRDestPdu_1 (PduRDestPdu):
              PduRDestPduHandleId = 6
              PduRDestPduDirection = RECEIVE
              PduRDestPduRoutingType = API_FORWARDING
              PduRDestPduDataProcessing = IMMEDIATE
              PduRPduLengthHandlingStrategy = UNUSED
              PduRTransmissionConfirmation = false
              PduRDestPduRef = EcucPduCollection/msg_XCP_Request_MyECU_oCAN_24ce420e_Rx
              PduRDestPduPduRBswModulesRef = Cdd_Com
            PduRSrcPdu_3 (PduRSrcPdu):
              PduRSourcePduHandleId = 6
              PduRSrcPduDirection = RECEIVE
              PduRSrcPduRef = EcucPduCollection/msg_XCP_Request_MyECU_oCAN_24ce420e_Rx
              PduRSrcPduPduRBswModulesRef = PduR/CanIf
          msg_XCP_Response_MyECU_oCAN_5d942f8b_Tx: PduRRoutingPathCommunicationType=COMMUNICATION_INTERFACE
            PduRDestPdu_3 (PduRDestPdu):
              PduRDestPduHandleId = 6
              PduRDestPduDirection = TRANSMIT
              PduRDestPduRoutingType = API_FORWARDING
              PduRDestPduDataProcessing = IMMEDIATE
              PduRPduLengthHandlingStrategy = UNUSED
              PduRTransmissionConfirmation = true
              PduRDestPduDataProvision = PDUR_DIRECT
              PduRDestPduRef = EcucPduCollection/msg_XCP_Response_MyECU_oCAN_5d942f8b_Tx
              PduRDestPduPduRBswModulesRef = PduR/CanIf
            PduRSrcPdu_4 (PduRSrcPdu):
              PduRSourcePduHandleId = 6
              PduRSrcPduDirection = TRANSMIT
              PduRSrcPduRef = EcucPduCollection/msg_XCP_Response_MyECU_oCAN_5d942f8b_Tx
              PduRSrcPduPduRBswModulesRef = Cdd_Com
          PduRRoutingPath: PduRRoutingPathCommunicationType=COMMUNICATION_INTERFACE
            PduRDestPdu_4 (PduRDestPdu):
              PduRDestPduHandleId = 0
              PduRDestPduDirection = TRANSMIT
              PduRDestPduRoutingType = API_FORWARDING
              PduRDestPduDataProcessing = IMMEDIATE
              PduRPduLengthHandlingStrategy = UNUSED
              PduRDestPduDataProvision = PDUR_TRIGGERTRANSMIT
              PduRTransmissionConfirmation = false
              PduRDestPduRef = Pdu_NmOsekUserDataTxPdu
              PduRDestPduPduRBswModulesRef = PduR/NmOsek
            PduRSrcPdu_5 (PduRSrcPdu): PduRSourcePduHandleId=0, PduRSrcPduDirection=TRANSMIT, PduRSrcPduRef=Pdu_NmOsekUserDataTxPdu, PduRSrcPduPduRBswModulesRef=PduR/Com
      PduRLock_PduRExclusiveArea (PduRLock)
        PduRExclusiveArea: PduRExclusiveAreaId=0
    6 x PduRBswModules, all with PduRCancelReceive=false, PduRChangeParameterRequestApi=false:
      CanIf: PduRCancelTransmit=true, PduRCommunicationInterface=true, PduRLowerModule=true, PduRTransportProtocol=false, PduRTriggertransmit=false, PduRTxConfirmation=true, PduRUpperModule=false, PduRUseTag=false, PduRBswModuleRef=CanIf
      CanTp: PduRCancelTransmit=true, PduRCommunicationInterface=false, PduRLowerModule=true, PduRTransportProtocol=true, PduRTriggertransmit=false, PduRTxConfirmation=false, PduRUpperModule=false, PduRUseTag=false, PduRBswModuleRef=CanTp
      Com: PduRCancelTransmit=false, PduRCommunicationInterface=true, PduRLowerModule=false, PduRTransportProtocol=false, PduRTriggertransmit=true, PduRTxConfirmation=false, PduRUpperModule=true, PduRUseTag=false, PduRBswModuleRef=Com
      Dcm: PduRCancelTransmit=true, PduRCommunicationInterface=true, PduRLowerModule=false, PduRTransportProtocol=true, PduRTriggertransmit=false, PduRTxConfirmation=true, PduRUpperModule=true, PduRUseTag=true, PduRBswModuleRef=Dcm
      Cdd_Com: PduRCancelTransmit=false, PduRCommunicationInterface=true, PduRLowerModule=false, PduRTransportProtocol=false, PduRTriggertransmit=false, PduRTxConfirmation=true, PduRUpperModule=true, PduRUseTag=false, PduRBswModuleRef=Cdd_Com
      NmOsek: PduRCancelTransmit=false, PduRCommunicationInterface=true, PduRLowerModule=true, PduRTransportProtocol=false, PduRTriggertransmit=true, PduRTxConfirmation=false, PduRUpperModule=false, PduRUseTag=false, PduRBswModuleRef=NmOsek
  module config EcuM: implementation-config-variant=VARIANT-PRE-COMPILE, module-description=EcuM_Impl
    EcuMConfiguration
      EcuMFlexConfiguration: EcuMFlexModuleConfigurationRef=CanConfigSet, EcuMNormalMcuModeRef=McuModeSettingConf_0
        ECUM_CAUSE_UNKNOWN (EcuMShutdownCause): EcuMShutdownCauseId=0
        ECUM_RESET_IO (EcuMResetMode): EcuMResetModeId=2
        ECUM_RESET_MCU (EcuMResetMode): EcuMResetModeId=0
        ECUM_CAUSE_DCM (EcuMShutdownCause): EcuMShutdownCauseId=3
        ECUM_RESET_WAKEUP (EcuMResetMode): EcuMResetModeId=3
        ECUM_CAUSE_ECU_STATE (EcuMShutdownCause): EcuMShutdownCauseId=1
        ECUM_RESET_WDG (EcuMResetMode): EcuMResetModeId=1
        ECUM_CAUSE_WDGM (EcuMShutdownCause): EcuMShutdownCauseId=2
      EcuMCommonConfiguration: EcuMConfigConsistencyHash=10679597781477036655, EcuMDefaultAppMode=OSDEFAULTAPPMODE, EcuMOSResource=OsResource_EcuM
        4 x EcuMWakeupSource, all with EcuMValidationTimeout=0, EcuMCheckWakeupTimeout=0, EcuMWakeupSourcePolling=false:
          ECUM_WKSOURCE_POWER: EcuMWakeupSourceId=0
          ECUM_WKSOURCE_INTERNAL_WDG: EcuMWakeupSourceId=3
          ECUM_WKSOURCE_INTERNAL_RESET: EcuMWakeupSourceId=2
          ECUM_WKSOURCE_RESET: EcuMWakeupSourceId=1
        EcuMDefaultShutdownTarget: EcuMDefaultState=EcuMStateOff
        ECUM_WKSOURCE_EXTERNAL_WDG (EcuMWakeupSource): EcuMWakeupSourceId=4, EcuMValidationTimeout=0, EcuMCheckWakeupTimeout=0, EcuMWakeupSourcePolling=false
        EcuMDriverInitListZero
          17 x EcuMDriverInitItem:
            BswM_InitMemory: index=0, EcuMModuleID=BswM, EcuMModuleService=BswM_InitMemory, EcuMModuleHeader=BswM.h
            CanIf_InitMemory: index=1, EcuMModuleID=CanIf, EcuMModuleService=CanIf_InitMemory, EcuMModuleHeader=CanIf.h
            CanSM_InitMemory: index=2, EcuMModuleID=CanSM, EcuMModuleService=CanSM_InitMemory, EcuMModuleHeader=CanSM_EcuM.h
            CanTp_InitMemory: index=3, EcuMModuleID=CanTp, EcuMModuleService=CanTp_InitMemory, EcuMModuleHeader=CanTp.h
            Can_InitMemory: index=4, EcuMModuleID=Can, EcuMModuleService=Can_InitMemory, EcuMModuleHeader=Can.h
            ComM_InitMemory: index=5, EcuMModuleID=ComM, EcuMModuleService=ComM_InitMemory, EcuMModuleHeader=ComM.h
            Com_InitMemory: index=6, EcuMModuleID=Com, EcuMModuleService=Com_InitMemory, EcuMModuleHeader=Com.h
            Dcm_InitMemory: index=7, EcuMModuleID=Dcm, EcuMModuleService=Dcm_InitMemory, EcuMModuleHeader=Dcm.h
            Dem_InitMemory: index=8, EcuMModuleID=Dem, EcuMModuleService=Dem_InitMemory, EcuMModuleHeader=Dem.h
            Det_InitMemory: index=9, EcuMModuleID=Det, EcuMModuleService=Det_InitMemory, EcuMModuleHeader=Det.h
            Nm_InitMemory: index=10, EcuMModuleID=Nm, EcuMModuleService=Nm_InitMemory, EcuMModuleHeader=Nm.h
            PduR_InitMemory: index=11, EcuMModuleID=PduR, EcuMModuleService=PduR_InitMemory, EcuMModuleHeader=PduR.h
            Rte_InitMemory: index=12, EcuMModuleID=Rte, EcuMModuleService=Rte_InitMemory, EcuMModuleHeader=Rte_Main.h
            RamTst_InitMemory: index=13, EcuMModuleID=RamTst, EcuMModuleService=RamTst_InitMemory, EcuMModuleHeader=RamTst.h
            Dem_PreInit: index=14, EcuMModuleID=Dem, EcuMModuleService=Dem_PreInit, EcuMModuleHeader=Dem.h
            Det_Init: index=15, EcuMModuleID=Det, EcuMModuleService=Det_Init, EcuMModuleHeader=Det.h
            NmOsek_InitMemory: index=16, EcuMModuleID=NmOsek, EcuMModuleService=NmOsek_InitMemory, EcuMModuleHeader=NmOsek.h
        EcuMDriverInitListOne
          12 x EcuMDriverInitItem:
            Mcu_Init: index=0, EcuMModuleID=Mcu, EcuMModuleService=Mcu_Init, EcuMModuleHeader=CDD_Mcl.h
            Mcu_InitClock: index=12, EcuMModuleID=Code, EcuMAdditionalInitCode=Mcu_InitClock(McuConf_McuClockSettingConfig_McuClockSettingConfig_0); while (Mcu_GetPllStatus() != MCU_PLL_LOCKED) { /* Wait until PLL is locked */ } Mcu_DistributePllClock();
            Port_Init: index=1, EcuMModuleID=Port, EcuMModuleService=Port_Init, EcuMModuleHeader=Port.h
            Gpt_Init: index=2, EcuMModuleID=Gpt, EcuMModuleService=Gpt_Init, EcuMModuleHeader=Gpt.h
            Mcl_Init: index=3, EcuMModuleID=Mcl, EcuMModuleService=Mcl_Init, EcuMModuleHeader=CDD_Mcl.h
            Eep_Init: index=17, EcuMModuleID=Eep, EcuMModuleService=Eep_Init, EcuMModuleHeader=Eep_Api.h
            Pwm_Init: index=4, EcuMModuleID=Pwm, EcuMModuleService=Pwm_Init, EcuMModuleHeader=Pwm.h
            Wdg_Init: index=14, EcuMModuleID=Code, EcuMModuleHeader=Wdg.h, EcuMAdditionalInitCode=Wdg_Init( &WdgSettingsConfig_0 );
            BrsHw_EnableHwAccess: index=16, EcuMModuleID=Brs, EcuMModuleService=BrsHw_EnableHwAccess, EcuMModuleHeader=BrsHw.h
            Adc_Init: index=8, EcuMModuleID=Adc, EcuMModuleService=Adc_Init, EcuMModuleHeader=Adc.h
            Icu_Init: index=10, EcuMModuleID=Icu, EcuMModuleService=Icu_Init, EcuMModuleHeader=Icu.h
            Spi_Init: index=13, EcuMModuleID=Code, EcuMAdditionalInitCode=Spi_Init( &Spi_PBCfgVariantPredefined );, EcuMModuleHeader=Spi.h
        CN_CAN_fe6ecc87 (EcuMWakeupSource): EcuMWakeupSourceId=5, EcuMWakeupSourcePolling=false, EcuMComMChannelRef=ComMConfigSet/CN_CAN_fe6ecc87
        EcuMDriverRestartList
    EcuMGeneral:
      EcuMDevErrorDetect = true
      EcuMIncludeDem = true
      EcuMIncludeDet = true
      EcuMMainFunctionPeriod = 0.01
      EcuMVersionInfoApi = false
      EcuMDeferredBswMNotification = false
      EcuMSlaveCoreHandling = true
      EcuMEnableFixBehavior = false
      EcuMNonChannelWakeupInRun = false
      EcuMGeneration: EcuMOutOfBoundsWriteSanitizer=false, EcuMOutOfBoundsReadSanitizer=false, EcuMInterfacesForDeactivatedData=false
    EcuMFlexGeneral: EcuMAlarmClockPresent=false, EcuMResetLoopDetection=false, EcuMEnableDefBehaviour=false
  module config CanSM: implementation-config-variant=VARIANT-PRE-COMPILE, module-description=CanSM_Impl
    CanSMConfiguration: CanSMModeRequestRepetitionMax=10, CanSMModeRequestRepetitionTime=0.1
      CHNL_346f2748 (CanSMManagerNetwork):
        CanSMBorCounterL1ToL2 = 5
        CanSMBorTimeL1 = 1
        CanSMBorTimeL2 = 1
        CanSMBorTimeTxEnsured = 5
        CanSMBorTxConfirmationPolling = false
        CanSMComMNetworkHandleRef = ComMConfigSet/CN_CAN_fe6ecc87
        CT_CAN_956be4cd (CanSMController): CanSMControllerId=CanIfCtrlDrvCfg_7d254554/CT_CAN_d43e43a4
    CanSMGeneral:
      CanSMDevErrorDetect = true
      CanSMMainFunctionTimePeriod = 0.01
      CanSMVersionInfoApi = false
      CanSMBorCheckLevel = false
      CanSMSetBaudrateApi = false
      CanSMBusOffBegin = NmOsek_CanSM_BusOffBegin
      CanSMBusOffEnd = NmOsek_CanSM_BusOffEnd
      CanSMGeneration: CanSMOutOfBoundsWriteSanitizer=false, CanSMOutOfBoundsReadSanitizer=false
