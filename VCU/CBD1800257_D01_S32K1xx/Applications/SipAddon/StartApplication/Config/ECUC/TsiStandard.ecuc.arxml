[part 5 of 5: packages /ActiveEcuC to /Mcu]
AUTOSAR XML (schema 4-2-1)
package /ActiveEcuC  (continued)
  module config BswM: implementation-config-variant=VARIANT-PRE-COMPILE, module-description=BswM_Impl
    BswMGeneral:
      BswMCanSMEnabled = true
      BswMComMEnabled = true
      BswMDcmEnabled = true
      BswMDevErrorDetect = true
      BswMEcuMEnabled = true
      BswMEthIfEnabled = false
      BswMEthSMEnabled = false
      BswMFrSMEnabled = false
      BswMGenericRequestEnabled = true
      BswMJ1939DcmEnabled = false
      BswMJ1939NmEnabled = false
      BswMLinSMEnabled = false
      BswMLinTPEnabled = false
      BswMNmEnabled = false
      BswMNvMEnabled = true
      BswMPduREnabled = false
      BswMRuleControlEnabled = false
      BswMSdEnabled = false
      BswMVersionInfoApi = false
      BswMWdgMEnabled = true
      BswMModeCheck = true
      BswMActionListQueueSearchAlgorithm = LINEAR_SEARCH
      BswMMainFunctionPeriod = 0.01
      BswMCommonData
      BswMGeneration:
        BswMOutOfBoundsWriteSanitizer = false
        BswMOutOfBoundsReadSanitizer = false
        BswMReduceConstantData2Define = true
        BswMReduceDataByStreaming = false
        BswMBoolDataInArrayOfStructStrategy = BITMASKING
        BswMInterfacesForDeactivatedData = false
    BswMConfig
      BswMArbitration
        ESH_RunToPostRun (BswMRule):
          BswMNestedExecutionOnly = false
          BswMRuleId = 9
          BswMRuleInitState = BSWM_FALSE
          BswMRuleExpressionRef = ESH_LE_RunToPostRunTransition
          BswMRuleTrueActionList = ESH_AL_ExitRun
        ESH_Cond_StateIsRun (BswMModeCondition): BswMConditionType=BSWM_EQUALS, BswMConditionMode=ESH_State
          BswMConditionValue
            BswMBswMode: BswMBswRequestedMode=ESH_RUN
        ESH_State (BswMModeRequestPort): BswMArbitrateOnInit=true, BswMRequestProcessing=BSWM_IMMEDIATE
          BswMModeRequestSource
            BswMGenericRequest: BswMModeRequesterId=230, BswMRequestedModeMax=7
              7 x BswMGenericRequestMode:
                ESH_INIT: BswMGenericRequestModeValue=0
                ESH_RUN: BswMGenericRequestModeValue=1
                ESH_POST_RUN: BswMGenericRequestModeValue=2
                ESH_PREP_SHUTDOWN: BswMGenericRequestModeValue=3
                ESH_WAIT_FOR_NVM: BswMGenericRequestModeValue=4
                ESH_SHUTDOWN: BswMGenericRequestModeValue=5
                ESH_WAKEUP: BswMGenericRequestModeValue=6
          BswMModeInitValue
            BswMBswModeInitValue: BswMBswModeInitValueMode=ESH_INIT
        ESH_LE_RunReleased (BswMLogicalExpression): BswMLogicalOperator=BSWM_AND, BswMArgumentRef=ESH_Cond_RunRequest0IsReleased, BswMArgumentRef=ESH_Cond_RunRequest1IsReleased
        ESH_Cond_RunRequest0IsReleased (BswMModeCondition): BswMConditionType=BSWM_EQUALS, BswMConditionMode=ESH_RunRequest_0
          BswMConditionValue
            BswMModeDeclaration: BswMModeValueRef=RELEASED
        ESH_RunRequest_0 (BswMModeRequestPort): BswMArbitrateOnInit=false, BswMRequestProcessing=BSWM_DEFERRED
          BswMModeRequestSource
            BswMSwcModeRequest: BswMModeRequestDataElementPrototypeName=requestedMode, BswMSwcModeRequestModeDeclarationGroupPrototypeRef=BswM_MDGP_ESH_RunRequest
          BswMModeInitValue
            BswMSwcModeInitValue: BswMSwcModeInitValueRef=RELEASED
        ESH_Cond_RunRequest1IsReleased (BswMModeCondition): BswMConditionType=BSWM_EQUALS, BswMConditionMode=ESH_RunRequest_1
          BswMConditionValue
            BswMModeDeclaration: BswMModeValueRef=RELEASED
        ESH_RunRequest_1 (BswMModeRequestPort): BswMArbitrateOnInit=false, BswMRequestProcessing=BSWM_DEFERRED
          BswMModeRequestSource
            BswMSwcModeRequest: BswMModeRequestDataElementPrototypeName=requestedMode, BswMSwcModeRequestModeDeclarationGroupPrototypeRef=BswM_MDGP_ESH_RunRequest
          BswMModeInitValue
            BswMSwcModeInitValue: BswMSwcModeInitValueRef=RELEASED
        ESH_Cond_SelfRunReqTimerExpired (BswMModeCondition): BswMConditionType=BSWM_EQUALS, BswMConditionMode=ESH_SelfRunRequestTimer
          BswMConditionValue
            BswMBswMode: BswMBswRequestedMode=BSWM_TIMER_EXPIRED
        ESH_SelfRunRequestTimer (BswMModeRequestPort): BswMArbitrateOnInit=false, BswMRequestProcessing=BSWM_DEFERRED
          BswMModeRequestSource
            BswMTimer
          BswMModeInitValue
            BswMBswModeInitValue: BswMBswModeInitValueMode=BSWM_TIMER_STOPPED
        ESH_Cond_ModeIsRun (BswMModeCondition): BswMConditionType=BSWM_EQUALS, BswMConditionMode=ESH_ModeNotification
          BswMConditionValue
            BswMModeDeclaration: BswMModeValueRef=RUN
        ESH_ModeNotification (BswMModeRequestPort): BswMArbitrateOnInit=false, BswMRequestProcessing=BSWM_DEFERRED
          BswMModeRequestSource
            BswMSwcModeNotification: BswMSwcModeNotificationModeDeclarationGroupPrototypeRef=BswM_MDGP_ESH_Mode
          BswMModeInitValue
            BswMSwcModeInitValue: BswMSwcModeInitValueRef=STARTUP
        ESH_WaitToShutdown (BswMRule):
          BswMNestedExecutionOnly = false
          BswMRuleId = 11
          BswMRuleInitState = BSWM_FALSE
          BswMRuleExpressionRef = ESH_LE_WaitForNvMToShutdown
          BswMRuleTrueActionList = ESH_AL_WaitForNvMToShutdown
        ESH_LE_WaitForNvMToShutdown (BswMLogicalExpression): BswMLogicalOperator=BSWM_AND, BswMArgumentRef=ESH_LE_NoWakeup, BswMArgumentRef=ESH_Cond_StateIsWaitForNvm, BswMArgumentRef=ESH_LE_WriteNotPending
        ESH_Cond_StateIsWaitForNvm (BswMModeCondition): BswMConditionType=BSWM_EQUALS, BswMConditionMode=ESH_State
          BswMConditionValue
            BswMBswMode: BswMBswRequestedMode=ESH_WAIT_FOR_NVM
        ESH_LE_WriteNotPending (BswMLogicalExpression): BswMLogicalOperator=BSWM_OR, BswMArgumentRef=ESH_Cond_NvMWAIsNotPending, BswMArgumentRef=ESH_Cond_NvWWriteAllTimerNotRunning
        ESH_Cond_NvMWAIsNotPending (BswMModeCondition): BswMConditionType=BSWM_EQUALS_NOT, BswMConditionMode=ESH_NvMIndication
          BswMConditionValue
            BswMBswMode: BswMBswRequestedMode=NVM_REQ_PENDING
        ESH_NvMIndication (BswMModeRequestPort): BswMArbitrateOnInit=false, BswMRequestProcessing=BSWM_DEFERRED
          BswMModeRequestSource
            BswMNvMJobModeIndication: BswMNvmService=NvmWriteAll
          BswMModeInitValue
            BswMBswModeInitValue: BswMBswModeInitValueMode=NVM_REQ_OK
        ESH_Cond_NvWWriteAllTimerNotRunning (BswMModeCondition): BswMConditionType=BSWM_EQUALS_NOT, BswMConditionMode=ESH_NvM_WriteAllTimer
          BswMConditionValue
            BswMBswMode: BswMBswRequestedMode=BSWM_TIMER_STARTED
        ESH_NvM_WriteAllTimer (BswMModeRequestPort): BswMArbitrateOnInit=false, BswMRequestProcessing=BSWM_DEFERRED
          BswMModeRequestSource
            BswMTimer
          BswMModeInitValue
            BswMBswModeInitValue: BswMBswModeInitValueMode=BSWM_TIMER_STOPPED
        ESH_LE_NoWakeup (BswMLogicalExpression): BswMLogicalOperator=BSWM_AND, BswMArgumentRef=ESH_Cond_NoValidatedWakeups, BswMArgumentRef=ESH_Cond_ComMNoPendingRequests
        ESH_Cond_NoValidatedWakeups (BswMModeCondition): BswMConditionType=BSWM_EQUALS, BswMConditionMode=ESH_EcuM_GetValidatedWakeupEvents
          BswMConditionValue
            BswMBswMode: BswMBswRequestedMode=0
        ESH_EcuM_GetValidatedWakeupEvents (BswMModeRequestPort): BswMArbitrateOnInit=false, BswMRequestProcessing=BSWM_DEFERRED
          BswMModeRequestSource
            BswMUserConditionRequest: BswMUserCondition=EcuM_GetValidatedWakeupEvents()
        ESH_WakeupToPrep (BswMRule):
          BswMNestedExecutionOnly = false
          BswMRuleId = 13
          BswMRuleInitState = BSWM_FALSE
          BswMRuleExpressionRef = ESH_LE_WakeupToPrepShutdown
          BswMRuleTrueActionList = ESH_AL_WakeupToPrep
        ESH_LE_WakeupToPrepShutdown (BswMLogicalExpression):
          BswMLogicalOperator = BSWM_AND
          BswMArgumentRef = ESH_Cond_StateIsWakeup
          BswMArgumentRef = ESH_LE_CancelNotPending
          BswMArgumentRef = ESH_Cond_NoPendingWakeups
          BswMArgumentRef = ESH_LE_NoWakeup
          BswMArgumentRef = ESH_Cond_ModeIsWakeup
        ESH_Cond_StateIsWakeup (BswMModeCondition): BswMConditionType=BSWM_EQUALS, BswMConditionMode=ESH_State
          BswMConditionValue
            BswMBswMode: BswMBswRequestedMode=ESH_WAKEUP
        ESH_LE_CancelNotPending (BswMLogicalExpression): BswMLogicalOperator=BSWM_OR, BswMArgumentRef=ESH_Cond_NvMWAIsNotPending, BswMArgumentRef=ESH_Cond_NvWCancelTimerNotRunning
        ESH_Cond_NvWCancelTimerNotRunning (BswMModeCondition): BswMConditionType=BSWM_EQUALS_NOT, BswMConditionMode=ESH_NvM_CancelWriteAllTimer
          BswMConditionValue
            BswMBswMode: BswMBswRequestedMode=BSWM_TIMER_STARTED
        ESH_NvM_CancelWriteAllTimer (BswMModeRequestPort): BswMArbitrateOnInit=false, BswMRequestProcessing=BSWM_DEFERRED
          BswMModeRequestSource
            BswMTimer
          BswMModeInitValue
            BswMBswModeInitValue: BswMBswModeInitValueMode=BSWM_TIMER_STOPPED
        ESH_Cond_NoPendingWakeups (BswMModeCondition): BswMConditionType=BSWM_EQUALS, BswMConditionMode=ESH_EcuM_GetPendingWakeupEvents
          BswMConditionValue
            BswMBswMode: BswMBswRequestedMode=0
        ESH_EcuM_GetPendingWakeupEvents (BswMModeRequestPort): BswMArbitrateOnInit=false, BswMRequestProcessing=BSWM_DEFERRED
          BswMModeRequestSource
            BswMUserConditionRequest: BswMUserCondition=EcuM_GetPendingWakeupEvents()
        ESH_Cond_ModeIsWakeup (BswMModeCondition): BswMConditionType=BSWM_EQUALS, BswMConditionMode=ESH_ModeNotification
          BswMConditionValue
            BswMModeDeclaration: BswMModeValueRef=WAKEUP
        ESH_WaitToWakeup (BswMRule):
          BswMNestedExecutionOnly = false
          BswMRuleId = 12
          BswMRuleInitState = BSWM_FALSE
          BswMRuleExpressionRef = ESH_LE_WaitForNvMToWakeup
          BswMRuleTrueActionList = ESH_AL_WaitForNvMWakeup
        ESH_LE_WaitForNvMToWakeup (BswMLogicalExpression): BswMLogicalOperator=BSWM_AND, BswMArgumentRef=ESH_Cond_StateIsWaitForNvm, BswMArgumentRef=ESH_LE_ValidWakeup
        ESH_LE_ValidWakeup (BswMLogicalExpression): BswMLogicalOperator=BSWM_OR, BswMArgumentRef=ESH_Cond_ValidatedWakeups, BswMArgumentRef=ESH_Cond_ComMPendingRequests
        ESH_Cond_ValidatedWakeups (BswMModeCondition): BswMConditionType=BSWM_EQUALS_NOT, BswMConditionMode=ESH_EcuM_GetValidatedWakeupEvents
          BswMConditionValue
            BswMBswMode: BswMBswRequestedMode=0
        ESH_WakeupToRun (BswMRule):
          BswMNestedExecutionOnly = false
          BswMRuleId = 14
          BswMRuleInitState = BSWM_FALSE
          BswMRuleExpressionRef = ESH_LE_WakeupToRun
          BswMRuleTrueActionList = ESH_AL_WakeupToRun
        ESH_LE_WakeupToRun (BswMLogicalExpression):
          BswMLogicalOperator = BSWM_AND
          BswMArgumentRef = ESH_Cond_StateIsWakeup
          BswMArgumentRef = ESH_LE_ValidWakeup
          BswMArgumentRef = ESH_LE_CancelNotPending
          BswMArgumentRef = ESH_Cond_ModeIsWakeup
        ESH_DemInit (BswMRule):
          BswMNestedExecutionOnly = true
          BswMRuleId = 3
          BswMRuleInitState = BSWM_FALSE
          BswMRuleExpressionRef = ESH_LE_DemNotInitialized
          BswMRuleTrueActionList = ESH_AL_DemInit
        ESH_LE_DemNotInitialized (BswMLogicalExpression): BswMLogicalOperator=BSWM_OR, BswMArgumentRef=ESH_Cond_DemNotInitialized
        ESH_Cond_DemNotInitialized (BswMModeCondition): BswMConditionType=BSWM_EQUALS, BswMConditionMode=ESH_DemInitStatus
          BswMConditionValue
            BswMBswMode: BswMBswRequestedMode=DEM_NOT_INITIALIZED
        ESH_DemInitStatus (BswMModeRequestPort): BswMArbitrateOnInit=false, BswMRequestProcessing=BSWM_IMMEDIATE
          BswMModeRequestSource
            BswMGenericRequest: BswMModeRequesterId=231, BswMRequestedModeMax=2
              DEM_INITIALIZED (BswMGenericRequestMode): BswMGenericRequestModeValue=0
              DEM_NOT_INITIALIZED (BswMGenericRequestMode): BswMGenericRequestModeValue=1
          BswMModeInitValue
            BswMBswModeInitValue: BswMBswModeInitValueMode=DEM_INITIALIZED
        ESH_InitToWakeup (BswMRule):
          BswMNestedExecutionOnly = false
          BswMRuleId = 4
          BswMRuleInitState = BSWM_FALSE
          BswMRuleExpressionRef = ESH_LE_InitToWakeup
          BswMRuleTrueActionList = ESH_AL_InitToWakeup
        ESH_LE_InitToWakeup (BswMLogicalExpression): BswMLogicalOperator=BSWM_AND, BswMArgumentRef=ESH_Cond_StateIsInit
        ESH_Cond_StateIsInit (BswMModeCondition): BswMConditionType=BSWM_EQUALS, BswMConditionMode=ESH_State
          BswMConditionValue
            BswMBswMode: BswMBswRequestedMode=ESH_INIT
        ESH_PostRunToPrepNested (BswMRule):
          BswMNestedExecutionOnly = true
          BswMRuleId = 7
          BswMRuleInitState = BSWM_FALSE
          BswMRuleExpressionRef = ESH_LE_PostRunToPrep
          BswMRuleTrueActionList = ESH_AL_PostRunToPrepShutdown
        ESH_LE_PostRunToPrep (BswMLogicalExpression): BswMLogicalOperator=BSWM_AND, BswMArgumentRef=ESH_LE_PostRunReleased
        ESH_LE_PostRunReleased (BswMLogicalExpression): BswMLogicalOperator=BSWM_AND, BswMArgumentRef=ESH_Cond_PostRunRequest0IsReleased, BswMArgumentRef=ESH_Cond_PostRunRequest1IsReleased
        ESH_Cond_PostRunRequest0IsReleased (BswMModeCondition): BswMConditionType=BSWM_EQUALS, BswMConditionMode=ESH_PostRunRequest_0
          BswMConditionValue
            BswMModeDeclaration: BswMModeValueRef=RELEASED
        ESH_PostRunRequest_0 (BswMModeRequestPort): BswMArbitrateOnInit=false, BswMRequestProcessing=BSWM_DEFERRED
          BswMModeRequestSource
            BswMSwcModeRequest: BswMModeRequestDataElementPrototypeName=requestedMode, BswMSwcModeRequestModeDeclarationGroupPrototypeRef=BswM_MDGP_ESH_RunRequest
          BswMModeInitValue
            BswMSwcModeInitValue: BswMSwcModeInitValueRef=RELEASED
        ESH_Cond_PostRunRequest1IsReleased (BswMModeCondition): BswMConditionType=BSWM_EQUALS, BswMConditionMode=ESH_PostRunRequest_1
          BswMConditionValue
            BswMModeDeclaration: BswMModeValueRef=RELEASED
        ESH_PostRunRequest_1 (BswMModeRequestPort): BswMArbitrateOnInit=false, BswMRequestProcessing=BSWM_DEFERRED
          BswMModeRequestSource
            BswMSwcModeRequest: BswMModeRequestDataElementPrototypeName=requestedMode, BswMSwcModeRequestModeDeclarationGroupPrototypeRef=BswM_MDGP_ESH_RunRequest
          BswMModeInitValue
            BswMSwcModeInitValue: BswMSwcModeInitValueRef=RELEASED
        ESH_PostRunNested (BswMRule):
          BswMNestedExecutionOnly = true
          BswMRuleId = 6
          BswMRuleInitState = BSWM_FALSE
          BswMRuleExpressionRef = ESH_LE_PostRunToRun
          BswMRuleFalseActionList = ESH_AL_ESH_PostRunToPrepCheck
          BswMRuleTrueActionList = ESH_AL_PostRunToRun
        ESH_LE_RunRequestsOrWakeup (BswMLogicalExpression): BswMLogicalOperator=BSWM_OR, BswMArgumentRef=ESH_LE_RunRequested, BswMArgumentRef=ESH_LE_ValidWakeup
        ESH_LE_RunRequested (BswMLogicalExpression): BswMLogicalOperator=BSWM_OR, BswMArgumentRef=ESH_Cond_RunRequest0IsRequested, BswMArgumentRef=ESH_Cond_RunRequest1IsRequested
        ESH_Cond_RunRequest0IsRequested (BswMModeCondition): BswMConditionType=BSWM_EQUALS, BswMConditionMode=ESH_RunRequest_0
          BswMConditionValue
            BswMModeDeclaration: BswMModeValueRef=REQUESTED
        ESH_Cond_RunRequest1IsRequested (BswMModeCondition): BswMConditionType=BSWM_EQUALS, BswMConditionMode=ESH_RunRequest_1
          BswMConditionValue
            BswMModeDeclaration: BswMModeValueRef=REQUESTED
        ESH_PostRun (BswMRule):
          BswMNestedExecutionOnly = false
          BswMRuleId = 5
          BswMRuleInitState = BSWM_FALSE
          BswMRuleExpressionRef = ESH_LE_PostRun
          BswMRuleTrueActionList = ESH_AL_ExitPostRun
        ESH_LE_PostRun (BswMLogicalExpression): BswMLogicalOperator=BSWM_AND, BswMArgumentRef=ESH_Cond_StateIsPostRun, BswMArgumentRef=ESH_Cond_ModeIsPostRun
        ESH_Cond_StateIsPostRun (BswMModeCondition): BswMConditionType=BSWM_EQUALS, BswMConditionMode=ESH_State
          BswMConditionValue
            BswMBswMode: BswMBswRequestedMode=ESH_POST_RUN
        ESH_Cond_ModeIsPostRun (BswMModeCondition): BswMConditionType=BSWM_EQUALS, BswMConditionMode=ESH_ModeNotification
          BswMConditionValue
            BswMModeDeclaration: BswMModeValueRef=POSTRUN
        ESH_PrepToWait (BswMRule):
          BswMNestedExecutionOnly = false
          BswMRuleId = 8
          BswMRuleInitState = BSWM_FALSE
          BswMRuleExpressionRef = ESH_LE_PrepShutdownToWaitForNvM
          BswMRuleTrueActionList = ESH_AL_PrepShutdownToWaitForNvM
        ESH_LE_PrepShutdownToWaitForNvM (BswMLogicalExpression): BswMLogicalOperator=BSWM_AND, BswMArgumentRef=ESH_Cond_StateIsPrepShutdown, BswMArgumentRef=ESH_Cond_ModeIsShutdown
        ESH_Cond_StateIsPrepShutdown (BswMModeCondition): BswMConditionType=BSWM_EQUALS, BswMConditionMode=ESH_State
          BswMConditionValue
            BswMBswMode: BswMBswRequestedMode=ESH_PREP_SHUTDOWN
        ESH_Cond_ModeIsShutdown (BswMModeCondition): BswMConditionType=BSWM_EQUALS, BswMConditionMode=ESH_ModeNotification
          BswMConditionValue
            BswMModeDeclaration: BswMModeValueRef=SHUTDOWN
        CC_CN_CAN_fe6ecc87_RX (BswMRule):
          BswMNestedExecutionOnly = false
          BswMRuleId = 0
          BswMRuleInitState = BSWM_FALSE
          BswMRuleExpressionRef = CC_LE_CN_CAN_fe6ecc87_RX
          BswMRuleFalseActionList = CC_AL_CN_CAN_fe6ecc87_RX_Disable
          BswMRuleTrueActionList = CC_AL_CN_CAN_fe6ecc87_RX_EnableNoinit
        CC_LE_CN_CAN_fe6ecc87_RX (BswMLogicalExpression): BswMLogicalOperator=BSWM_AND, BswMArgumentRef=CC_Cond_CanSMIndication_CN_CAN_fe6ecc87_NEQ_CANSM_BSWM_NO_COMMUNICATION
        CC_Cond_CanSMIndication_CN_CAN_fe6ecc87_NEQ_CANSM_BSWM_NO_COMMUNICATION (BswMModeCondition): BswMConditionType=BSWM_EQUALS_NOT, BswMConditionMode=CC_CanSMIndication_CN_CAN_fe6ecc87
          BswMConditionValue
            BswMBswMode: BswMBswRequestedMode=CANSM_BSWM_NO_COMMUNICATION
        CC_CanSMIndication_CN_CAN_fe6ecc87 (BswMModeRequestPort): BswMArbitrateOnInit=false, BswMRequestProcessing=BSWM_IMMEDIATE
          BswMModeRequestSource
            BswMCanSMIndication: BswMCanSMChannelRef=ComMConfigSet/CN_CAN_fe6ecc87
          BswMModeInitValue
            BswMBswModeInitValue: BswMBswModeInitValueMode=CANSM_BSWM_NO_COMMUNICATION
        CC_CN_CAN_fe6ecc87_RX_DM (BswMRule):
          BswMNestedExecutionOnly = false
          BswMRuleId = 1
          BswMRuleInitState = BSWM_FALSE
          BswMRuleExpressionRef = CC_LE_CN_CAN_fe6ecc87_RX_DM
          BswMRuleFalseActionList = CC_AL_CN_CAN_fe6ecc87_Disable_DM
          BswMRuleTrueActionList = CC_AL_CN_CAN_fe6ecc87_Enable_DM
        CC_LE_CN_CAN_fe6ecc87_RX_DM (BswMLogicalExpression): BswMLogicalOperator=BSWM_AND, BswMArgumentRef=CC_Cond_CanSMIndication_CN_CAN_fe6ecc87_EQ_CANSM_BSWM_FULL_COMMUNICATION
        CC_Cond_CanSMIndication_CN_CAN_fe6ecc87_EQ_CANSM_BSWM_FULL_COMMUNICATION (BswMModeCondition): BswMConditionType=BSWM_EQUALS, BswMConditionMode=CC_CanSMIndication_CN_CAN_fe6ecc87
          BswMConditionValue
            BswMBswMode: BswMBswRequestedMode=CANSM_BSWM_FULL_COMMUNICATION
        CC_CN_CAN_fe6ecc87_TX (BswMRule):
          BswMNestedExecutionOnly = false
          BswMRuleId = 2
          BswMRuleInitState = BSWM_FALSE
          BswMRuleExpressionRef = CC_LE_CN_CAN_fe6ecc87_TX
          BswMRuleFalseActionList = CC_AL_CN_CAN_fe6ecc87_TX_Disable
          BswMRuleTrueActionList = CC_AL_CN_CAN_fe6ecc87_TX_EnableNoinit
        CC_LE_CN_CAN_fe6ecc87_TX (BswMLogicalExpression): BswMLogicalOperator=BSWM_AND, BswMArgumentRef=CC_Cond_CanSMIndication_CN_CAN_fe6ecc87_EQ_CANSM_BSWM_FULL_COMMUNICATION
        ESH_LE_AllChannelsNoCom (BswMLogicalExpression): BswMLogicalOperator=BSWM_AND, BswMArgumentRef=ESH_Cond_NoComOn_CN_CAN_fe6ecc87
        ESH_Cond_NoComOn_CN_CAN_fe6ecc87 (BswMModeCondition): BswMConditionType=BSWM_EQUALS, BswMConditionMode=ESH_ComMIndication_CN_CAN_fe6ecc87
          BswMConditionValue
            BswMBswMode: BswMBswRequestedMode=COMM_NO_COMMUNICATION
        ESH_ComMIndication_CN_CAN_fe6ecc87 (BswMModeRequestPort): BswMArbitrateOnInit=false, BswMRequestProcessing=BSWM_DEFERRED
          BswMModeRequestSource
            BswMComMIndication: BswMComMChannelRef=ComMConfigSet/CN_CAN_fe6ecc87
          BswMModeInitValue
            BswMBswModeInitValue: BswMBswModeInitValueMode=COMM_NO_COMMUNICATION
        ESH_RunToPostRunNested (BswMRule):
          BswMNestedExecutionOnly = true
          BswMRuleId = 10
          BswMRuleInitState = BSWM_FALSE
          BswMRuleExpressionRef = ESH_LE_ComMNoPendingRequests
          BswMRuleTrueActionList = ESH_AL_RunToPostRun
        ESH_LE_ComMNoPendingRequests (BswMLogicalExpression): BswMLogicalOperator=BSWM_OR, BswMArgumentRef=ESH_Cond_ComMNoPendingRequests
        ESH_Cond_ComMNoPendingRequests (BswMModeCondition): BswMConditionType=BSWM_EQUALS, BswMConditionMode=ESH_ComMPendingRequests
          BswMConditionValue
            BswMBswMode: BswMBswRequestedMode=ESH_COMM_NO_REQUEST
        ESH_ComMPendingRequests (BswMModeRequestPort): BswMArbitrateOnInit=false, BswMRequestProcessing=BSWM_DEFERRED
          BswMModeRequestSource
            BswMGenericRequest: BswMModeRequesterId=232, BswMRequestedModeMax=2
              ESH_COMM_NO_REQUEST (BswMGenericRequestMode): BswMGenericRequestModeValue=0
              ESH_COMM_PENDING_REQUEST (BswMGenericRequestMode): BswMGenericRequestModeValue=1
          BswMModeInitValue
            BswMBswModeInitValue: BswMBswModeInitValueMode=ESH_COMM_NO_REQUEST
        ESH_Cond_ComMPendingRequests (BswMModeCondition): BswMConditionType=BSWM_EQUALS, BswMConditionMode=ESH_ComMPendingRequests
          BswMConditionValue
            BswMBswMode: BswMBswRequestedMode=ESH_COMM_PENDING_REQUEST
        6 x BswMLogicalExpression:
          ESH_LE_RunToPostRunTransition: BswMLogicalOperator=BSWM_AND, BswMArgumentRef=ESH_LE_RunReached, BswMArgumentRef=ESH_LE_NoRunAndNoKillAllRequest
          ESH_LE_RunReached: BswMLogicalOperator=BSWM_AND, BswMArgumentRef=ESH_Cond_StateIsRun, BswMArgumentRef=ESH_Cond_ModeIsRun
          ESH_LE_NoRunAndNoKillAllRequest: BswMLogicalOperator=BSWM_OR, BswMArgumentRef=ESH_LE_NoRunReasons
          ESH_LE_NoRunReasons: BswMLogicalOperator=BSWM_AND, BswMArgumentRef=ESH_LE_AllChannelsNoCom, BswMArgumentRef=ESH_LE_RunReleased, BswMArgumentRef=ESH_Cond_SelfRunReqTimerExpired
          ESH_LE_NoWakeupOrKillAll: BswMLogicalOperator=BSWM_OR, BswMArgumentRef=ESH_LE_NoWakeup
          ESH_LE_PostRunToRun: BswMLogicalOperator=BSWM_AND, BswMArgumentRef=ESH_LE_RunRequestsOrWakeup
      BswMModeControl: BswMInitActionListRef=INIT_AL_Initialize
        ESH_AL_RunToPostRun (BswMActionList): BswMActionListExecution=BSWM_CONDITION
          5 x BswMActionListItem, all with BswMAbortOnFail=false:
            ESH_Action_EcuMClearValidatedWakeupEvents: BswMActionListItemIndex=1, BswMActionListItemRef=BswMModeControl/ESH_Action_EcuMClearValidatedWakeupEvents
            ESH_Action_OnEnterPostRun: BswMActionListItemIndex=2, BswMActionListItemRef=BswMModeControl/ESH_Action_OnEnterPostRun
            ESH_Action_SwitchPostRun: BswMActionListItemIndex=3, BswMActionListItemRef=BswMModeControl/ESH_Action_SwitchPostRun
            ESH_Action_ESH_PostRun: BswMActionListItemIndex=4, BswMActionListItemRef=BswMModeControl/ESH_Action_ESH_PostRun
            ESH_Action_ComMDisallow_CN_CAN_fe6ecc87: BswMActionListItemIndex=0, BswMActionListItemRef=BswMModeControl/ESH_Action_ComMDisallow_CN_CAN_fe6ecc87
        3 x BswMAction:
          ESH_Action_EcuMClearValidatedWakeupEvents
            BswMAvailableActions
              BswMUserCallout: BswMUserCalloutFunction=EcuM_ClearValidatedWakeupEvent(ECUM_WKSOURCE_ALL_SOURCES), BswMCreateCallout=false, BswMUserIncludeFile=EcuM.h
          ESH_Action_OnEnterPostRun
            BswMAvailableActions
              BswMUserCallout: BswMUserCalloutFunction=BswM_ESH_OnEnterPostRun(), BswMCreateCallout=true
          ESH_Action_SwitchPostRun
            BswMAvailableActions
              BswMRteSwitch: BswMSwitchedMode=POSTRUN, BswMRteSwitchPortRef=ESH_ModeSwitch
        ESH_ModeSwitch (BswMSwitchPort): BswMModeSwitchInterfaceRef=BswM_MSI_ESH_Mode
        ESH_Action_ESH_PostRun (BswMAction)
          BswMAvailableActions
            BswMGenericModeSwitch: BswMGenericRequestRef=ESH_State, BswMGenericRequestModeRef=ESH_POST_RUN
        ESH_AL_WaitForNvMToShutdown (BswMActionList): BswMActionListExecution=BSWM_CONDITION
          3 x BswMActionListItem, all with BswMAbortOnFail=false:
            ESH_Action_WriteAllTimer_Stop: BswMActionListItemIndex=0, BswMActionListItemRef=BswMModeControl/ESH_Action_WriteAllTimer_Stop
            ESH_Action_OnEnterShutdown: BswMActionListItemIndex=1, BswMActionListItemRef=BswMModeControl/ESH_Action_OnEnterShutdown
            ESH_Action_EcuMGoToSelectedShutdownTarget: BswMActionListItemIndex=2, BswMActionListItemRef=BswMModeControl/ESH_Action_EcuMGoToSelectedShutdownTarget
        3 x BswMAction:
          ESH_Action_WriteAllTimer_Stop
            BswMAvailableActions
              BswMTimerControl: BswMTimerAction=BSWM_TIMER_STOP, BswMTimerValue=0, BswMTimerRef=ESH_NvM_WriteAllTimer
          ESH_Action_OnEnterShutdown
            BswMAvailableActions
              BswMUserCallout: BswMUserCalloutFunction=BswM_ESH_OnEnterShutdown(), BswMCreateCallout=true
          ESH_Action_EcuMGoToSelectedShutdownTarget
            BswMAvailableActions
              BswMUserCallout: BswMUserCalloutFunction=(void)EcuM_GoToSelectedShutdownTarget(), BswMCreateCallout=false, BswMUserIncludeFile=EcuM.h
        ESH_AL_WakeupToPrep (BswMActionList): BswMActionListExecution=BSWM_CONDITION
          3 x BswMActionListItem, all with BswMAbortOnFail=false:
            ESH_Action_OnEnterPrepShutdown: BswMActionListItemIndex=0, BswMActionListItemRef=BswMModeControl/ESH_Action_OnEnterPrepShutdown
            ESH_Action_SwitchShutdown: BswMActionListItemIndex=1, BswMActionListItemRef=BswMModeControl/ESH_Action_SwitchShutdown
            ESH_Action_ESH_PrepShutdown: BswMActionListItemIndex=2, BswMActionListItemRef=BswMModeControl/ESH_Action_ESH_PrepShutdown
        3 x BswMAction:
          ESH_Action_OnEnterPrepShutdown
            BswMAvailableActions
              BswMUserCallout: BswMUserCalloutFunction=BswM_ESH_OnEnterPrepShutdown(), BswMCreateCallout=true
          ESH_Action_SwitchShutdown
            BswMAvailableActions
              BswMRteSwitch: BswMSwitchedMode=SHUTDOWN, BswMRteSwitchPortRef=ESH_ModeSwitch
          ESH_Action_ESH_PrepShutdown
            BswMAvailableActions
              BswMGenericModeSwitch: BswMGenericRequestRef=ESH_State, BswMGenericRequestModeRef=ESH_PREP_SHUTDOWN
        ESH_AL_WaitForNvMWakeup (BswMActionList): BswMActionListExecution=BSWM_CONDITION
          6 x BswMActionListItem, all with BswMAbortOnFail=false:
            ESH_Action_WriteAllTimer_Stop: BswMActionListItemIndex=0, BswMActionListItemRef=BswMModeControl/ESH_Action_WriteAllTimer_Stop
            ESH_Action_CancelWriteAllTimer_Start: BswMActionListItemIndex=1, BswMActionListItemRef=BswMModeControl/ESH_Action_CancelWriteAllTimer_Start
            ESH_Action_CancelNvMWriteAll: BswMActionListItemIndex=2, BswMActionListItemRef=BswMModeControl/ESH_Action_CancelNvMWriteAll
            ESH_Action_OnEnterWakeup: BswMActionListItemIndex=3, BswMActionListItemRef=BswMModeControl/ESH_Action_OnEnterWakeup
            ESH_Action_SwitchWakeup: BswMActionListItemIndex=4, BswMActionListItemRef=BswMModeControl/ESH_Action_SwitchWakeup
            ESH_Action_ESH_Wakeup: BswMActionListItemIndex=5, BswMActionListItemRef=BswMModeControl/ESH_Action_ESH_Wakeup
        5 x BswMAction:
          ESH_Action_CancelWriteAllTimer_Start
            BswMAvailableActions
              BswMTimerControl: BswMTimerAction=BSWM_TIMER_START, BswMTimerValue=60, BswMTimerRef=ESH_NvM_CancelWriteAllTimer
          ESH_Action_CancelNvMWriteAll
            BswMAvailableActions
              BswMUserCallout: BswMUserCalloutFunction=NvM_CancelWriteAll(), BswMCreateCallout=false, BswMUserIncludeFile=NvM.h
          ESH_Action_OnEnterWakeup
            BswMAvailableActions
              BswMUserCallout: BswMUserCalloutFunction=BswM_ESH_OnEnterWakeup(), BswMCreateCallout=true
          ESH_Action_SwitchWakeup
            BswMAvailableActions
              BswMRteSwitch: BswMSwitchedMode=WAKEUP, BswMRteSwitchPortRef=ESH_ModeSwitch
          ESH_Action_ESH_Wakeup
            BswMAvailableActions
              BswMGenericModeSwitch: BswMGenericRequestRef=ESH_State, BswMGenericRequestModeRef=ESH_WAKEUP
        ESH_AL_WakeupToRun (BswMActionList): BswMActionListExecution=BSWM_CONDITION
          8 x BswMActionListItem, all with BswMAbortOnFail=false:
            ESH_Action_CancelWriteAllTimer_Stop: BswMActionListItemIndex=0, BswMActionListItemRef=BswMModeControl/ESH_Action_CancelWriteAllTimer_Stop
            ESH_DemInit: BswMActionListItemIndex=1, BswMActionListItemRef=BswMArbitration/ESH_DemInit
            ESH_Action_SelfRunRequestTimer_Start: BswMActionListItemIndex=3, BswMActionListItemRef=BswMModeControl/ESH_Action_SelfRunRequestTimer_Start
            ESH_Action_OnEnterRun: BswMActionListItemIndex=4, BswMActionListItemRef=BswMModeControl/ESH_Action_OnEnterRun
            ESH_Action_SwitchRun: BswMActionListItemIndex=5, BswMActionListItemRef=BswMModeControl/ESH_Action_SwitchRun
            ESH_Action_ESH_Run: BswMActionListItemIndex=6, BswMActionListItemRef=BswMModeControl/ESH_Action_ESH_Run
            ESH_Action_ComMAllow_CN_CAN_fe6ecc87: BswMActionListItemIndex=2, BswMActionListItemRef=BswMModeControl/ESH_Action_ComMAllow_CN_CAN_fe6ecc87
            RTE_REQUEST_BswMRteModeRequestPort_REQUESTED: BswMActionListItemIndex=7, BswMActionListItemRef=BswMModeControl/RTE_REQUEST_BswMRteModeRequestPort_REQUESTED
        ESH_Action_CancelWriteAllTimer_Stop (BswMAction)
          BswMAvailableActions
            BswMTimerControl: BswMTimerAction=BSWM_TIMER_STOP, BswMTimerValue=0, BswMTimerRef=ESH_NvM_CancelWriteAllTimer
        ESH_AL_DemInit (BswMActionList): BswMActionListExecution=BSWM_CONDITION
          ESH_Action_DemInit (BswMActionListItem): BswMAbortOnFail=false, BswMActionListItemIndex=0, BswMActionListItemRef=BswMModeControl/ESH_Action_DemInit
          ESH_Action_DemInitialized (BswMActionListItem): BswMAbortOnFail=false, BswMActionListItemIndex=1, BswMActionListItemRef=BswMModeControl/ESH_Action_DemInitialized
        6 x BswMAction:
          ESH_Action_DemInit
            BswMAvailableActions
              BswMUserCallout: BswMUserCalloutFunction=Dem_Init(Dem_Config_Ptr), BswMCreateCallout=false, BswMUserIncludeFile=Dem.h
          ESH_Action_DemInitialized
            BswMAvailableActions
              BswMGenericModeSwitch: BswMGenericRequestRef=ESH_DemInitStatus, BswMGenericRequestModeRef=DEM_INITIALIZED
          ESH_Action_SelfRunRequestTimer_Start
            BswMAvailableActions
              BswMTimerControl: BswMTimerAction=BSWM_TIMER_START, BswMTimerValue=0.1, BswMTimerRef=ESH_SelfRunRequestTimer
          ESH_Action_OnEnterRun
            BswMAvailableActions
              BswMUserCallout: BswMUserCalloutFunction=BswM_ESH_OnEnterRun(), BswMCreateCallout=true
          ESH_Action_SwitchRun
            BswMAvailableActions
              BswMRteSwitch: BswMSwitchedMode=RUN, BswMRteSwitchPortRef=ESH_ModeSwitch
          ESH_Action_ESH_Run
            BswMAvailableActions
              BswMGenericModeSwitch: BswMGenericRequestRef=ESH_State, BswMGenericRequestModeRef=ESH_RUN
        ESH_AL_InitToWakeup (BswMActionList): BswMActionListExecution=BSWM_CONDITION
          3 x BswMActionListItem, all with BswMAbortOnFail=false:
            ESH_Action_OnEnterWakeup: BswMActionListItemIndex=0, BswMActionListItemRef=BswMModeControl/ESH_Action_OnEnterWakeup
            ESH_Action_SwitchWakeup: BswMActionListItemIndex=1, BswMActionListItemRef=BswMModeControl/ESH_Action_SwitchWakeup
            ESH_Action_ESH_Wakeup: BswMActionListItemIndex=2, BswMActionListItemRef=BswMModeControl/ESH_Action_ESH_Wakeup
        ESH_AL_PostRunToPrepShutdown (BswMActionList): BswMActionListExecution=BSWM_CONDITION
          5 x BswMActionListItem, all with BswMAbortOnFail=false:
            ESH_Action_DemShutdown: BswMActionListItemIndex=0, BswMActionListItemRef=BswMModeControl/ESH_Action_DemShutdown
            ESH_Action_DemNotInitialized: BswMActionListItemIndex=1, BswMActionListItemRef=BswMModeControl/ESH_Action_DemNotInitialized
            ESH_Action_OnEnterPrepShutdown: BswMActionListItemIndex=2, BswMActionListItemRef=BswMModeControl/ESH_Action_OnEnterPrepShutdown
            ESH_Action_SwitchShutdown: BswMActionListItemIndex=3, BswMActionListItemRef=BswMModeControl/ESH_Action_SwitchShutdown
            ESH_Action_ESH_PrepShutdown: BswMActionListItemIndex=4, BswMActionListItemRef=BswMModeControl/ESH_Action_ESH_PrepShutdown
        ESH_Action_DemShutdown (BswMAction)
          BswMAvailableActions
            BswMUserCallout: BswMUserCalloutFunction=Dem_Shutdown(), BswMCreateCallout=false, BswMUserIncludeFile=Dem.h
        ESH_Action_DemNotInitialized (BswMAction)
          BswMAvailableActions
            BswMGenericModeSwitch: BswMGenericRequestRef=ESH_DemInitStatus, BswMGenericRequestModeRef=DEM_NOT_INITIALIZED
        4 x BswMActionList, all with BswMActionListExecution=BSWM_CONDITION:
          ESH_AL_ESH_PostRunToPrepCheck
            ESH_PostRunToPrepNested (BswMActionListItem): BswMAbortOnFail=false, BswMActionListItemIndex=0, BswMActionListItemRef=BswMArbitration/ESH_PostRunToPrepNested
          ESH_AL_PostRunToRun
            5 x BswMActionListItem, all with BswMAbortOnFail=false:
              ESH_Action_SelfRunRequestTimer_Start: BswMActionListItemIndex=1, BswMActionListItemRef=BswMModeControl/ESH_Action_SelfRunRequestTimer_Start
              ESH_Action_OnEnterRun: BswMActionListItemIndex=2, BswMActionListItemRef=BswMModeControl/ESH_Action_OnEnterRun
              ESH_Action_SwitchRun: BswMActionListItemIndex=3, BswMActionListItemRef=BswMModeControl/ESH_Action_SwitchRun
              ESH_Action_ESH_Run: BswMActionListItemIndex=4, BswMActionListItemRef=BswMModeControl/ESH_Action_ESH_Run
              ESH_Action_ComMAllow_CN_CAN_fe6ecc87: BswMActionListItemIndex=0, BswMActionListItemRef=BswMModeControl/ESH_Action_ComMAllow_CN_CAN_fe6ecc87
          ESH_AL_ExitPostRun
            4 x BswMActionListItem, all with BswMAbortOnFail=false:
              ESH_PostRunNested: BswMActionListItemIndex=2, BswMActionListItemRef=BswMArbitration/ESH_PostRunNested
              ESH_Action_EnterExclusiveArea: BswMActionListItemIndex=0, BswMActionListItemRef=BswMModeControl/ESH_Action_EnterExclusiveArea
              ESH_Action_ComMCheckPendingRequests: BswMActionListItemIndex=1, BswMActionListItemRef=BswMModeControl/ESH_Action_ComMCheckPendingRequests
              ESH_Action_ExitExclusiveArea: BswMActionListItemIndex=3, BswMActionListItemRef=BswMModeControl/ESH_Action_ExitExclusiveArea
          ESH_AL_PrepShutdownToWaitForNvM
            5 x BswMActionListItem, all with BswMAbortOnFail=false:
              ESH_Action_WriteAllTimer_Start: BswMActionListItemIndex=0, BswMActionListItemRef=BswMModeControl/ESH_Action_WriteAllTimer_Start
              ESH_Action_NvMWriteAll: BswMActionListItemIndex=1, BswMActionListItemRef=BswMModeControl/ESH_Action_NvMWriteAll
              ESH_Action_OnEnterWaitForNvm: BswMActionListItemIndex=3, BswMActionListItemRef=BswMModeControl/ESH_Action_OnEnterWaitForNvm
              ESH_Action_ESH_WaitForNvm: BswMActionListItemIndex=4, BswMActionListItemRef=BswMModeControl/ESH_Action_ESH_WaitForNvm
              ESH_Action_ComMCheckPendingRequests: BswMActionListItemIndex=2, BswMActionListItemRef=BswMModeControl/ESH_Action_ComMCheckPendingRequests
        4 x BswMAction:
          ESH_Action_WriteAllTimer_Start
            BswMAvailableActions
              BswMTimerControl: BswMTimerAction=BSWM_TIMER_START, BswMTimerValue=60, BswMTimerRef=ESH_NvM_WriteAllTimer
          ESH_Action_NvMWriteAll
            BswMAvailableActions
              BswMUserCallout: BswMUserCalloutFunction=NvM_WriteAll(), BswMCreateCallout=false, BswMUserIncludeFile=NvM.h
          ESH_Action_OnEnterWaitForNvm
            BswMAvailableActions
              BswMUserCallout: BswMUserCalloutFunction=BswM_ESH_OnEnterWaitForNvm(), BswMCreateCallout=true
          ESH_Action_ESH_WaitForNvm
            BswMAvailableActions
              BswMGenericModeSwitch: BswMGenericRequestRef=ESH_State, BswMGenericRequestModeRef=ESH_WAIT_FOR_NVM
        INIT_AL_Initialize (BswMActionList): BswMActionListExecution=BSWM_CONDITION
          16 x BswMActionListItem, all with BswMAbortOnFail=false:
            INIT_Action_Can_Init: BswMActionListItemIndex=0, BswMActionListItemRef=BswMModeControl/INIT_Action_Can_Init
            INIT_Action_CanIf_Init: BswMActionListItemIndex=1, BswMActionListItemRef=BswMModeControl/INIT_Action_CanIf_Init
            INIT_Action_Ea_Init: BswMActionListItemIndex=2, BswMActionListItemRef=BswMModeControl/INIT_Action_Ea_Init
            INIT_Action_Com_Init: BswMActionListItemIndex=3, BswMActionListItemRef=BswMModeControl/INIT_Action_Com_Init
            INIT_Action_PduR_Init: BswMActionListItemIndex=4, BswMActionListItemRef=BswMModeControl/INIT_Action_PduR_Init
            INIT_Action_CanSM_Init: BswMActionListItemIndex=5, BswMActionListItemRef=BswMModeControl/INIT_Action_CanSM_Init
            INIT_Action_Nm_Init: BswMActionListItemIndex=7, BswMActionListItemRef=BswMModeControl/INIT_Action_Nm_Init
            INIT_Action_CanTp_Init: BswMActionListItemIndex=8, BswMActionListItemRef=BswMModeControl/INIT_Action_CanTp_Init
            INIT_Action_NvM_Init: BswMActionListItemIndex=9, BswMActionListItemRef=BswMModeControl/INIT_Action_NvM_Init
            INIT_Action_EnableInterrupts: BswMActionListItemIndex=10, BswMActionListItemRef=BswMModeControl/INIT_Action_EnableInterrupts
            INIT_Action_ComM_Init: BswMActionListItemIndex=11, BswMActionListItemRef=BswMModeControl/INIT_Action_ComM_Init
            INIT_Action_Dcm_Init: BswMActionListItemIndex=12, BswMActionListItemRef=BswMModeControl/INIT_Action_Dcm_Init
            INIT_Action_Dem_Init: BswMActionListItemIndex=13, BswMActionListItemRef=BswMModeControl/INIT_Action_Dem_Init
            INIT_Action_RamTst_Init: BswMActionListItemIndex=14, BswMActionListItemRef=BswMModeControl/INIT_Action_RamTst_Init
            INIT_Action_RteStart: BswMActionListItemIndex=15, BswMActionListItemRef=BswMModeControl/INIT_Action_RteStart
            INIT_Action_NmOsek_Init: BswMActionListItemIndex=6, BswMActionListItemRef=BswMModeControl/INIT_Action_NmOsek_Init
        15 x BswMAction:
          INIT_Action_Can_Init
            BswMAvailableActions
              BswMUserCallout: BswMUserCalloutFunction=Can_Init(Can_Config_Ptr), BswMCreateCallout=false, BswMUserIncludeFile=Can.h
          INIT_Action_CanIf_Init
            BswMAvailableActions
              BswMUserCallout: BswMUserCalloutFunction=CanIf_Init(CanIf_Config_Ptr), BswMCreateCallout=false, BswMUserIncludeFile=CanIf.h
          INIT_Action_Ea_Init
            BswMAvailableActions
              BswMUserCallout: BswMUserCalloutFunction=Ea_Init(), BswMCreateCallout=false, BswMUserIncludeFile=Ea.h
          INIT_Action_Com_Init
            BswMAvailableActions
              BswMUserCallout: BswMUserCalloutFunction=Com_Init(Com_Config_Ptr), BswMCreateCallout=false, BswMUserIncludeFile=Com.h
          INIT_Action_PduR_Init
            BswMAvailableActions
              BswMUserCallout: BswMUserCalloutFunction=PduR_Init(PduR_Config_Ptr), BswMCreateCallout=false, BswMUserIncludeFile=PduR.h
          INIT_Action_CanSM_Init
            BswMAvailableActions
              BswMUserCallout: BswMUserCalloutFunction=CanSM_Init(CanSM_Config_Ptr), BswMCreateCallout=false, BswMUserIncludeFile=CanSM_EcuM.h
          INIT_Action_Nm_Init
            BswMAvailableActions
              BswMUserCallout: BswMUserCalloutFunction=Nm_Init(), BswMCreateCallout=false, BswMUserIncludeFile=Nm.h
          INIT_Action_CanTp_Init
            BswMAvailableActions
              BswMUserCallout: BswMUserCalloutFunction=CanTp_Init(CanTp_Config_Ptr), BswMCreateCallout=false, BswMUserIncludeFile=CanTp.h
          INIT_Action_NvM_Init
            BswMAvailableActions
              BswMUserCallout: BswMUserCalloutFunction=NvM_Init(), BswMCreateCallout=false, BswMUserIncludeFile=NvM.h
          INIT_Action_EnableInterrupts
            BswMAvailableActions
              BswMUserCallout: BswMUserCalloutFunction=BswM_AL_SetProgrammableInterrupts(), BswMCreateCallout=true
          INIT_Action_ComM_Init
            BswMAvailableActions
              BswMUserCallout: BswMUserCalloutFunction=ComM_Init(), BswMCreateCallout=false, BswMUserIncludeFile=ComM.h
          INIT_Action_Dcm_Init
            BswMAvailableActions
              BswMUserCallout: BswMUserCalloutFunction=Dcm_Init(NULL_PTR), BswMCreateCallout=false, BswMUserIncludeFile=Dcm.h
          INIT_Action_Dem_Init
            BswMAvailableActions
              BswMUserCallout: BswMUserCalloutFunction=Dem_Init(Dem_Config_Ptr), BswMCreateCallout=false, BswMUserIncludeFile=Dem.h
          INIT_Action_RamTst_Init
            BswMAvailableActions
              BswMUserCallout: BswMUserCalloutFunction=RamTst_Init(), BswMCreateCallout=false, BswMUserIncludeFile=RamTst.h
          INIT_Action_RteStart
            BswMAvailableActions
              BswMUserCallout: BswMUserCalloutFunction=(void)Rte_Start(), BswMCreateCallout=false, BswMUserIncludeFile=Rte_Main.h
        CC_AL_CN_CAN_fe6ecc87_RX_Disable (BswMActionList): BswMActionListExecution=BSWM_TRIGGER
          CC_DisablePDUGroup_MyECU_oCAN_Rx_63a3e3ce (BswMActionListItem): BswMAbortOnFail=false, BswMActionListItemIndex=0, BswMActionListItemRef=BswMModeControl/CC_DisablePDUGroup_MyECU_oCAN_Rx_63a3e3ce
        CC_DisablePDUGroup_MyECU_oCAN_Rx_63a3e3ce (BswMAction)
          BswMAvailableActions
            BswMPduGroupSwitch: BswMPduGroupSwitchReinit=false, BswMDisabledPduGroupRef=MyECU_oCAN_Rx_63a3e3ce
        CC_AL_CN_CAN_fe6ecc87_RX_EnableNoinit (BswMActionList): BswMActionListExecution=BSWM_TRIGGER
          CC_EnablePDUGroup_MyECU_oCAN_Rx_63a3e3ce (BswMActionListItem): BswMAbortOnFail=false, BswMActionListItemIndex=0, BswMActionListItemRef=BswMModeControl/CC_EnablePDUGroup_MyECU_oCAN_Rx_63a3e3ce
        CC_EnablePDUGroup_MyECU_oCAN_Rx_63a3e3ce (BswMAction)
          BswMAvailableActions
            BswMPduGroupSwitch: BswMPduGroupSwitchReinit=false, BswMEnabledPduGroupRef=MyECU_oCAN_Rx_63a3e3ce
        CC_AL_CN_CAN_fe6ecc87_Disable_DM (BswMActionList): BswMActionListExecution=BSWM_TRIGGER
          CC_DisableDM_MyECU_oCAN_Rx_63a3e3ce (BswMActionListItem): BswMAbortOnFail=false, BswMActionListItemIndex=0, BswMActionListItemRef=BswMModeControl/CC_DisableDM_MyECU_oCAN_Rx_63a3e3ce
        CC_DisableDM_MyECU_oCAN_Rx_63a3e3ce (BswMAction)
          BswMAvailableActions
            BswMDeadlineMonitoringControl: BswMDisabledDMPduGroupRef=MyECU_oCAN_Rx_63a3e3ce
        CC_AL_CN_CAN_fe6ecc87_Enable_DM (BswMActionList): BswMActionListExecution=BSWM_TRIGGER
          CC_EnableDM_MyECU_oCAN_Rx_63a3e3ce (BswMActionListItem): BswMAbortOnFail=false, BswMActionListItemIndex=0, BswMActionListItemRef=BswMModeControl/CC_EnableDM_MyECU_oCAN_Rx_63a3e3ce
        CC_EnableDM_MyECU_oCAN_Rx_63a3e3ce (BswMAction)
          BswMAvailableActions
            BswMDeadlineMonitoringControl: BswMEnabledDMPduGroupRef=MyECU_oCAN_Rx_63a3e3ce
        CC_AL_CN_CAN_fe6ecc87_TX_Disable (BswMActionList): BswMActionListExecution=BSWM_TRIGGER
          CC_DisablePDUGroup_MyECU_oCAN_Tx_35f94448 (BswMActionListItem): BswMAbortOnFail=false, BswMActionListItemIndex=0, BswMActionListItemRef=BswMModeControl/CC_DisablePDUGroup_MyECU_oCAN_Tx_35f94448
        CC_DisablePDUGroup_MyECU_oCAN_Tx_35f94448 (BswMAction)
          BswMAvailableActions
            BswMPduGroupSwitch: BswMPduGroupSwitchReinit=false, BswMDisabledPduGroupRef=MyECU_oCAN_Tx_35f94448
        CC_AL_CN_CAN_fe6ecc87_TX_EnableNoinit (BswMActionList): BswMActionListExecution=BSWM_TRIGGER
          CC_EnablePDUGroup_MyECU_oCAN_Tx_35f94448 (BswMActionListItem): BswMAbortOnFail=false, BswMActionListItemIndex=0, BswMActionListItemRef=BswMModeControl/CC_EnablePDUGroup_MyECU_oCAN_Tx_35f94448
        CC_EnablePDUGroup_MyECU_oCAN_Tx_35f94448 (BswMAction)
          BswMAvailableActions
            BswMPduGroupSwitch: BswMPduGroupSwitchReinit=false, BswMEnabledPduGroupRef=MyECU_oCAN_Tx_35f94448
        ESH_AL_ExitRun (BswMActionList): BswMActionListExecution=BSWM_CONDITION
          4 x BswMActionListItem, all with BswMAbortOnFail=false:
            ESH_Action_EnterExclusiveArea: BswMActionListItemIndex=0, BswMActionListItemRef=BswMModeControl/ESH_Action_EnterExclusiveArea
            ESH_Action_ComMCheckPendingRequests: BswMActionListItemIndex=1, BswMActionListItemRef=BswMModeControl/ESH_Action_ComMCheckPendingRequests
            ESH_RunToPostRunNested: BswMActionListItemIndex=2, BswMActionListItemRef=BswMArbitration/ESH_RunToPostRunNested
            ESH_Action_ExitExclusiveArea: BswMActionListItemIndex=3, BswMActionListItemRef=BswMModeControl/ESH_Action_ExitExclusiveArea
        5 x BswMAction:
          ESH_Action_EnterExclusiveArea
            BswMAvailableActions
              BswMUserCallout: BswMUserCalloutFunction=SchM_Enter_BswM_BSWM_EXCLUSIVE_AREA_0(), BswMCreateCallout=false, BswMUserIncludeFile=SchM_BswM.h
          ESH_Action_ComMCheckPendingRequests
            BswMAvailableActions
              BswMUserCallout:
                BswMUserCalloutFunction = ESH_ComM_CheckPendingRequests()
                BswMCreateCallout = true
                BswMUserCode = ComM_StateType CN_CAN_fe6ecc87 = COMM_NO_COM_NO_PENDING_REQUEST; (void)ComM_GetState(ComMConf_ComMChannel_CN_CAN_fe6ecc87, &CN_CAN_fe6ecc87); /* SBSW_BSWM_FCTCALL_LOCALVAR */ if(CN_CAN_fe6ecc87 != COMM_NO_COM_NO_PENDING_REQUEST) { BswM_RequestMode(BSWM_GENERIC_ESH_ComMPendingRequests, BSWM_GENERICVALUE_ESH_ComMPendingRequests_ESH_COMM_PENDING_REQUEST); } else { BswM_RequestMode(BSWM_GENERIC_ESH_ComMPendingRequests, BSWM_GENERICVALUE_ESH_ComMPendingRequests_ESH_COMM_NO_REQUEST); }
          ESH_Action_ComMDisallow_CN_CAN_fe6ecc87
            BswMAvailableActions
              BswMComMAllowCom: BswMComAllowed=false, BswMComMAllowChannelRef=ComMConfigSet/CN_CAN_fe6ecc87
          ESH_Action_ExitExclusiveArea
            BswMAvailableActions
              BswMUserCallout: BswMUserCalloutFunction=SchM_Exit_BswM_BSWM_EXCLUSIVE_AREA_0(), BswMCreateCallout=false, BswMUserIncludeFile=SchM_BswM.h
          ESH_Action_ComMAllow_CN_CAN_fe6ecc87
            BswMAvailableActions
              BswMComMAllowCom: BswMComAllowed=true, BswMComMAllowChannelRef=ComMConfigSet/CN_CAN_fe6ecc87
        BswMRteModeRequestPort: BswMRteModeInitValue=REQUESTED, BswMRteModeRequestPortInterfaceRef=BswM.Request_ESH_RunRequest_0.requestedMode
        RTE_REQUEST_BswMRteModeRequestPort_REQUESTED (BswMAction)
          BswMAvailableActions
            BswMRteModeRequest: BswMRequestedMode=REQUESTED, BswMRteModeRequestPortRef=BswMRteModeRequestPort
        INIT_Action_NmOsek_Init (BswMAction)
          BswMAvailableActions
            BswMUserCallout: BswMUserCalloutFunction=NmOsek_Init(NmOsek_Config_Ptr), BswMCreateCallout=false, BswMUserIncludeFile=NmOsek.h
      ESH_Mode (BswMRteModeDclGroup): BswMInitMode=STARTUP
        5 x BswMRteMode:
          STARTUP: BswMModePhysicalValue=0
          RUN: BswMModePhysicalValue=1
          POSTRUN: BswMModePhysicalValue=2
          WAKEUP: BswMModePhysicalValue=3
          SHUTDOWN: BswMModePhysicalValue=4
      ESH_RunRequest (BswMRteModeDclGroup): BswMInitMode=RELEASED
        RELEASED (BswMRteMode): BswMModePhysicalValue=0
        REQUESTED (BswMRteMode): BswMModePhysicalValue=1
      BswMDataTypeMappingSets: BswMDataTypeMappingSetRef=BswMMappingSet
  module config Nm: implementation-config-variant=VARIANT-PRE-COMPILE, module-description=Nm_Impl
    NmGlobalConfig
      NmGlobalFeatures:
        NmComUserDataSupport = true
        NmNodeIdEnabled = true
        NmUserDataEnabled = true
        NmBusSynchronizationEnabled = false
        NmCarWakeUpRxEnabled = false
        NmComControlEnabled = false
        NmCoordinatorSupportEnabled = false
        NmNodeDetectionEnabled = false
        NmPduRxIndicationEnabled = false
        NmRemoteSleepIndEnabled = true
        NmRepeatMsgIndEnabled = false
        NmStateChangeIndEnabled = false
        NmMacroLayerEnabled = false
        NmCoordinatorSyncSupport = false
        NmRuntimeMeasurementSupport = false
        NmCoordinatorRequestChannelsInBusSleep = false
        NmCoordinatorPassiveStartUpForwarding = false
        NmPassiveModeEnabled = false
        NmGlobalCoordinatorTime = 0
      NmGeneration:
        NmOutOfBoundsWriteSanitizer = false
        NmOutOfBoundsReadSanitizer = false
        NmShortSymbols = false
        NmInterfacesForDeactivatedData = false
        NmReferringKeysInComments = false
      NmGlobalProperties: NmDevErrorDetect=true, NmVersionInfoApi=false, NmSafeBswChecks=false, NmCycletimeMainFunction=0.01
      NmGlobalConstants
    CN_CAN_fe6ecc87 (NmChannelConfig):
      NmChannelId = 0
      NmChannelSleepMaster = false
      NmStateReportEnabled = false
      NmSynchronizingNetwork = false
      NmCoordClusterIndex = 0
      NmActiveCoordinator = true
      NmComMChannelRef = ComMConfigSet/CN_CAN_fe6ecc87
      NmBusType
        NmGenericBusNmConfig: NmGenericBusNmPrefix=NmOsek, NmGenericBusNmShutdownTime=1.78, NmGenericBusNmChannelSleepMaster=false
  module config Ea: implementation-config-variant=VARIANT-PRE-COMPILE, module-description=Ea_Impl
    EaGeneral:
      EaSetModeSupported = true
      EaDevErrorDetect = true
      EaIndex = 0
      EaPollingMode = true
      EaVersionInfoApi = false
      EaVirtualPageSize = 8
      EaNvMCallbackIncludeFile = NvM_Cbk.h
      EaCorrectSingleBitFlips = true
      EaMainFunctionPeriod = 0.005
      EaMainFunctionTriggering = FixedCycleTime
      EaSafeBswChecks = false
    EaBlockConfiguration_AdminDB (EaBlockConfiguration):
      EaBlockNumber = 16
      EaBlockSize = 12
      EaImmediateData = false
      EaNumberOfWriteCycles = 10000
      EaNumberOfDatasets = 1
      EaNumberOfInstances = 1
      EaVerifyWrittenData = false
      EaBlockId = 0
      EaPartition = EaPartitionConfiguration
      EaDeviceIndex = EepGeneral
    EaPublishedInformation: EaBlockOverhead=2, EaMaximumBlockingTime=0, EaPageOverhead=0
    EaPartitionConfiguration: EaPartitionStartAddress=0, EaPartitionSize=65536, EaPartitionAddressAlignment=1, EaPartitionWriteAlignment=1, EaPartitionDevice=EepInitConfiguration
    13 x EaBlockConfiguration, all with EaImmediateData=false, EaNumberOfWriteCycles=10000, EaNumberOfInstances=1, EaVerifyWrittenData=false, EaPartition=EaPartitionConfiguration, EaDeviceIndex=EepGeneral:
      EaBlockConfiguration0: EaBlockNumber=32, EaBlockSize=14, EaNumberOfDatasets=1, EaBlockId=13
      EaBlockConfiguration1: EaBlockNumber=48, EaBlockSize=14, EaNumberOfDatasets=1, EaBlockId=12
      EaBlockConfiguration2: EaBlockNumber=64, EaBlockSize=14, EaNumberOfDatasets=1, EaBlockId=11
      EaBlockConfiguration3: EaBlockNumber=80, EaBlockSize=14, EaNumberOfDatasets=1, EaBlockId=10
      EaBlockConfiguration4: EaBlockNumber=96, EaBlockSize=14, EaNumberOfDatasets=1, EaBlockId=9
      EaBlockConfiguration5: EaBlockNumber=112, EaBlockSize=14, EaNumberOfDatasets=1, EaBlockId=8
      EaBlockConfiguration6: EaBlockNumber=128, EaBlockSize=14, EaNumberOfDatasets=1, EaBlockId=7
      EaBlockConfiguration7: EaBlockNumber=144, EaBlockSize=14, EaNumberOfDatasets=1, EaBlockId=6
      EaBlockConfiguration_StatusDB: EaBlockNumber=160, EaBlockSize=68, EaNumberOfDatasets=1, EaBlockId=5
      EaBlockConfiguration_ConfigB: EaBlockNumber=176, EaBlockSize=4, EaNumberOfDatasets=2, EaBlockId=4
      EaBlockConfiguration_SA1: EaBlockNumber=192, EaBlockSize=3, EaNumberOfDatasets=1, EaBlockId=3
      EaBlockConfiguration_SA2: EaBlockNumber=208, EaBlockSize=3, EaNumberOfDatasets=1, EaBlockId=2
      EaBlockDescriptor: EaBlockNumber=224, EaBlockSize=3, EaNumberOfDatasets=1, EaBlockId=1
  module config NvM: implementation-config-variant=VARIANT-PRE-COMPILE, module-description=NvM_Impl
    NvMConfigBlock (NvMBlockDescriptor):
      NvMBlockCrcType = NVM_CRC16
      NvMBlockManagementType = NVM_BLOCK_REDUNDANT
      NvMInitBlockCallback = NULL_PTR
      NvMResistantToChangedSw = true
      NvMSelectBlockForReadAll = true
      NvMSelectBlockForWriteAll = true
      NvMUseInitCallback = false
      NvMUseJobendCallback = true
      NvMSingleBlockCallback = Dem_NvM_JobFinished
      NvMBswMBlockStatusInformation = false
      NvMBlockUseCrc = true
      NvMBlockUseSyncMechanism = false
      NvMCalcRamBlockCrc = false
      NvMUseServicePorts = false
      NvMNvramBlockIdentifier = 1
      NvMNvBlockNum = 2
      NvMNvBlockLength = 2
      NvMRomBlockDataAddress = NULL_PTR
      NvMBlockJobPriority = 127
      NvMBlockWriteProt = false
      NvMWriteBlockOnce = false
      NvMBlockUseCRCCompMechanism = false
      NvMTargetBlockReference
        NvMEaRef: NvMNameOfEaBlock=EaBlockConfiguration_ConfigB
    NvMCommon:
      NvMDevErrorDetect = true
      NvMVersionInfoApi = false
      NvMApiConfigClass = NVM_API_CONFIG_CLASS_3
      NvMBswMMultiBlockJobStatusInformation = true
      NvMCompiledConfigId = 1
      NvMCrcNumOfBytes = 64
      NvMDatasetSelectionBits = 4
      NvMDrvModeSwitch = true
      NvMDynamicConfiguration = false
      NvMJobPrioritization = false
      NvMPollingMode = true
      NvMSetRamBlockStatusApi = true
      NvMSizeStandardJobQueue = 8
      NvMMaxNoOfWriteRetries = 1
      NvMMainFunctionPeriod = 0.01
      NvMUseBlockIdCheck = false
      NvMRepairRedundantBlocksApi = false
      NvMSafeBswChecks = false
    NvMCommonVendorParams: NvMMultiblockId=MultiBlockRequest, NvMCrcIntBuffer=true, NvMKillWriteAllApi=true, NvMCfgCbkIncludeList=Dem_Cbk.h, NvMCfgCbkIncludeList=ComM.h
    13 x NvMBlockDescriptor, all with NvMBlockCrcType=NVM_CRC16, NvMBlockManagementType=NVM_BLOCK_NATIVE, NvMResistantToChangedSw=true, NvMUseJobendCallback=true, NvMBswMBlockStatusInformation=false, NvMBlockUseCrc=true, NvMBlockUseSyncMechanism=false, NvMCalcRamBlockCrc=false, NvMBlockJobPriority=127, NvMBlockWriteProt=false, NvMNvBlockNum=1, NvMWriteBlockOnce=false, NvMBlockUseCRCCompMechanism=false:
      DemAdminDataBlock: NvMInitBlockCallback=Dem_NvM_InitAdminData, NvMSelectBlockForReadAll=true, NvMSelectBlockForWriteAll=true, NvMUseInitCallback=true, NvMSingleBlockCallback=Dem_NvM_JobFinished, NvMNvBlockLength=10, NvMNvramBlockIdentifier=2, NvMUseServicePorts=false, NvMRamBlockDataAddress=Dem_Cfg_AdminData, NvMRomBlockDataAddress=NULL_PTR
        NvMTargetBlockReference
          NvMEaRef: NvMNameOfEaBlock=EaBlockConfiguration_AdminDB
      DemStatusDataBlock: NvMInitBlockCallback=Dem_NvM_InitStatusData, NvMSelectBlockForReadAll=true, NvMSelectBlockForWriteAll=true, NvMUseInitCallback=true, NvMSingleBlockCallback=Dem_NvM_JobFinished, NvMNvBlockLength=66, NvMNvramBlockIdentifier=6, NvMUseServicePorts=false, NvMRamBlockDataAddress=Dem_Cfg_StatusData, NvMRomBlockDataAddress=NULL_PTR
        NvMTargetBlockReference
          NvMEaRef: NvMNameOfEaBlock=EaBlockConfiguration_StatusDB
      DemPrimaryDataBlock0: NvMInitBlockCallback=NULL_PTR, NvMSelectBlockForReadAll=true, NvMSelectBlockForWriteAll=true, NvMUseInitCallback=false, NvMSingleBlockCallback=Dem_NvM_JobFinished, NvMNvBlockLength=12, NvMNvramBlockIdentifier=7, NvMUseServicePorts=false, NvMRamBlockDataAddress=Dem_Cfg_PrimaryEntry_0, NvMRomBlockDataAddress=Dem_Cfg_MemoryEntryInit
        NvMTargetBlockReference
          NvMEaRef: NvMNameOfEaBlock=EaBlockConfiguration0
      DemPrimaryDataBlock1: NvMInitBlockCallback=NULL_PTR, NvMSelectBlockForReadAll=true, NvMSelectBlockForWriteAll=true, NvMUseInitCallback=false, NvMSingleBlockCallback=Dem_NvM_JobFinished, NvMNvBlockLength=12, NvMNvramBlockIdentifier=8, NvMUseServicePorts=false, NvMRamBlockDataAddress=Dem_Cfg_PrimaryEntry_1, NvMRomBlockDataAddress=Dem_Cfg_MemoryEntryInit
        NvMTargetBlockReference
          NvMEaRef: NvMNameOfEaBlock=EaBlockConfiguration1
      DemPrimaryDataBlock2: NvMInitBlockCallback=NULL_PTR, NvMSelectBlockForReadAll=true, NvMSelectBlockForWriteAll=true, NvMUseInitCallback=false, NvMSingleBlockCallback=Dem_NvM_JobFinished, NvMNvBlockLength=12, NvMNvramBlockIdentifier=9, NvMUseServicePorts=false, NvMRamBlockDataAddress=Dem_Cfg_PrimaryEntry_2, NvMRomBlockDataAddress=Dem_Cfg_MemoryEntryInit
        NvMTargetBlockReference
          NvMEaRef: NvMNameOfEaBlock=EaBlockConfiguration2
      DemPrimaryDataBlock3: NvMInitBlockCallback=NULL_PTR, NvMSelectBlockForReadAll=true, NvMSelectBlockForWriteAll=true, NvMUseInitCallback=false, NvMSingleBlockCallback=Dem_NvM_JobFinished, NvMNvBlockLength=12, NvMNvramBlockIdentifier=10, NvMUseServicePorts=false, NvMRamBlockDataAddress=Dem_Cfg_PrimaryEntry_3, NvMRomBlockDataAddress=Dem_Cfg_MemoryEntryInit
        NvMTargetBlockReference
          NvMEaRef: NvMNameOfEaBlock=EaBlockConfiguration3
      DemPrimaryDataBlock4: NvMInitBlockCallback=NULL_PTR, NvMSelectBlockForReadAll=true, NvMSelectBlockForWriteAll=true, NvMUseInitCallback=false, NvMSingleBlockCallback=Dem_NvM_JobFinished, NvMNvBlockLength=12, NvMNvramBlockIdentifier=11, NvMUseServicePorts=false, NvMRamBlockDataAddress=Dem_Cfg_PrimaryEntry_4, NvMRomBlockDataAddress=Dem_Cfg_MemoryEntryInit
        NvMTargetBlockReference
          NvMEaRef: NvMNameOfEaBlock=EaBlockConfiguration4
      DemPrimaryDataBlock5: NvMInitBlockCallback=NULL_PTR, NvMSelectBlockForReadAll=true, NvMSelectBlockForWriteAll=true, NvMUseInitCallback=false, NvMSingleBlockCallback=Dem_NvM_JobFinished, NvMNvBlockLength=12, NvMNvramBlockIdentifier=12, NvMUseServicePorts=false, NvMRamBlockDataAddress=Dem_Cfg_PrimaryEntry_5, NvMRomBlockDataAddress=Dem_Cfg_MemoryEntryInit
        NvMTargetBlockReference
          NvMEaRef: NvMNameOfEaBlock=EaBlockConfiguration5
      DemPrimaryDataBlock6: NvMInitBlockCallback=NULL_PTR, NvMSelectBlockForReadAll=true, NvMSelectBlockForWriteAll=true, NvMUseInitCallback=false, NvMSingleBlockCallback=Dem_NvM_JobFinished, NvMNvBlockLength=12, NvMNvramBlockIdentifier=13, NvMUseServicePorts=false, NvMRamBlockDataAddress=Dem_Cfg_PrimaryEntry_6, NvMRomBlockDataAddress=Dem_Cfg_MemoryEntryInit
        NvMTargetBlockReference
          NvMEaRef: NvMNameOfEaBlock=EaBlockConfiguration6
      DemPrimaryDataBlock7: NvMInitBlockCallback=NULL_PTR, NvMSelectBlockForReadAll=true, NvMSelectBlockForWriteAll=true, NvMUseInitCallback=false, NvMSingleBlockCallback=Dem_NvM_JobFinished, NvMNvBlockLength=12, NvMNvramBlockIdentifier=14, NvMUseServicePorts=false, NvMRamBlockDataAddress=Dem_Cfg_PrimaryEntry_7, NvMRomBlockDataAddress=Dem_Cfg_MemoryEntryInit
        NvMTargetBlockReference
          NvMEaRef: NvMNameOfEaBlock=EaBlockConfiguration7
      StartApplication_NvMBlock1: NvMInitBlockCallback=NULL_PTR, NvMSelectBlockForReadAll=false, NvMSelectBlockForWriteAll=false, NvMUseInitCallback=false, NvMSingleBlockCallback=NULL_PTR, NvMNvBlockLength=1, NvMNvramBlockIdentifier=5, NvMUseServicePorts=true
        NvMTargetBlockReference
          NvMEaRef: NvMNameOfEaBlock=EaBlockConfiguration_SA1
      StartApplication_NvMBlock2: NvMInitBlockCallback=NULL_PTR, NvMSelectBlockForReadAll=false, NvMSelectBlockForWriteAll=false, NvMUseInitCallback=false, NvMSingleBlockCallback=NULL_PTR, NvMNvBlockLength=1, NvMNvramBlockIdentifier=4, NvMUseServicePorts=true
        NvMTargetBlockReference
          NvMEaRef: NvMNameOfEaBlock=EaBlockConfiguration_SA2
      NvMBlockDescriptor_ComM: NvMInitBlockCallback=NULL_PTR, NvMSelectBlockForReadAll=true, NvMSelectBlockForWriteAll=true, NvMUseInitCallback=false, NvMSingleBlockCallback=Dem_NvM_JobFinished, NvMNvBlockLength=1, NvMNvramBlockIdentifier=3, NvMUseServicePorts=false, NvMRamBlockDataAddress=ComM_Inhibition
        NvMTargetBlockReference
          NvMEaRef: NvMNameOfEaBlock=EaBlockDescriptor
  module config WdgIf: implementation-config-variant=VARIANT-PRE-COMPILE, module-description=WdgIf_Impl
    WdgIfDevice:
      WdgIfDeviceIndex = 0
      WdgIfDeviceIncludeFile = Wdg.h
      WdgIfDeviceSetMode = Wdg_SetMode
      WdgIfDeviceSetTriggerCondition = Wdg_SetTriggerCondition
      WdgIfDriverRef = WdgGeneral
    WdgIfGeneral: WdgIfDevErrorDetect=true, WdgIfVersionInfoApi=false, WdgIfUseStateCombiner=false
  module config WdgM: implementation-config-variant=VARIANT-PRE-COMPILE, module-description=WdgM_Impl
    WdgMConfigSet: WdgMInitialMode=WdgMMode
      WdgMMode:
        WdgMExpiredSupervisionCycleTol = 65535
        WdgMModeId = 0
        WdgMSupervisionCycle = 0.01
        WdgMInitialTriggerModeId = 0
        WdgMModeCoreAssignment = 0
        WdgMTicksPerSecond = 100
        WdgMReportStatusViaRte = false
        WdgMGlobalMemoryAppTaskRef = OsApplication_Trusted_Core0
        WdgMTrigger: WdgMWatchdogMode=WDGIF_OFF_MODE, WdgMTriggerConditionValue=500, WdgMTriggerModeId=0, WdgMTriggerWatchdogRef=WdgMWatchdog
        WdgMLocalStatusParams:
          WdgMFailedAliveSupervisionRefCycleTol = 65534
          WdgMSupervisedEntityInitialMode = WDGM_LOCAL_STATUS_OK
          WdgMFailedDeadlineRefCycleTol = 0
          WdgMDeadlineReferenceCycle = 0
          WdgMFailedProgramFlowRefCycleTol = 0
          WdgMProgramFlowReferenceCycle = 0
          WdgMLocalStatusSupervisedEntityRef = WdgMSupervisedEntity_Dummy
        WdgMAliveSupervision:
          WdgMExpectedAliveIndications = 10
          WdgMMaxMargin = 10
          WdgMMinMargin = 10
          WdgMSupervisionReferenceCycle = 65535
          WdgMAliveSupervisionCheckpointRef = WdgMCheckpoint_Dummy
        WdgMAliveSupervision_StartApplication (WdgMAliveSupervision):
          WdgMExpectedAliveIndications = 10
          WdgMMaxMargin = 10
          WdgMMinMargin = 9
          WdgMSupervisionReferenceCycle = 10
          WdgMAliveSupervisionCheckpointRef = WdgMCheckpoint_StartApplication
        WdgMLocalStatusParams_StartApplication (WdgMLocalStatusParams):
          WdgMFailedAliveSupervisionRefCycleTol = 0
          WdgMSupervisedEntityInitialMode = WDGM_LOCAL_STATUS_OK
          WdgMFailedDeadlineRefCycleTol = 0
          WdgMDeadlineReferenceCycle = 0
          WdgMFailedProgramFlowRefCycleTol = 0
          WdgMProgramFlowReferenceCycle = 0
          WdgMLocalStatusSupervisedEntityRef = WdgMSupervisedEntity_StartApplication
    WdgMGeneral:
      WdgMDevErrorDetect = true
      WdgMDemReport = false
      WdgMImmediateReset = true
      WdgMOffModeEnabled = true
      WdgMVersionInfoApi = false
      WdgMDefensiveBehavior = false
      WdgMUseRte = true
      WdgMDemSupervisionReport = false
      WdgMFirstCycleAliveCounterReset = false
      WdgMAutosarDebugging = false
      WdgMUseOsSuspendInterrupt = true
      WdgMTimebaseSource = WDGM_INTERNAL_SOFTWARE_TICK
      WdgMSecondResetPath = true
      WdgMTickOverrunCorrection = false
      WdgMEntityDeactivationEnabled = false
      WdgMGenerateCPIdAsPortDefinedArgument = false
      WdgMStatusReportingMechanism = WDGM_USE_NO_STATUS_REPORTING
      WdgMCallerIds: WdgMCallerId=0
      WdgMWatchdog: WdgMWatchdogName=, WdgMWatchdogDeviceRef=WdgIfDevice
      WdgMSupervisedEntity_Dummy (WdgMSupervisedEntity):
        WdgMSupervisedEntityId = 0
        WdgMEnableEntityDeactivation = false
        WdgMReportStatusViaRte = false
        WdgMInternalCheckpointInitialRef = WdgMCheckpoint_Dummy
        WdgMAppTaskRef = OsApplication_Trusted_Core0
        WdgMCheckpoint_Dummy (WdgMCheckpoint): WdgMCheckpointId=0
      WdgMSupervisedEntity_StartApplication (WdgMSupervisedEntity):
        WdgMSupervisedEntityId = 1
        WdgMEnableEntityDeactivation = false
        WdgMReportStatusViaRte = false
        WdgMInternalCheckpointInitialRef = WdgMCheckpoint_StartApplication
        WdgMAppTaskRef = OsApplication_NonTrusted_Core0
        WdgMCheckpoint_StartApplication (WdgMCheckpoint): WdgMCheckpointId=0
  module config Crc: implementation-config-variant=VARIANT-PRE-COMPILE, module-description=Crc_Impl
    CrcGeneral:
      Crc16Mode = CRC_16_RUNTIME
      Crc32Mode = CRC_32_RUNTIME
      Crc8H2FMode = CRC_8H2F_RUNTIME
      Crc8Mode = CRC_8_RUNTIME
      CrcVersionInfoApi = true
      Crc32P4Mode = CRC_32P4_RUNTIME
      Crc64Mode = CRC_64_RUNTIME
  module config MemIf: implementation-config-variant=VARIANT-PRE-COMPILE, module-description=MemIf_Impl
    MemIfGeneral: MemIfDevErrorDetect=true, MemIfVersionInfoApi=false, MemIfSafeBswChecks=false
    MemIfMemHwA: MemIfMemHwAId=0, MemIfMemHwARef=EaGeneral
  module config RamTst: implementation-config-variant=VARIANT-PRE-COMPILE, module-description=RamTst_Impl
    RamTstCommon:
      RamTstDevErrorDetect = true
      RamTstGetVersionInfoApi = false
      RamTstAllowApi = true
      RamTstChangeNumOfTestedCellsApi = true
      RamTstGetAlgParamsApi = true
      RamTstGetExecutionStatusApi = true
      RamTstGetNumberOfTestedCellsApi = true
      RamTstGetTestAlgorithmApi = true
      RamTstGetTestResultApi = true
      RamTstGetTestResultPerBlockApi = true
      RamTstResumeApi = true
      RamTstRunFullTestApi = true
      RamTstRunPartialTestApi = true
      RamTstSelectAlgParamsApi = true
      RamTstStopApi = true
      RamTstSuspendApi = true
      RamTstDevErrorReporting = true
      RamTstNotificationInclude = Appl_RamTst.h
      RamTstMainFunctionPeriod = 0.01
      RamTstConfigParams:
        RamTstTestCompletedNotification = NULL_PTR
        RamTstTestErrorNotification = NULL_PTR
        RamTstDefaultAlgParamsId = 0
        RamTstMinNumberOfTestedCells = 32
        RamTstNumberOfAlgParamSets = 1
        RamTstDefaultAlgParams = RamTstAlgParams
        RamTstAlgParams:
          RamTstAlgParamsId = 0
          RamTstAlgorithm = RAMTST_CHECKERBOARD_TEST
          RamTstExtNumberOfTestedCells = 1
          RamTstMaxNumberOfTestedCells = 128
          RamTstNumberOfBlocks = 1
          RamTstNumberOfTestedCells = 32
          RamTstBlockParams: RamTstBlockId=0, RamTstEndAddress=4294967295, RamTstStartAddress=0, RamTstTestPolicy=RAMTEST_NON_DESTRUCTIVE
      RamTstAlgorithms:
        RamTstAbrahamTestSelected = true
        RamTstCheckerboardTestSelected = true
        RamTstGalpatTestSelected = true
        RamTstMarchTestSelected = true
        RamTstTranspGalpatTestSelected = true
        RamTstWalkPathTestSelected = true
    RamTstDemEventParameterRefs: RAMTST_E_RAM_FAILURE=DemEventParameter_Ramtst
    RamTstPublishedInformation: RamTstCellSize=32
  module config Cdd_Com: definition=Cdd, implementation-config-variant=VARIANT-PRE-COMPILE, module-description=Cdd_Impl
    CddComStackContribution
      CddPduRUpperLayerContribution
        GlobalTimeMaster_oCAN_48f281bc_Rx (CddPduRUpperLayerRxPdu): CddPduRUpperLayerHandleId=1, CddPduRUpperLayerPduRef=EcucPduCollection/GlobalTimeMaster_oCAN_48f281bc_Rx
        msg_diag_Request_MyECU_Slave3_oCAN_87f08505_Rx (CddPduRUpperLayerRxPdu): CddPduRUpperLayerHandleId=2, CddPduRUpperLayerPduRef=EcucPduCollection/msg_diag_Request_MyECU_Slave3_oCAN_87f08505_Rx
        msg_diag_Response_MyECU_Slave3_oCAN_659398e3_Tx (CddPduRUpperLayerTxPdu): CddPduRUpperLayerHandleId=1, CddPduRUpperLayerPduRef=EcucPduCollection/msg_diag_Response_MyECU_Slave3_oCAN_659398e3_Tx
        msg_XCP_Request_MyECU_oCAN_24ce420e_Rx (CddPduRUpperLayerRxPdu): CddPduRUpperLayerHandleId=0, CddPduRUpperLayerPduRef=EcucPduCollection/msg_XCP_Request_MyECU_oCAN_24ce420e_Rx
        msg_XCP_Response_MyECU_oCAN_5d942f8b_Tx (CddPduRUpperLayerTxPdu): CddPduRUpperLayerHandleId=0, CddPduRUpperLayerPduRef=EcucPduCollection/msg_XCP_Response_MyECU_oCAN_5d942f8b_Tx
  module config NmOsek: implementation-config-variant=VARIANT-PRE-COMPILE, module-description=NmOsek_Impl
    NmOsekGlobalConfig:
      NmOsekBusOffNotificationEnabled = true
      NmOsekType = NMOSEK_TYPE_VECTOR_OSEK
      NmOsekUseNmNodeList = false
      NmOsekNumberOfNmConfigNodes = 32
      NmOsekDevErrorDetect = true
      NmOsekTokenMonitoring = false
      NmOsekMainFunctionPeriod = 0.01
      NmOsekVersionInfoApi = false
      NmOsekInstanceId = 0
      NmOsekLastByteOfCanIdAsNodeIdEnabled = false
      NmOsekResetTMaxInLHPrepSleepOnRxRingEnabled = true
      NmOsekNMResetIgnoreRxExceptAliveEnabled = false
      NmOsekLeaveLHOnlyOnRxIndicationEnabled = false
      NmOsekWBSTransitionOnRingMsgOnlyEnabled = false
      NmOsekFirstMessageShallBeNmMessage = false
      NmOsekTxDeadlineMonitoringInComEnabled = false
      NmOsekSafeBswChecks = false
      NmOsekChannelConfig:
        NmOsekNodeId = 0
        NmOsekRingTypTime = 0.1
        NmOsekRingMaxTime = 0.26
        NmOsekLimpHomeTime = 1
        NmOsekWaitBusSleepTime = 1.5
        NmOsekComMNetworkHandleRef = ComMConfigSet/CN_CAN_fe6ecc87
        NmOsekRxPdu: NmOsekRxPduRef=Pdu_NmOsek_Rx
        NmOsekUserDataTxPdu: NmOsekTxUserDataPduId=0, NmOsekTxUserDataPduRef=Pdu_NmOsekUserDataTxPdu
        NmOsekTxPdu: NmOsekTxPduRef=Pdu_NmOsek_Tx
  module config vSet: implementation-config-variant=VARIANT-PRE-COMPILE, module-description=vSet_Impl
    vSetGeneral: vSetDummyStatementKind=SelfAssignment
    vSetPlatform:
      vSetByteOrder = LITTLE_ENDIAN
      vSetSizeOfEnum = Size32Bit
      vSetBitOrder = LSB_to_MSB
      vSetCPUType = CPU32Bit
      vSetSizeOfROMPointer = Size32Bit
      vSetSizeOfInt = Size32Bit
      vSetSizeOfRAMPointer = Size32Bit
    vSetCalibration
package /Fls
  module config Fls: implementation-config-variant=VARIANT-POST-BUILD, module-description=Fls_Impl
    CommonPublishedInformation:
      ArReleaseMajorVersion = 4
      ArReleaseMinorVersion = 2
      ArReleaseRevisionVersion = 2
      ModuleId = 92
      SwMajorVersion = 1
      SwMinorVersion = 0
      SwPatchVersion = 0
      VendorApiInfix = 
      VendorId = 43
    FlsConfigSet:
      FlsAcErase = 1073751296
      FlsAcErasePointer = NULL_PTR
      FlsAcWrite = 1073751296
      FlsAcWritePointer = NULL_PTR
      FlsCallCycle = 0
      FlsDefaultMode = MEMIF_MODE_FAST
      FlsMaxReadFastMode = 1048576
      FlsMaxReadNormalMode = 1024
      FlsMaxWriteFastMode = 256
      FlsMaxWriteNormalMode = 8
      FlsProtection = 0
      FlsSectorList
        6 x FlsSector, all with FlsHwCh=FLS_CH_INTERN, FlsNumberOfSectors=1, FlsPageSize=8, FlsPageWriteAsynch=false, FlsPhysicalSectorUnlock=true, FlsProgrammingSize=FLS_WRITE_DOUBLE_WORD, FlsQspiSectorCh=NOT_QSPI_CHANNEL, FlsSectorEraseAsynch=false, FlsSectorHwAddress=0, FlsSectorIrqMode=false, FlsSectorSize=4096:
          FlsSector_0: FlsPhysicalSector=FLS_DATA_ARRAY_0_BLOCK_3_S000, FlsSectorIndex=0, FlsSectorStartaddress=0
          FlsSector_1: FlsPhysicalSector=FLS_DATA_ARRAY_0_BLOCK_3_S001, FlsSectorIndex=1, FlsSectorStartaddress=4096
          FlsSector_2: FlsPhysicalSector=FLS_DATA_ARRAY_0_BLOCK_3_S002, FlsSectorIndex=2, FlsSectorStartaddress=8192
          FlsSector_3: FlsPhysicalSector=FLS_DATA_ARRAY_0_BLOCK_3_S003, FlsSectorIndex=3, FlsSectorStartaddress=12288
          FlsSector_4: FlsPhysicalSector=FLS_DATA_ARRAY_0_BLOCK_3_S004, FlsSectorIndex=4, FlsSectorStartaddress=16384
          FlsSector_5: FlsPhysicalSector=FLS_DATA_ARRAY_0_BLOCK_3_S005, FlsSectorIndex=5, FlsSectorStartaddress=20480
    FlsGeneral:
      FlsAcLoadOnJobStart = false
      FlsBaseAddress = 0
      FlsBlankCheckApi = false
      FlsCancelApi = true
      FlsCompareApi = true
      FlsDevErrorDetect = true
      FlsDriverIndex = 0
      FlsDsiHandlerApi = false
      FlsEraseBlankCheck = true
      FlsGetJobResultApi = true
      FlsGetStatusApi = true
      FlsMaxEraseBlankCheck = 256
      FlsRuntimeErrorDetect = true
      FlsSetModeApi = true
      FlsTotalSize = 0
      FlsUseInterrupts = false
      FlsVersionInfoApi = true
      FlsWriteBlankCheck = true
      FlsWriteVerifyCheck = true
      FlsTimeouts:
        FlsAbortTimeout = 32767
        FlsAsyncEraseTimeout = 2147483647
        FlsAsyncWriteTimeout = 2147483647
        FlsQspiAsyncEraseTimeout = 2147483647
        FlsQspiAsyncWriteTimeout = 2147483647
        FlsQspiIrqEraseTimeout = 2147483647
        FlsQspiIrqReadTimeout = 2147483647
        FlsQspiIrqWriteTimeout = 2147483647
        FlsQspiSyncEraseTimeout = 2147483647
        FlsQspiSyncReadTimeout = 2147483647
        FlsQspiSyncWriteTimeout = 2147483647
        FlsSyncEraseTimeout = 2147483647
        FlsSyncWriteTimeout = 2147483647
    FlsPublishedInformation:
      FlsAcLocationErase = 0
      FlsAcLocationWrite = 0
      FlsAcSizeErase = 0
      FlsAcSizeWrite = 0
      FlsEraseTime = 5
      FlsErasedValue = 4294967295
      FlsExpectedHwId = 0
      FlsSpecifiedEraseCycles = 100000
      FlsWriteTime = 0.0005
    NonAutosar:
      FlsCheckFlexNvmRatio = false
      FlsDisableDemReportErrorStatus = false
      FlsEnableUserModeSupport = false
      FlsExternalSectorsConfigured = false
      FlsInternalSectorsConfigured = true
      FlsQspiHyperflashEnable = false
      FlsQspiLockLUT = false
      FlsSynchronizeCache = false
package /Icu
  module config Icu: implementation-config-variant=VARIANT-POST-BUILD, module-description=Icu_Impl
    CommonPublishedInformation:
      ArReleaseMajorVersion = 4
      ArReleaseMinorVersion = 2
      ArReleaseRevisionVersion = 2
      ModuleId = 122
      SwMajorVersion = 1
      SwMinorVersion = 0
      SwPatchVersion = 0
      VendorId = 43
    IcuConfigSet: IcuMaxChannel=1
      IcuChannel_0 (IcuChannel):
        IcuChannelId = 0
        IcuDMAChannelEnable = false
        IcuDefaultStartEdge = ICU_RISING_EDGE
        IcuHwIP = FTM
        IcuLockableChannel = false
        IcuMeasurementMode = ICU_MODE_SIGNAL_EDGE_DETECT
        IcuOverflowNotification = NULL_PTR
        IcuWakeupCapability = false
        IcuDMAChannelRef = DMAChannel_0
        IcuFtmChannelRef = IcuFtmChannels_0
        IcuSignalEdgeDetection: IcuSignalNotification=NULL_PTR
      IcuFtm_0 (IcuFtm):
        IcuFtmModule = FTM_0
        Icu_FlexTimer_ClockSource = ICU_FTM_SYSTEM_CLOCK
        Icu_FlexTimer_Prescaler = ICU_FTM_PRESCALER_DIVIDE_128
        Icu_FlexTimer_Prescaler_Alternate = ICU_FTM_PRESCALER_DIVIDE_128
        IcuFtmChannels_0 (IcuFtmChannels): IcuFreezeEnable=false, IcuFtmChannel=CH_0, Icu_FlexTimerFilter=0
      194 x IcuHwInterruptConfigList, all with IcuIsrEnable=false:
        IcuHwInterruptConfigList_0: IcuIsrHwId=FTM_0_CH_0
        IcuHwInterruptConfigList_1: IcuIsrHwId=FTM_0_CH_1
        IcuHwInterruptConfigList_10: IcuIsrHwId=FTM_1_CH_2
        IcuHwInterruptConfigList_100: IcuIsrHwId=PORT_1_CH_14
        IcuHwInterruptConfigList_101: IcuIsrHwId=PORT_1_CH_15
        IcuHwInterruptConfigList_102: IcuIsrHwId=PORT_1_CH_16
        IcuHwInterruptConfigList_103: IcuIsrHwId=PORT_1_CH_17
        IcuHwInterruptConfigList_104: IcuIsrHwId=PORT_1_CH_18
        IcuHwInterruptConfigList_105: IcuIsrHwId=PORT_1_CH_20
        IcuHwInterruptConfigList_106: IcuIsrHwId=PORT_1_CH_21
        IcuHwInterruptConfigList_107: IcuIsrHwId=PORT_1_CH_22
        IcuHwInterruptConfigList_108: IcuIsrHwId=PORT_1_CH_23
        IcuHwInterruptConfigList_109: IcuIsrHwId=PORT_1_CH_25
        IcuHwInterruptConfigList_11: IcuIsrHwId=FTM_1_CH_3
        IcuHwInterruptConfigList_110: IcuIsrHwId=PORT_1_CH_27
        IcuHwInterruptConfigList_111: IcuIsrHwId=PORT_1_CH_28
        IcuHwInterruptConfigList_112: IcuIsrHwId=PORT_1_CH_29
        IcuHwInterruptConfigList_113: IcuIsrHwId=PORT_2_CH_0
        IcuHwInterruptConfigList_114: IcuIsrHwId=PORT_2_CH_1
        IcuHwInterruptConfigList_115: IcuIsrHwId=PORT_2_CH_2
        IcuHwInterruptConfigList_116: IcuIsrHwId=PORT_2_CH_3
        IcuHwInterruptConfigList_117: IcuIsrHwId=PORT_2_CH_4
        IcuHwInterruptConfigList_118: IcuIsrHwId=PORT_2_CH_5
        IcuHwInterruptConfigList_119: IcuIsrHwId=PORT_2_CH_6
        IcuHwInterruptConfigList_12: IcuIsrHwId=FTM_1_CH_4
        IcuHwInterruptConfigList_120: IcuIsrHwId=PORT_2_CH_7
        IcuHwInterruptConfigList_121: IcuIsrHwId=PORT_2_CH_8
        IcuHwInterruptConfigList_122: IcuIsrHwId=PORT_2_CH_9
        IcuHwInterruptConfigList_123: IcuIsrHwId=PORT_2_CH_10
        IcuHwInterruptConfigList_124: IcuIsrHwId=PORT_2_CH_11
        IcuHwInterruptConfigList_125: IcuIsrHwId=PORT_2_CH_12
        IcuHwInterruptConfigList_126: IcuIsrHwId=PORT_2_CH_13
        IcuHwInterruptConfigList_127: IcuIsrHwId=PORT_2_CH_14
        IcuHwInterruptConfigList_128: IcuIsrHwId=PORT_2_CH_15
        IcuHwInterruptConfigList_129: IcuIsrHwId=PORT_2_CH_16
        IcuHwInterruptConfigList_13: IcuIsrHwId=FTM_1_CH_5
        IcuHwInterruptConfigList_130: IcuIsrHwId=PORT_2_CH_17
        IcuHwInterruptConfigList_131: IcuIsrHwId=PORT_2_CH_19
        IcuHwInterruptConfigList_132: IcuIsrHwId=PORT_2_CH_23
        IcuHwInterruptConfigList_133: IcuIsrHwId=PORT_2_CH_27
        IcuHwInterruptConfigList_134: IcuIsrHwId=PORT_2_CH_28
        IcuHwInterruptConfigList_135: IcuIsrHwId=PORT_2_CH_29
        IcuHwInterruptConfigList_136: IcuIsrHwId=PORT_2_CH_30
        IcuHwInterruptConfigList_137: IcuIsrHwId=PORT_2_CH_31
        IcuHwInterruptConfigList_138: IcuIsrHwId=PORT_3_CH_0
        IcuHwInterruptConfigList_139: IcuIsrHwId=PORT_3_CH_1
        IcuHwInterruptConfigList_14: IcuIsrHwId=FTM_1_CH_6
        IcuHwInterruptConfigList_140: IcuIsrHwId=PORT_3_CH_2
        IcuHwInterruptConfigList_141: IcuIsrHwId=PORT_3_CH_3
        IcuHwInterruptConfigList_142: IcuIsrHwId=PORT_3_CH_4
        IcuHwInterruptConfigList_143: IcuIsrHwId=PORT_3_CH_5
        IcuHwInterruptConfigList_144: IcuIsrHwId=PORT_3_CH_6
        IcuHwInterruptConfigList_145: IcuIsrHwId=PORT_3_CH_7
        IcuHwInterruptConfigList_146: IcuIsrHwId=PORT_3_CH_8
        IcuHwInterruptConfigList_147: IcuIsrHwId=PORT_3_CH_9
        IcuHwInterruptConfigList_148: IcuIsrHwId=PORT_3_CH_10
        IcuHwInterruptConfigList_149: IcuIsrHwId=PORT_3_CH_11
        IcuHwInterruptConfigList_15: IcuIsrHwId=FTM_1_CH_7
        IcuHwInterruptConfigList_150: IcuIsrHwId=PORT_3_CH_12
        IcuHwInterruptConfigList_151: IcuIsrHwId=PORT_3_CH_13
        IcuHwInterruptConfigList_152: IcuIsrHwId=PORT_3_CH_14
        IcuHwInterruptConfigList_153: IcuIsrHwId=PORT_3_CH_15
        IcuHwInterruptConfigList_154: IcuIsrHwId=PORT_3_CH_16
        IcuHwInterruptConfigList_155: IcuIsrHwId=PORT_3_CH_17
        IcuHwInterruptConfigList_156: IcuIsrHwId=PORT_3_CH_18
        IcuHwInterruptConfigList_157: IcuIsrHwId=PORT_3_CH_19
        IcuHwInterruptConfigList_158: IcuIsrHwId=PORT_3_CH_22
        IcuHwInterruptConfigList_159: IcuIsrHwId=PORT_3_CH_23
        IcuHwInterruptConfigList_16: IcuIsrHwId=FTM_2_CH_0
        IcuHwInterruptConfigList_160: IcuIsrHwId=PORT_3_CH_24
        IcuHwInterruptConfigList_161: IcuIsrHwId=PORT_3_CH_27
        IcuHwInterruptConfigList_162: IcuIsrHwId=PORT_3_CH_28
        IcuHwInterruptConfigList_163: IcuIsrHwId=PORT_3_CH_29
        IcuHwInterruptConfigList_164: IcuIsrHwId=PORT_3_CH_30
        IcuHwInterruptConfigList_165: IcuIsrHwId=PORT_4_CH_0
        IcuHwInterruptConfigList_166: IcuIsrHwId=PORT_4_CH_1
        IcuHwInterruptConfigList_167: IcuIsrHwId=PORT_4_CH_2
        IcuHwInterruptConfigList_168: IcuIsrHwId=PORT_4_CH_3
        IcuHwInterruptConfigList_169: IcuIsrHwId=PORT_4_CH_4
        IcuHwInterruptConfigList_17: IcuIsrHwId=FTM_2_CH_1
        IcuHwInterruptConfigList_170: IcuIsrHwId=PORT_4_CH_5
        IcuHwInterruptConfigList_171: IcuIsrHwId=PORT_4_CH_6
        IcuHwInterruptConfigList_172: IcuIsrHwId=PORT_4_CH_7
        IcuHwInterruptConfigList_173: IcuIsrHwId=PORT_4_CH_8
        IcuHwInterruptConfigList_174: IcuIsrHwId=PORT_4_CH_9
        IcuHwInterruptConfigList_175: IcuIsrHwId=PORT_4_CH_10
        IcuHwInterruptConfigList_176: IcuIsrHwId=PORT_4_CH_11
        IcuHwInterruptConfigList_177: IcuIsrHwId=PORT_4_CH_12
        IcuHwInterruptConfigList_178: IcuIsrHwId=PORT_4_CH_13
        IcuHwInterruptConfigList_179: IcuIsrHwId=PORT_4_CH_14
        IcuHwInterruptConfigList_18: IcuIsrHwId=FTM_2_CH_2
        IcuHwInterruptConfigList_180: IcuIsrHwId=PORT_4_CH_15
        IcuHwInterruptConfigList_181: IcuIsrHwId=PORT_4_CH_16
        IcuHwInterruptConfigList_182: IcuIsrHwId=PORT_4_CH_19
        IcuHwInterruptConfigList_183: IcuIsrHwId=PORT_4_CH_20
        IcuHwInterruptConfigList_184: IcuIsrHwId=PORT_4_CH_21
        IcuHwInterruptConfigList_185: IcuIsrHwId=PORT_4_CH_22
        IcuHwInterruptConfigList_186: IcuIsrHwId=PORT_4_CH_23
        IcuHwInterruptConfigList_187: IcuIsrHwId=PORT_4_CH_24
        IcuHwInterruptConfigList_188: IcuIsrHwId=PORT_4_CH_25
        IcuHwInterruptConfigList_189: IcuIsrHwId=LPIT_0_CH_0
        IcuHwInterruptConfigList_19: IcuIsrHwId=FTM_2_CH_3
        IcuHwInterruptConfigList_190: IcuIsrHwId=LPIT_0_CH_1
        IcuHwInterruptConfigList_191: IcuIsrHwId=LPIT_0_CH_2
        IcuHwInterruptConfigList_192: IcuIsrHwId=LPIT_0_CH_3
        IcuHwInterruptConfigList_193: IcuIsrHwId=LPTMR_0_CH_0
        IcuHwInterruptConfigList_2: IcuIsrHwId=FTM_0_CH_2
        IcuHwInterruptConfigList_20: IcuIsrHwId=FTM_2_CH_4
        IcuHwInterruptConfigList_21: IcuIsrHwId=FTM_2_CH_5
        IcuHwInterruptConfigList_22: IcuIsrHwId=FTM_2_CH_6
        IcuHwInterruptConfigList_23: IcuIsrHwId=FTM_2_CH_7
        IcuHwInterruptConfigList_24: IcuIsrHwId=FTM_3_CH_0
        IcuHwInterruptConfigList_25: IcuIsrHwId=FTM_3_CH_1
        IcuHwInterruptConfigList_26: IcuIsrHwId=FTM_3_CH_2
        IcuHwInterruptConfigList_27: IcuIsrHwId=FTM_3_CH_3
        IcuHwInterruptConfigList_28: IcuIsrHwId=FTM_3_CH_4
        IcuHwInterruptConfigList_29: IcuIsrHwId=FTM_3_CH_5
        IcuHwInterruptConfigList_3: IcuIsrHwId=FTM_0_CH_3
        IcuHwInterruptConfigList_30: IcuIsrHwId=FTM_3_CH_6
        IcuHwInterruptConfigList_31: IcuIsrHwId=FTM_3_CH_7
        IcuHwInterruptConfigList_32: IcuIsrHwId=FTM_4_CH_0
        IcuHwInterruptConfigList_33: IcuIsrHwId=FTM_4_CH_1
        IcuHwInterruptConfigList_34: IcuIsrHwId=FTM_4_CH_2
        IcuHwInterruptConfigList_35: IcuIsrHwId=FTM_4_CH_3
        IcuHwInterruptConfigList_36: IcuIsrHwId=FTM_4_CH_4
        IcuHwInterruptConfigList_37: IcuIsrHwId=FTM_4_CH_5
        IcuHwInterruptConfigList_38: IcuIsrHwId=FTM_4_CH_6
        IcuHwInterruptConfigList_39: IcuIsrHwId=FTM_4_CH_7
        IcuHwInterruptConfigList_4: IcuIsrHwId=FTM_0_CH_4
        IcuHwInterruptConfigList_40: IcuIsrHwId=FTM_5_CH_0
        IcuHwInterruptConfigList_41: IcuIsrHwId=FTM_5_CH_1
        IcuHwInterruptConfigList_42: IcuIsrHwId=FTM_5_CH_2
        IcuHwInterruptConfigList_43: IcuIsrHwId=FTM_5_CH_3
        IcuHwInterruptConfigList_44: IcuIsrHwId=FTM_5_CH_4
        IcuHwInterruptConfigList_45: IcuIsrHwId=FTM_5_CH_5
        IcuHwInterruptConfigList_46: IcuIsrHwId=FTM_5_CH_6
        IcuHwInterruptConfigList_47: IcuIsrHwId=FTM_5_CH_7
        IcuHwInterruptConfigList_48: IcuIsrHwId=FTM_6_CH_0
        IcuHwInterruptConfigList_49: IcuIsrHwId=FTM_6_CH_1
        IcuHwInterruptConfigList_5: IcuIsrHwId=FTM_0_CH_5
        IcuHwInterruptConfigList_50: IcuIsrHwId=FTM_6_CH_2
        IcuHwInterruptConfigList_51: IcuIsrHwId=FTM_6_CH_3
        IcuHwInterruptConfigList_52: IcuIsrHwId=FTM_6_CH_4
        IcuHwInterruptConfigList_53: IcuIsrHwId=FTM_6_CH_5
        IcuHwInterruptConfigList_54: IcuIsrHwId=FTM_6_CH_7
        IcuHwInterruptConfigList_55: IcuIsrHwId=FTM_7_CH_0
        IcuHwInterruptConfigList_56: IcuIsrHwId=FTM_7_CH_1
        IcuHwInterruptConfigList_57: IcuIsrHwId=FTM_7_CH_2
        IcuHwInterruptConfigList_58: IcuIsrHwId=FTM_7_CH_3
        IcuHwInterruptConfigList_59: IcuIsrHwId=FTM_7_CH_5
        IcuHwInterruptConfigList_6: IcuIsrHwId=FTM_0_CH_6
        IcuHwInterruptConfigList_60: IcuIsrHwId=FTM_7_CH_7
        IcuHwInterruptConfigList_61: IcuIsrHwId=PORT_0_CH_0
        IcuHwInterruptConfigList_62: IcuIsrHwId=PORT_0_CH_1
        IcuHwInterruptConfigList_63: IcuIsrHwId=PORT_0_CH_2
        IcuHwInterruptConfigList_64: IcuIsrHwId=PORT_0_CH_3
        IcuHwInterruptConfigList_65: IcuIsrHwId=PORT_0_CH_4
        IcuHwInterruptConfigList_66: IcuIsrHwId=PORT_0_CH_5
        IcuHwInterruptConfigList_67: IcuIsrHwId=PORT_0_CH_6
        IcuHwInterruptConfigList_68: IcuIsrHwId=PORT_0_CH_7
        IcuHwInterruptConfigList_69: IcuIsrHwId=PORT_0_CH_8
        IcuHwInterruptConfigList_7: IcuIsrHwId=FTM_0_CH_7
        IcuHwInterruptConfigList_70: IcuIsrHwId=PORT_0_CH_9
        IcuHwInterruptConfigList_71: IcuIsrHwId=PORT_0_CH_10
        IcuHwInterruptConfigList_72: IcuIsrHwId=PORT_0_CH_11
        IcuHwInterruptConfigList_73: IcuIsrHwId=PORT_0_CH_12
        IcuHwInterruptConfigList_74: IcuIsrHwId=PORT_0_CH_13
        IcuHwInterruptConfigList_75: IcuIsrHwId=PORT_0_CH_14
        IcuHwInterruptConfigList_76: IcuIsrHwId=PORT_0_CH_15
        IcuHwInterruptConfigList_77: IcuIsrHwId=PORT_0_CH_16
        IcuHwInterruptConfigList_78: IcuIsrHwId=PORT_0_CH_17
        IcuHwInterruptConfigList_79: IcuIsrHwId=PORT_0_CH_25
        IcuHwInterruptConfigList_8: IcuIsrHwId=FTM_1_CH_0
        IcuHwInterruptConfigList_80: IcuIsrHwId=PORT_0_CH_26
        IcuHwInterruptConfigList_81: IcuIsrHwId=PORT_0_CH_27
        IcuHwInterruptConfigList_82: IcuIsrHwId=PORT_0_CH_28
        IcuHwInterruptConfigList_83: IcuIsrHwId=PORT_0_CH_29
        IcuHwInterruptConfigList_84: IcuIsrHwId=PORT_0_CH_30
        IcuHwInterruptConfigList_85: IcuIsrHwId=PORT_0_CH_31
        IcuHwInterruptConfigList_86: IcuIsrHwId=PORT_1_CH_0
        IcuHwInterruptConfigList_87: IcuIsrHwId=PORT_1_CH_1
        IcuHwInterruptConfigList_88: IcuIsrHwId=PORT_1_CH_2
        IcuHwInterruptConfigList_89: IcuIsrHwId=PORT_1_CH_3
        IcuHwInterruptConfigList_9: IcuIsrHwId=FTM_1_CH_1
        IcuHwInterruptConfigList_90: IcuIsrHwId=PORT_1_CH_4
        IcuHwInterruptConfigList_91: IcuIsrHwId=PORT_1_CH_5
        IcuHwInterruptConfigList_92: IcuIsrHwId=PORT_1_CH_6
        IcuHwInterruptConfigList_93: IcuIsrHwId=PORT_1_CH_7
        IcuHwInterruptConfigList_94: IcuIsrHwId=PORT_1_CH_8
        IcuHwInterruptConfigList_95: IcuIsrHwId=PORT_1_CH_9
        IcuHwInterruptConfigList_96: IcuIsrHwId=PORT_1_CH_10
        IcuHwInterruptConfigList_97: IcuIsrHwId=PORT_1_CH_11
        IcuHwInterruptConfigList_98: IcuIsrHwId=PORT_1_CH_12
        IcuHwInterruptConfigList_99: IcuIsrHwId=PORT_1_CH_13
    IcuGeneral: IcuDevErrorDetect=true, IcuEnableUserModeSupport=false, IcuIndex=0, IcuReportWakeupSource=true
    IcuNonAUTOSAR:
      IcuEnableDualClockMode = false
      IcuGetCaptureRegisterValueApi = false
      IcuGetInputLevelApi = false
      IcuOverflowNotificationApi = false
      IcuRegisterLockingMode = NO_REGISTER_LOCKING
    IcuOptionalApis:
      IcuDeInitApi = true
      IcuDisableWakeupApi = true
      IcuEdgeCountApi = true
      IcuEdgeDetectApi = true
      IcuEnableWakeupApi = true
      IcuGetDutyCycleValuesApi = true
      IcuGetInputStateApi = true
      IcuGetTimeElapsedApi = true
      IcuGetVersionInfoApi = true
      IcuSetModeApi = true
      IcuSignalMeasurementApi = true
      IcuTimestampApi = true
      IcuWakeupFunctionalityApi = true
package /Csec
  module config Csec: implementation-config-variant=VARIANT-PRE-COMPILE, module-description=Csec_Impl
    CommonPublishedInformation:
      ArReleaseMajorVersion = 4
      ArReleaseMinorVersion = 2
      ArReleaseRevisionVersion = 2
      ModuleId = 255
      SwMajorVersion = 1
      SwMinorVersion = 0
      SwPatchVersion = 0
      VendorId = 43
    CsecGeneral: CsecDevErrorDetect=false, CsecEnableUserModeSupport=false, CsecTimeoutDuration=2147483647, CsecVersionInfoApi=true
package /Resource
  module config Resource: implementation-config-variant=VARIANT-PRE-COMPILE
    CommonPublishedInformation:
      ArReleaseMajorVersion = 4
      ArReleaseMinorVersion = 2
      ArReleaseRevisionVersion = 2
      ModuleId = 0
      SwMajorVersion = 1
      SwMinorVersion = 0
      SwPatchVersion = 0
      VendorId = 43
    ResourceGeneral: ResourceSubderivative=s32k148_lqfp144
package /Eep
  module config Eep: implementation-config-variant=VARIANT-POST-BUILD, module-description=Eep_Impl
    CommonPublishedInformation:
      ArReleaseMajorVersion = 4
      ArReleaseMinorVersion = 2
      ArReleaseRevisionVersion = 2
      ModuleId = 90
      SwMajorVersion = 1
      SwMinorVersion = 0
      SwPatchVersion = 0
      VendorApiInfix = 
      VendorId = 43
    EepGeneral:
      EepDevErrorDetect = true
      EepDriverIndex = 0
      EepUseInterrupts = false
      EepVersionInfoApi = true
      EepWriteCycleReduction = false
      EepTestComApi = false
      EepMaxAllowedReadBlockSize = 16
      EepSafeBswChecks = false
      EepExtendedAddressing = false
    EepInitConfiguration:
      EepAcWrite = 1073751296
      EepAcWritePointer = NULL_PTR
      EepBaseAddress = 0
      EepDefaultMode = MEMIF_MODE_SLOW
      EepFastReadBlockSize = 128
      EepFastWriteBlockSize = 128
      EepJobCallCycle = 0
      EepNormalReadBlockSize = 128
      EepNormalWriteBlockSize = 128
      EepSize = 65536
      EepDefaultHandling = EEP_30_XXI2C01_HANDLING_RECURRENT
      EepNbOfBurstQueries = 65535
      EepDeviceInformationRef = (unset)
      EepExternalDriver: EepI2cReference=(unset), EepI2cReference=(unset), EepI2cReference=(unset)
    EepPublishedInformation:
      EepAllowedWriteCycles = 100000
      EepEraseTime = 0.0005
      EepEraseUnitSize = 1
      EepEraseValue = 255
      EepMinimumAddressType = 4
      EepMinimumLengthType = 1
      EepReadUnitSize = 1
      EepSpecifiedEraseCycles = 100000
      EepTotalSize = 4096
      EepWriteTime = 0.0005
      EepWriteUnitSize = 1
    NonAutosar:
      EepAcLoadOnJobStart = false
      EepCancelApi = true
      EepCompareApi = true
      EepDisableDemReportErrorStatus = false
      EepEnableQuickWriteApi = false
      EepEnableUserModeSupport = false
      EepGetJobResultApi = true
      EepGetStatusApi = true
      EepPageAsynchBehaviorEn = false
      EepSetModeApi = true
      EepSizeUsedForCSEC = 0
    22 x EepDeviceInformation, all with EepMinimumAddressType=16:
      Microchip_24C65: EepAllowedWriteCycles=1000000, EepTotalSize=16384, EepWriteTime=0.005, EepPageSize=EepPageSize64
      Microchip_24AA64: EepAllowedWriteCycles=1000000, EepTotalSize=8192, EepWriteTime=0.005, EepPageSize=EepPageSize32
      Microchip_24AA128: EepAllowedWriteCycles=1000000, EepTotalSize=16384, EepWriteTime=0.005, EepPageSize=EepPageSize64
      Microchip_24LC64: EepAllowedWriteCycles=1000000, EepTotalSize=8192, EepWriteTime=0.005, EepPageSize=EepPageSize32
      Microchip_24LC256: EepAllowedWriteCycles=1000000, EepTotalSize=32768, EepWriteTime=0.005, EepPageSize=EepPageSize64
      ONSemiconductor_CAT24C32: EepAllowedWriteCycles=1000000, EepTotalSize=4096, EepWriteTime=0.005, EepPageSize=EepPageSize32
      ONSemiconductor_CAT24C64: EepAllowedWriteCycles=1000000, EepTotalSize=8192, EepWriteTime=0.005, EepPageSize=EepPageSize32
      ONSemiconductor_CAV24C16: EepAllowedWriteCycles=1000000, EepTotalSize=2048, EepWriteTime=0.005, EepPageSize=EepPageSize16
      ONSemiconductor_CAV24C32: EepAllowedWriteCycles=1000000, EepTotalSize=4096, EepWriteTime=0.005, EepPageSize=EepPageSize32
      ONSemiconductor_CAV24C64: EepAllowedWriteCycles=1000000, EepTotalSize=8192, EepWriteTime=0.005, EepPageSize=EepPageSize32
      ONSemiconductor_N24C32: EepAllowedWriteCycles=1000000, EepTotalSize=4096, EepWriteTime=0.004, EepPageSize=EepPageSize32
      ROHM_BR24L16: EepAllowedWriteCycles=1000000, EepTotalSize=2048, EepWriteTime=0.005, EepPageSize=EepPageSize16
      Ablic_S24C64C: EepAllowedWriteCycles=1000000, EepTotalSize=8192, EepWriteTime=0.005, EepPageSize=EepPageSize32
      Seiko_S24C128CH: EepAllowedWriteCycles=1000000, EepTotalSize=16384, EepWriteTime=0.005, EepPageSize=EepPageSize64
      STMicroelectronics_M24C16: EepAllowedWriteCycles=4000000, EepTotalSize=2048, EepWriteTime=0.005, EepPageSize=EepPageSize16
      STMicroelectronics_M24C32: EepAllowedWriteCycles=4000000, EepTotalSize=4096, EepWriteTime=0.005, EepPageSize=EepPageSize32
      STMicroelectronics_M24C64: EepAllowedWriteCycles=4000000, EepTotalSize=8192, EepWriteTime=0.005, EepPageSize=EepPageSize32
      STMicroelectronics_M24128: EepAllowedWriteCycles=4000000, EepTotalSize=16384, EepWriteTime=0.004, EepPageSize=EepPageSize64
      STMicroelectronics_M24256: EepAllowedWriteCycles=4000000, EepTotalSize=32768, EepWriteTime=0.005, EepPageSize=EepPageSize64
      STMicroelectronics_ST24C16: EepAllowedWriteCycles=4000000, EepTotalSize=4096, EepWriteTime=0.005, EepPageSize=EepPageSize32
      Atmel_AT24C32: EepAllowedWriteCycles=1000000, EepTotalSize=4096, EepWriteTime=0.01, EepPageSize=EepPageSize32
      Atmel_AT24C64: EepAllowedWriteCycles=1000000, EepTotalSize=8192, EepWriteTime=0.01, EepPageSize=EepPageSize32
package /Spi
  module config Spi: implementation-config-variant=VARIANT-PRE-COMPILE, module-description=Spi_Impl
    CommonPublishedInformation:
      ArReleaseMajorVersion = 4
      ArReleaseMinorVersion = 2
      ArReleaseRevisionVersion = 2
      ModuleId = 83
      SwMajorVersion = 1
      SwMinorVersion = 0
      SwPatchVersion = 0
      VendorId = 43
    SpiDriver: SpiMaxChannel=1, SpiMaxJob=1, SpiMaxSequence=1
      SpiChannel_0 (SpiChannel): SpiChannelId=0, SpiChannelType=IB, SpiDataWidth=8, SpiDefaultData=1, SpiEbMaxLength=1, SpiIbNBuffers=1, SpiTransferStart=MSB, SpiTransferWidth=1
      SpiExternalDevice_0 (SpiExternalDevice):
        SpiBaudrate = 100000
        SpiBaudrateAlternate = 100000
        SpiByteSwap = FALSE
        SpiCsContinous = TRUE
        SpiCsIdentifier = PCS0
        SpiCsPolarity = HIGH
        SpiCsSelection = CS_VIA_PERIPHERAL_ENGINE
        SpiDataShiftEdge = LEADING
        SpiEnableCs = true
        SpiHwUnit = CSIB0
        SpiShiftClockIdleLevel = HIGH
        SpiSlaveMode = false
        SpiTimeClk2Cs = 0.000001
        SpiTimeCs2Clk = 0.000001
        SpiTimeCs2Cs = 0.000001
      SpiJob_0 (SpiJob): SpiHwUnitSynchronous=ASYNCHRONOUS, SpiJobEndNotification=NULL_PTR, SpiJobId=0, SpiJobPriority=0, SpiDeviceAssignment=SpiExternalDevice_0
        SpiChannelList_0 (SpiChannelList): SpiChannelIndex=0, SpiChannelAssignment=SpiChannel_0
      SpiSequence_0 (SpiSequence): SpiInterruptibleSequence=false, SpiSequenceId=0, SpiJobAssignment=SpiJob_0
    SpiGeneral:
      SpiCancelApi = true
      SpiChannelBuffersAllowed = 0
      SpiDevErrorDetect = true
      SpiGlobalDmaEnable = false
      SpiHwStatusApi = true
      SpiInterruptibleSeqAllowed = false
      SpiLevelDelivered = 2
      SpiMainFunctionPeriod = 0.01
      SpiOptimizeOneJobSequences = false
      SpiOptimizedChannelsNumber = 0
      SpiOptimizedSeqNumber = 0
      SpiSupportConcurrentSyncTransmit = false
      SpiTransmitTimeout = 50000
      SpiVersionInfoApi = true
      SpiCPUClockRef = McuClockReferencePoint_0
      SpiPhyUnit_0 (SpiPhyUnit):
        SpiPhyUnitAsyncMethod = PIO_FIFO
        SpiPhyUnitMapping = LPSPI_0
        SpiPhyUnitMode = SPI_MASTER
        SpiPhyUnitSync = true
        SpiPhyUnitAlternateClockRef = McuClockReferencePoint_0
        SpiPhyUnitClockRef = McuClockReferencePoint_0
    SpiNonAUTOSAR:
      SpiAllowBigSizeCollections = false
      SpiDisableDemReportErrorStatus = false
      SpiEnableHWUnitAsyncMode = false
      SpiEnableUserModeSupport = false
      SpiJobStartNotificationEnable = false
    SpiPublishedInformation: SpiMaxHwUnit=0
package /Base
  module config Base: implementation-config-variant=VARIANT-PRE-COMPILE
    CommonPublishedInformation:
      ArReleaseMajorVersion = 4
      ArReleaseMinorVersion = 2
      ArReleaseRevisionVersion = 2
      ModuleId = 0
      SwMajorVersion = 1
      SwMinorVersion = 0
      SwPatchVersion = 0
      VendorId = 43
package /Port
  module config Port: implementation-config-variant=VARIANT-POST-BUILD, module-description=Port_Impl
    CommonPublishedInformation:
      ArReleaseMajorVersion = 4
      ArReleaseMinorVersion = 2
      ArReleaseRevisionVersion = 2
      ModuleId = 124
      SwMajorVersion = 1
      SwMinorVersion = 0
      SwPatchVersion = 0
      VendorId = 43
    PortConfigSet
      NotUsedPortPin: PortPinDSE=Low_Drive_Strength, PortPinDirection=PORT_PIN_IN, PortPinLevelValue=PORT_PIN_LEVEL_LOW, PortPinPE=PullDisabled, PortPinPS=PullDown
      PortContainer_0 (PortContainer): PortNumberOfPortPins=6
        6 x PortPin, all with PortPinPFE=false, PortPinDirectionChangeable=true, PortPinModeChangeable=true, PortPinDSE=Low_drive_strength, PortPinPE=PullDisabled, PortPinPS=PullDown, PortPinInitialMode=PORT_GPIO_MODE, PortPinLevelValue=PORT_PIN_LEVEL_LOW:
          PortPin_JTAG_TMS_SWD_DIO: PortPinId=1, PortPinPcr=4, PortPinMode=JTAG_TMS_SWD_DIO, PortPinDirection=PORT_PIN_IN
          PortPin_JTAG_TDO: PortPinId=2, PortPinPcr=10, PortPinMode=JTAG_TDO, PortPinDirection=PORT_PIN_OUT
          PortPin_JTAG_TCLK_SWD_CLK: PortPinId=3, PortPinPcr=68, PortPinMode=JTAG_TCLK_SWD_CLK, PortPinDirection=PORT_PIN_IN
          PortPin_JTAG_TDI: PortPinId=4, PortPinPcr=69, PortPinMode=JTAG_TDI, PortPinDirection=PORT_PIN_IN
          PortPin_CAN0_TX: PortPinId=5, PortPinPcr=133, PortPinMode=CAN0_TX, PortPinDirection=PORT_PIN_OUT
          PortPin_CAN0_RX: PortPinId=6, PortPinPcr=132, PortPinMode=CAN0_RX, PortPinDirection=PORT_PIN_IN
    PortGeneral:
      PortDevErrorDetect = true
      PortEnableUserModeSupport = false
      PortSetPinDirectionApi = true
      PortSetPinModeApi = true
      PortSetPinModeDoesNotTouchGpioLevel = false
      PortVersionInfoApi = true
package /Adc
  module config Adc: implementation-config-variant=VARIANT-POST-BUILD, module-description=Adc_Impl
    AdcConfigSet
      AdcHwUnit_0 (AdcHwUnit):
        AdcHwUnitId = ADC0
        AdcLogicalUnitId = 0
        AdcOffsetCorrectionValue = 0
        AdcResolution = BITS_12
        AdcTransferType = ADC_INTERRUPT
        AdcVoltageReferenceSelection = VREFH_VREFL
        AdcChannel_0 (AdcChannel): AdcChannelId=AN_0, AdcLogicalChannelId=0
        AdcGroup_0 (AdcGroup):
          AdcDelayNextPdb = 0
          AdcEnableDoubleBuffering = false
          AdcExtraNotification = NULL_PTR
          AdcGroupAccessMode = ADC_ACCESS_MODE_SINGLE
          AdcGroupConversionMode = ADC_CONV_MODE_ONESHOT
          AdcGroupConversionType = ADC_CONV_TYPE_NORMAL
          AdcGroupId = 0
          AdcGroupInBacktoBackMode = true
          AdcGroupTriggSrc = ADC_TRIGG_SRC_SW
          AdcGroupUsesChannelDelays = false
          AdcHwTrigSrc = PDB
          AdcPdbPeriodContinuousMode = 0
          AdcStreamingBufferMode = ADC_STREAM_BUFFER_LINEAR
          AdcStreamingNumSamples = 1
          AdcWithoutInterrupts = false
          AdcGroupDefinition = AdcChannel_0
    AdcGeneral:
      AdcDeInitApi = true
      AdcDevErrorDetect = true
      AdcDmaTimeout = 65535
      AdcEnableLimitCheck = false
      AdcEnableQueuing = true
      AdcEnableStartStopGroupApi = true
      AdcGrpNotifCapability = true
      AdcHwTriggerApi = false
      AdcPriorityImplementation = ADC_PRIORITY_NONE
      AdcPriorityQueueMaxDepth = 1
      AdcReadGroupApi = true
      AdcResultAlignment = ADC_ALIGN_RIGHT
      AdcTimeout = 65535
      AdcVersionInfoApi = true
    AdcInterrupt_0 (AdcInterrupt): AdcInterruptEnable=true, AdcInterruptSource=ADC0_COCO
    AdcInterrupt_1 (AdcInterrupt): AdcInterruptEnable=false, AdcInterruptSource=ADC1_COCO
    AdcPublishedInformation: AdcChannelValueSigned=false, AdcGroupFirstChannelFixed=false, AdcMaxChannelResolution=12
    CommonPublishedInformation:
      ArReleaseMajorVersion = 4
      ArReleaseMinorVersion = 2
      ArReleaseRevisionVersion = 2
      ModuleId = 123
      SwMajorVersion = 1
      SwMinorVersion = 0
      SwPatchVersion = 0
      VendorApiInfix = 
      VendorId = 43
    NonAutosar:
      AdcBypassConsistencyLoop = false
      AdcContinuousWithoutInterrupt = false
      AdcConvTimeOnce = false
      AdcDisableDemReportErrorStatus = false
      AdcEnableCalibration = false
      AdcEnableDmaTrasferMode = false
      AdcEnableDoubleBufferingOptimization = false
      AdcEnableDualClockMode = false
      AdcEnableGroupDependentChannelNames = false
      AdcEnableInitialNotification = false
      AdcEnableSetChannel = false
      AdcEnableUserModeSupport = false
      AdcOptimizeOneShotHwTriggerConversions = false
      AdcUseHardwareNormalGroups = false
package /Wdg
  module config Wdg: implementation-config-variant=VARIANT-POST-BUILD, module-description=Wdg_Impl
    CommonPublishedInformation:
      ArReleaseMajorVersion = 4
      ArReleaseMinorVersion = 2
      ArReleaseRevisionVersion = 2
      ModuleId = 102
      SwMajorVersion = 1
      SwMinorVersion = 0
      SwPatchVersion = 0
      VendorId = 43
    WdgClockReferencePoint_0 (WdgClockReferencePoint): WdgClockReference=McuClockReferencePoint_1
    WdgGeneral:
      WdgCallbackNotification0 = NULL_PTR
      WdgDevErrorDetect = true
      WdgDisableAllowed = true
      WdgEnableUserModeSupport = false
      WdgIndex = 0
      WdgIndex{1..3} = {1..3}
      WdgInitialTimeout = 1
      WdgMaxTimeout = 1
      WdgRunArea = ROM
      WdgTriggerLocation = NULL_PTR
      WdgVersionInfoApi = true
      NonAutosar: WdgDisableDemReportErrorStatus=false
    WdgPublishedInformation: WdgTriggerMode=WDG_BOTH
    WdgSettingsConfig_0 (WdgSettingsConfig): WdgDefaultMode=WDGIF_FAST_MODE, WdgInstance=WDOG0, WdgInterruptContentEnable=true, WdgExternalTriggerCounterRef=GptChannelConfiguration_0
      WdgSettingsFast:
        WdgAllowUpdates = true
        WdgClockSelection = Bus_Clock
        WdgClockValue = 8000
        WdgOperationMode = ResetOnTimeOut
        WdgPrescalerEnabled = true
        WdgRunsInDebugMode = false
        WdgRunsInStopMode = true
        WdgRunsInWaitMode = false
        WdgTestMode = TestModeDisabled
        WdgTimeoutPeriod = 0.01
        WdgWindowMode = false
        WdgWindowPeriod = 0.004
        WdgClkSrcRef = WdgClockReferencePoint_0
      WdgSettingsOff: WdgAllowUpdates=true
      WdgSettingsSlow:
        WdgAllowUpdates = true
        WdgClockSelection = Bus_Clock
        WdgClockValue = 8000
        WdgOperationMode = ResetOnTimeOut
        WdgPrescalerEnabled = true
        WdgRunsInDebugMode = false
        WdgRunsInStopMode = true
        WdgRunsInWaitMode = false
        WdgTestMode = TestModeDisabled
        WdgTimeoutPeriod = 0.01
        WdgWindowMode = false
        WdgWindowPeriod = 0.004
        WdgClkSrcRef = WdgClockReferencePoint_0
package /Dio
  module config Dio: implementation-config-variant=VARIANT-PRE-COMPILE, module-description=Dio_Impl
    CommonPublishedInformation:
      ArReleaseMajorVersion = 4
      ArReleaseMinorVersion = 2
      ArReleaseRevisionVersion = 2
      ModuleId = 120
      SwMajorVersion = 1
      SwMinorVersion = 0
      SwPatchVersion = 0
      VendorId = 43
    DioConfig
      DioPort_0 (DioPort): DioPortId=0
    DioGeneral:
      DioDevErrorDetect = true
      DioEnableUserModeSupport = false
      DioFlipChannelApi = false
      DioMaskedWritePortApi = false
      DioReadZeroForUndefinedPortPins = false
      DioReversePortBits = false
      DioVersionInfoApi = false
package /Pwm
  module config Pwm: implementation-config-variant=VARIANT-POST-BUILD, module-description=Pwm_Impl
    CommonPublishedInformation:
      ArReleaseMajorVersion = 4
      ArReleaseMinorVersion = 2
      ArReleaseRevisionVersion = 2
      ModuleId = 121
      SwMajorVersion = 1
      SwMinorVersion = 0
      SwPatchVersion = 0
      VendorId = 43
    PwmChannelConfigSet
      PwmChannel_0 (PwmChannel):
        PwmChannelClass = PWM_FIXED_PERIOD
        PwmChannelId = 0
        PwmDutycycleDefault = 16384
        PwmIdleState = PWM_LOW
        PwmNotification = NULL
        PwmPeriodDefault = 0.000125
        PwmPeriodInTicks = true
        PwmPolarity = PWM_HIGH
        PwmFtmChannel = PwmFtmChannels_0
        PwmMcuClockReferencePoint = McuClockReferencePoint_0
      PwmFtmModule_0 (PwmFtmModule):
        FtmModule = FTM_1
        PwmBDMEnable = CNT_STOPED_FLAG_SET
        PwmChanEdgeAlignment = PWM_EDGE_ALIGNED
        PwmClockSelection = PWM_SYSTEM_CLOCK
        PwmFtmFaultFunctionality = FLTCTRL_DISABLED
        PwmPrescaler = PRESC_1
        PwmPrescaler_Alternate = PRESC_1
        PwmReloadFrequency = LDFQ_EACH1
        PwmUpdatedEndPeriod = true
        PwmUpdatedMiddlePeriod = false
        PwmExternalTriggerSettings:
          PwmEnableExternalTriggerChannel{0..7} = false
          PwmEnableInitializationTrigger = false
        PwmFtmChannelFaultSettings:
          PwmDisableOutputOnFault{0..3} = false
          PwmFilterValue = 0
          PwmFtmFaultOutputState = SAFE_VALUES
          PwmFtmChannelFault{0..3}Settings: PwmEnableFault{0..3}Filter=false, PwmFault{0..3}Notification=NULL, PwmFault{0..3}Polarity=false
        PwmFtmChannels_0 (PwmFtmChannels): ChannelCombDeadTimeEn=false, ChannelEdgeSetup=INDEPENDENT, PwmFtmChannelId=FTM_1_CH_0, PwmPhaseShift=0
    PwmConfigurationOfOptApiServices:
      PwmDeInitApi = true
      PwmDiableTrigger = false
      PwmEnableTrigger = false
      PwmForceOutputToZeroApi = false
      PwmGetChannelStateApi = false
      PwmGetOutputState = false
      PwmSetDutyCycle = true
      PwmSetDutyCycle_NoUpdate = false
      PwmSetOutputToIdle = true
      PwmSetPeriodAndDuty = true
      PwmSetPeriodAndDuty_NoUpdate = false
      PwmSetPhaseShift = false
      PwmSetPhaseShiftNoUpdate = false
      PwmSwResetCounter = false
      PwmVersionInfoApi = true
    PwmGeneral:
      EnableMaskingOperations = false
      PwmCommonTimebaseSupported = false
      PwmDevErrorDetect = true
      PwmDutycycleUpdatedEndperiod = true
      PwmEnableDualClockMode = false
      PwmEnablePhaseShift = false
      PwmEnableUserModeSupport = false
      PwmFaultSupport = false
      PwmFtmEnableExtTrigger = false
      PwmIndex = 0
      PwmMultiChannelSynch = false
      PwmNotificationSupported = true
      PwmPeriodUpdatedEndperiod = true
      77 x PwmHwConfiguration, all with PwmInterruptEnable=false:
        PwmHwConfiguration_0: PwmChannelIsUsed=false, PwmInterruptHwId=PWM_FTM_0_CH_0_ISR
        PwmHwConfiguration_1: PwmChannelIsUsed=false, PwmInterruptHwId=PWM_FTM_0_CH_1_ISR
        PwmHwConfiguration_10: PwmChannelIsUsed=true, PwmInterruptHwId=PWM_FTM_1_CH_0_ISR
        PwmHwConfiguration_11: PwmChannelIsUsed=false, PwmInterruptHwId=PWM_FTM_1_CH_1_ISR
        PwmHwConfiguration_12: PwmChannelIsUsed=false, PwmInterruptHwId=PWM_FTM_1_CH_2_ISR
        PwmHwConfiguration_13: PwmChannelIsUsed=false, PwmInterruptHwId=PWM_FTM_1_CH_3_ISR
        PwmHwConfiguration_14: PwmChannelIsUsed=false, PwmInterruptHwId=PWM_FTM_1_CH_4_ISR
        PwmHwConfiguration_15: PwmChannelIsUsed=false, PwmInterruptHwId=PWM_FTM_1_CH_5_ISR
        PwmHwConfiguration_16: PwmChannelIsUsed=false, PwmInterruptHwId=PWM_FTM_1_CH_6_ISR
        PwmHwConfiguration_17: PwmChannelIsUsed=false, PwmInterruptHwId=PWM_FTM_1_CH_7_ISR
        PwmHwConfiguration_18: PwmChannelIsUsed=false, PwmInterruptHwId=PWM_FTM_1_TOF_ISR
        PwmHwConfiguration_19: PwmChannelIsUsed=false, PwmInterruptHwId=PWM_FTM_1_FAULT_ISR
        PwmHwConfiguration_2: PwmChannelIsUsed=false, PwmInterruptHwId=PWM_FTM_0_CH_2_ISR
        PwmHwConfiguration_20: PwmChannelIsUsed=false, PwmInterruptHwId=PWM_FTM_2_CH_0_ISR
        PwmHwConfiguration_21: PwmChannelIsUsed=false, PwmInterruptHwId=PWM_FTM_2_CH_1_ISR
        PwmHwConfiguration_22: PwmChannelIsUsed=false, PwmInterruptHwId=PWM_FTM_2_CH_2_ISR
        PwmHwConfiguration_23: PwmChannelIsUsed=false, PwmInterruptHwId=PWM_FTM_2_CH_3_ISR
        PwmHwConfiguration_24: PwmChannelIsUsed=false, PwmInterruptHwId=PWM_FTM_2_CH_4_ISR
        PwmHwConfiguration_25: PwmChannelIsUsed=false, PwmInterruptHwId=PWM_FTM_2_CH_5_ISR
        PwmHwConfiguration_26: PwmChannelIsUsed=false, PwmInterruptHwId=PWM_FTM_2_CH_6_ISR
        PwmHwConfiguration_27: PwmChannelIsUsed=false, PwmInterruptHwId=PWM_FTM_2_CH_7_ISR
        PwmHwConfiguration_28: PwmChannelIsUsed=false, PwmInterruptHwId=PWM_FTM_2_TOF_ISR
        PwmHwConfiguration_29: PwmChannelIsUsed=false, PwmInterruptHwId=PWM_FTM_2_FAULT_ISR
        PwmHwConfiguration_3: PwmChannelIsUsed=false, PwmInterruptHwId=PWM_FTM_0_CH_3_ISR
        PwmHwConfiguration_30: PwmChannelIsUsed=false, PwmInterruptHwId=PWM_FTM_3_CH_0_ISR
        PwmHwConfiguration_31: PwmChannelIsUsed=false, PwmInterruptHwId=PWM_FTM_3_CH_1_ISR
        PwmHwConfiguration_32: PwmChannelIsUsed=false, PwmInterruptHwId=PWM_FTM_3_CH_2_ISR
        PwmHwConfiguration_33: PwmChannelIsUsed=false, PwmInterruptHwId=PWM_FTM_3_CH_3_ISR
        PwmHwConfiguration_34: PwmChannelIsUsed=false, PwmInterruptHwId=PWM_FTM_3_CH_4_ISR
        PwmHwConfiguration_35: PwmChannelIsUsed=false, PwmInterruptHwId=PWM_FTM_3_CH_5_ISR
        PwmHwConfiguration_36: PwmChannelIsUsed=false, PwmInterruptHwId=PWM_FTM_3_CH_6_ISR
        PwmHwConfiguration_37: PwmChannelIsUsed=false, PwmInterruptHwId=PWM_FTM_3_CH_7_ISR
        PwmHwConfiguration_38: PwmChannelIsUsed=false, PwmInterruptHwId=PWM_FTM_3_TOF_ISR
        PwmHwConfiguration_39: PwmChannelIsUsed=false, PwmInterruptHwId=PWM_FTM_3_FAULT_ISR
        PwmHwConfiguration_4: PwmChannelIsUsed=false, PwmInterruptHwId=PWM_FTM_0_CH_4_ISR
        PwmHwConfiguration_40: PwmChannelIsUsed=false, PwmInterruptHwId=PWM_FTM_4_CH_0_ISR
        PwmHwConfiguration_41: PwmChannelIsUsed=false, PwmInterruptHwId=PWM_FTM_4_CH_1_ISR
        PwmHwConfiguration_42: PwmChannelIsUsed=false, PwmInterruptHwId=PWM_FTM_4_CH_2_ISR
        PwmHwConfiguration_43: PwmChannelIsUsed=false, PwmInterruptHwId=PWM_FTM_4_CH_3_ISR
        PwmHwConfiguration_44: PwmChannelIsUsed=false, PwmInterruptHwId=PWM_FTM_4_CH_4_ISR
        PwmHwConfiguration_45: PwmChannelIsUsed=false, PwmInterruptHwId=PWM_FTM_4_CH_5_ISR
        PwmHwConfiguration_46: PwmChannelIsUsed=false, PwmInterruptHwId=PWM_FTM_4_CH_6_ISR
        PwmHwConfiguration_47: PwmChannelIsUsed=false, PwmInterruptHwId=PWM_FTM_4_CH_7_ISR
        PwmHwConfiguration_48: PwmChannelIsUsed=false, PwmInterruptHwId=PWM_FTM_4_TOF_ISR
        PwmHwConfiguration_49: PwmChannelIsUsed=false, PwmInterruptHwId=PWM_FTM_4_FAULT_ISR
        PwmHwConfiguration_5: PwmChannelIsUsed=false, PwmInterruptHwId=PWM_FTM_0_CH_5_ISR
        PwmHwConfiguration_50: PwmChannelIsUsed=false, PwmInterruptHwId=PWM_FTM_5_CH_0_ISR
        PwmHwConfiguration_51: PwmChannelIsUsed=false, PwmInterruptHwId=PWM_FTM_5_CH_1_ISR
        PwmHwConfiguration_52: PwmChannelIsUsed=false, PwmInterruptHwId=PWM_FTM_5_CH_2_ISR
        PwmHwConfiguration_53: PwmChannelIsUsed=false, PwmInterruptHwId=PWM_FTM_5_CH_3_ISR
        PwmHwConfiguration_54: PwmChannelIsUsed=false, PwmInterruptHwId=PWM_FTM_5_CH_4_ISR
        PwmHwConfiguration_55: PwmChannelIsUsed=false, PwmInterruptHwId=PWM_FTM_5_CH_5_ISR
        PwmHwConfiguration_56: PwmChannelIsUsed=false, PwmInterruptHwId=PWM_FTM_5_CH_6_ISR
        PwmHwConfiguration_57: PwmChannelIsUsed=false, PwmInterruptHwId=PWM_FTM_5_CH_7_ISR
        PwmHwConfiguration_58: PwmChannelIsUsed=false, PwmInterruptHwId=PWM_FTM_5_TOF_ISR
        PwmHwConfiguration_59: PwmChannelIsUsed=false, PwmInterruptHwId=PWM_FTM_5_FAULT_ISR
        PwmHwConfiguration_6: PwmChannelIsUsed=false, PwmInterruptHwId=PWM_FTM_0_CH_6_ISR
        PwmHwConfiguration_60: PwmChannelIsUsed=false, PwmInterruptHwId=PWM_FTM_6_CH_0_ISR
        PwmHwConfiguration_61: PwmChannelIsUsed=false, PwmInterruptHwId=PWM_FTM_6_CH_1_ISR
        PwmHwConfiguration_62: PwmChannelIsUsed=false, PwmInterruptHwId=PWM_FTM_6_CH_2_ISR
        PwmHwConfiguration_63: PwmChannelIsUsed=false, PwmInterruptHwId=PWM_FTM_6_CH_3_ISR
        PwmHwConfiguration_64: PwmChannelIsUsed=false, PwmInterruptHwId=PWM_FTM_6_CH_4_ISR
        PwmHwConfiguration_65: PwmChannelIsUsed=false, PwmInterruptHwId=PWM_FTM_6_CH_5_ISR
        PwmHwConfiguration_66: PwmChannelIsUsed=false, PwmInterruptHwId=PWM_FTM_6_CH_7_ISR
        PwmHwConfiguration_67: PwmChannelIsUsed=false, PwmInterruptHwId=PWM_FTM_6_TOF_ISR
        PwmHwConfiguration_68: PwmChannelIsUsed=false, PwmInterruptHwId=PWM_FTM_6_FAULT_ISR
        PwmHwConfiguration_69: PwmChannelIsUsed=false, PwmInterruptHwId=PWM_FTM_7_CH_0_ISR
        PwmHwConfiguration_7: PwmChannelIsUsed=false, PwmInterruptHwId=PWM_FTM_0_CH_7_ISR
        PwmHwConfiguration_70: PwmChannelIsUsed=false, PwmInterruptHwId=PWM_FTM_7_CH_1_ISR
        PwmHwConfiguration_71: PwmChannelIsUsed=false, PwmInterruptHwId=PWM_FTM_7_CH_2_ISR
        PwmHwConfiguration_72: PwmChannelIsUsed=false, PwmInterruptHwId=PWM_FTM_7_CH_3_ISR
        PwmHwConfiguration_73: PwmChannelIsUsed=false, PwmInterruptHwId=PWM_FTM_7_CH_5_ISR
        PwmHwConfiguration_74: PwmChannelIsUsed=false, PwmInterruptHwId=PWM_FTM_7_CH_7_ISR
        PwmHwConfiguration_75: PwmChannelIsUsed=false, PwmInterruptHwId=PWM_FTM_7_TOF_ISR
        PwmHwConfiguration_76: PwmChannelIsUsed=false, PwmInterruptHwId=PWM_FTM_7_FAULT_ISR
        PwmHwConfiguration_8: PwmChannelIsUsed=false, PwmInterruptHwId=PWM_FTM_0_TOF_ISR
        PwmHwConfiguration_9: PwmChannelIsUsed=false, PwmInterruptHwId=PWM_FTM_0_FAULT_ISR
package /Gpt
  module config Gpt: implementation-config-variant=VARIANT-POST-BUILD, module-description=Gpt_Impl
    CommonPublishedInformation:
      ArReleaseMajorVersion = 4
      ArReleaseMinorVersion = 2
      ArReleaseRevisionVersion = 2
      ModuleId = 100
      SwMajorVersion = 1
      SwMinorVersion = 0
      SwPatchVersion = 0
      VendorId = 43
    GptChannelConfigSet
      GptChannelConfiguration_0 (GptChannelConfiguration):
        GptChannelId = 0
        GptChannelMode = GPT_CH_MODE_ONESHOT
        GptChannelTickFrequency = 8000000
        GptChannelTickValueMax = 65535
        GptEnableWakeup = false
        GptFreezeEnable = true
        GptHwChannel = FTM_0_CH_0
        GptLPitEnReloadOnTrigger = false
        GptLPitEnStartOnTrigger = false
        GptLPitEnStopOnInterrupt = false
        GptLPitIsExternalTrigger = false
        GptNotification = Wdg_Cbk_GptNotification0
        GptFtmPrescaler = 1
        GptFtmChannelClkSrc = SYSTEM_CLOCK
        GptChannelClkSrcRef = GptClockReferencePoint_0
    GptConfigurationOfOptApiServices:
      GptDeinitApi = true
      GptEnableDisableNotificationApi = true
      GptPredefTimerFunctionalityApi = true
      GptTimeElapsedApi = true
      GptTimeRemainingApi = true
      GptVersionInfoApi = true
      GptWakeupFunctionalityApi = true
    GptDriverConfiguration:
      GptDevErrorDetect = true
      GptPredefTimer100us32bitEnable = false
      GptPredefTimer1usEnablingGrade = GPT_PREDEF_TIMER_1US_16BIT_ENABLED
      GptRegisterLockingMode = NO_REGISTER_LOCKING
      GptReportWakeupSource = true
      GptClockReferencePoint_0 (GptClockReferencePoint): GptClockReference=McuClockReferencePoint_FTM0_CLK
    38 x GptHwConfiguration:
      GptHwConfiguration_0: GptIsrEnable=false, GptIsrHwId=LPIT_0_CH_0, GptModuleIsUsed=false
      GptHwConfiguration_1: GptIsrEnable=false, GptIsrHwId=LPIT_0_CH_1, GptModuleIsUsed=false
      GptHwConfiguration_10: GptIsrEnable=false, GptIsrHwId=FTM_1_CH_4_CH_5, GptModuleIsUsed=false
      GptHwConfiguration_11: GptIsrEnable=false, GptIsrHwId=FTM_1_CH_6_CH_7, GptModuleIsUsed=false
      GptHwConfiguration_12: GptIsrEnable=false, GptIsrHwId=FTM_2_CH_0_CH_1, GptModuleIsUsed=false
      GptHwConfiguration_13: GptIsrEnable=false, GptIsrHwId=FTM_2_CH_2_CH_3, GptModuleIsUsed=false
      GptHwConfiguration_14: GptIsrEnable=false, GptIsrHwId=FTM_2_CH_4_CH_5, GptModuleIsUsed=false
      GptHwConfiguration_15: GptIsrEnable=false, GptIsrHwId=FTM_2_CH_6_CH_7, GptModuleIsUsed=false
      GptHwConfiguration_16: GptIsrEnable=false, GptIsrHwId=FTM_3_CH_0_CH_1, GptModuleIsUsed=false
      GptHwConfiguration_17: GptIsrEnable=false, GptIsrHwId=FTM_3_CH_2_CH_3, GptModuleIsUsed=false
      GptHwConfiguration_18: GptIsrEnable=false, GptIsrHwId=FTM_3_CH_4_CH_5, GptModuleIsUsed=false
      GptHwConfiguration_19: GptIsrEnable=false, GptIsrHwId=FTM_3_CH_6_CH_7, GptModuleIsUsed=false
      GptHwConfiguration_2: GptIsrEnable=false, GptIsrHwId=LPIT_0_CH_2, GptModuleIsUsed=false
      GptHwConfiguration_20: GptIsrEnable=false, GptIsrHwId=FTM_4_CH_0_CH_1, GptModuleIsUsed=false
      GptHwConfiguration_21: GptIsrEnable=false, GptIsrHwId=FTM_4_CH_2_CH_3, GptModuleIsUsed=false
      GptHwConfiguration_22: GptIsrEnable=false, GptIsrHwId=FTM_4_CH_4_CH_5, GptModuleIsUsed=false
      GptHwConfiguration_23: GptIsrEnable=false, GptIsrHwId=FTM_4_CH_6_CH_7, GptModuleIsUsed=false
      GptHwConfiguration_24: GptIsrEnable=false, GptIsrHwId=FTM_5_CH_0_CH_1, GptModuleIsUsed=false
      GptHwConfiguration_25: GptIsrEnable=false, GptIsrHwId=FTM_5_CH_2_CH_3, GptModuleIsUsed=false
      GptHwConfiguration_26: GptIsrEnable=false, GptIsrHwId=FTM_5_CH_4_CH_5, GptModuleIsUsed=false
      GptHwConfiguration_27: GptIsrEnable=false, GptIsrHwId=FTM_5_CH_6_CH_7, GptModuleIsUsed=false
      GptHwConfiguration_28: GptIsrEnable=false, GptIsrHwId=FTM_6_CH_0_CH_1, GptModuleIsUsed=false
      GptHwConfiguration_29: GptIsrEnable=false, GptIsrHwId=FTM_6_CH_2_CH_3, GptModuleIsUsed=false
      GptHwConfiguration_3: GptIsrEnable=false, GptIsrHwId=LPIT_0_CH_3, GptModuleIsUsed=false
      GptHwConfiguration_30: GptIsrEnable=false, GptIsrHwId=FTM_6_CH_4_CH_5, GptModuleIsUsed=false
      GptHwConfiguration_31: GptIsrEnable=false, GptIsrHwId=FTM_6_CH_6_CH_7, GptModuleIsUsed=false
      GptHwConfiguration_32: GptIsrEnable=false, GptIsrHwId=FTM_7_CH_0_CH_1, GptModuleIsUsed=false
      GptHwConfiguration_33: GptIsrEnable=false, GptIsrHwId=FTM_7_CH_2_CH_3, GptModuleIsUsed=false
      GptHwConfiguration_34: GptIsrEnable=false, GptIsrHwId=FTM_7_CH_4_CH_5, GptModuleIsUsed=false
      GptHwConfiguration_35: GptIsrEnable=false, GptIsrHwId=FTM_7_CH_6_CH_7, GptModuleIsUsed=false
      GptHwConfiguration_36: GptIsrEnable=false, GptIsrHwId=LPTMR_0_CH_0, GptModuleIsUsed=false
      GptHwConfiguration_37: GptIsrEnable=false, GptIsrHwId=SRTC_0_CH_0, GptModuleIsUsed=false
      GptHwConfiguration_4: GptIsrEnable=true, GptIsrHwId=FTM_0_CH_0_CH_1, GptModuleIsUsed=true
      GptHwConfiguration_5: GptIsrEnable=false, GptIsrHwId=FTM_0_CH_2_CH_3, GptModuleIsUsed=false
      GptHwConfiguration_6: GptIsrEnable=false, GptIsrHwId=FTM_0_CH_4_CH_5, GptModuleIsUsed=false
      GptHwConfiguration_7: GptIsrEnable=false, GptIsrHwId=FTM_0_CH_6_CH_7, GptModuleIsUsed=false
      GptHwConfiguration_8: GptIsrEnable=false, GptIsrHwId=FTM_1_CH_0_CH_1, GptModuleIsUsed=false
      GptHwConfiguration_9: GptIsrEnable=false, GptIsrHwId=FTM_1_CH_2_CH_3, GptModuleIsUsed=false
    GptNonAUTOSAR: GptEnableDualClockMode=false, GptEnableTriggers=false, GptEnableUserModeSupport=false
    GptPredefTimerConfiguration
      GptPredefTimer_1us_16Bit:
        GptChannelPrescaler = 8
        GptFreezeEnable = true
        GptFtmChannelClkSrc = SYSTEM_CLOCK
        GptHwChannel = FTM_0_CH_0
        GptLptmrChannelClkSrc = SIRCDIV2_CLK
        GptChannelClkSrcRef = GptClockReferencePoint_0
package /Mcl
  module config Mcl: implementation-config-variant=VARIANT-POST-BUILD, module-description=Mcl_Impl
    CommonPublishedInformation:
      ArReleaseMajorVersion = 4
      ArReleaseMinorVersion = 2
      ArReleaseRevisionVersion = 2
      ModuleId = 255
      SwMajorVersion = 1
      SwMinorVersion = 0
      SwPatchVersion = 0
      VendorId = 43
    MclConfigSet_0 (MclConfigSet)
      DMAChannel_0 (DMAChannel):
        DMAChannelPriority = 0
        DPA = false
        DmaHwChannel = eDMA_0
        DmaSource{0..9} = NOT_USED
        ECP = false
        EMI = false
        MclDMAChannelEnable = false
        MclDMAChannelId = 0
        MclDMAChannelTriggerEnable = false
        MclDmaTransferCompletionNotif = NULL_PTR
      DmaInstance_0 (DmaInstance):
        DmaHwInstance = eDMA_Instance0
        MclEDMA_CLM = false
        MclEDMA_CX = false
        MclEDMA_ECX = false
        MclEDMA_EDBG = false
        MclEDMA_ERCA = false
        MclEDMA_HALT = false
        MclEDMA_HOE = false
      TriggerMux:
        TrgMuxAdc0Input{0..3} = INPUT_DISABLED
        TrgMuxAdc0LockEn = false
        TrgMuxAdc1Input{0..3} = INPUT_DISABLED
        TrgMuxAdc1LockEn = false
        TrgMuxCmp0Input0 = INPUT_DISABLED
        TrgMuxCmp0LockEn = false
        TrgMuxDmaMux0Input{0..3} = INPUT_DISABLED
        TrgMuxDmaMux0LockEn = false
        TrgMuxFlexIoInput{0..3} = INPUT_DISABLED
        TrgMuxFlexIoLockEn = false
        TrgMuxFtm0Input{0..3} = INPUT_DISABLED
        TrgMuxFtm0LockEn = false
        TrgMuxFtm1Input{0..3} = INPUT_DISABLED
        TrgMuxFtm1LockEn = false
        TrgMuxFtm2Input{0..3} = INPUT_DISABLED
        TrgMuxFtm2LockEn = false
        TrgMuxFtm3Input{0..3} = INPUT_DISABLED
        TrgMuxFtm3LockEn = false
        TrgMuxFtm4Input0 = INPUT_DISABLED
        TrgMuxFtm4LockEn = false
        TrgMuxFtm5Input0 = INPUT_DISABLED
        TrgMuxFtm5LockEn = false
        TrgMuxFtm6Input0 = INPUT_DISABLED
        TrgMuxFtm6LockEn = false
        TrgMuxFtm7Input0 = INPUT_DISABLED
        TrgMuxFtm7LockEn = false
        TrgMuxLpi2c0Input0 = INPUT_DISABLED
        TrgMuxLpi2c0LockEn = false
        TrgMuxLpi2c1Input0 = INPUT_DISABLED
        TrgMuxLpi2c1LockEn = false
        TrgMuxLpitInput{0..3} = INPUT_DISABLED
        TrgMuxLpitLockEn = false
        TrgMuxLpspi0Input0 = INPUT_DISABLED
        TrgMuxLpspi0LockEn = false
        TrgMuxLpspi1Input0 = INPUT_DISABLED
        TrgMuxLpspi1LockEn = false
        TrgMuxLptmr0Input0 = INPUT_DISABLED
        TrgMuxLptmr0LockEn = false
        TrgMuxLpuart0Input0 = INPUT_DISABLED
        TrgMuxLpuart0LockEn = false
        TrgMuxLpuart1Input0 = INPUT_DISABLED
        TrgMuxLpuart1LockEn = false
        TrgMuxPdb0Input0 = INPUT_DISABLED
        TrgMuxPdb0LockEn = false
        TrgMuxPdb1Input0 = INPUT_DISABLED
        TrgMuxPdb1LockEn = false
        TrgMuxXOut0Input{0..3} = INPUT_DISABLED
        TrgMuxXOut0LockEn = false
        TrgMuxXOut1Input{0..3} = INPUT_DISABLED
        TrgMuxXOut1LockEn = false
    MclGeneral:
      EnableDMA = true
      MclDevErrorDetect = true
      MclDisableDemReportErrorStatus = false
      MclDmaNotificationSupported = true
      MclEnableTrgMux = false
      MclEnableUserModeSupport = false
      MclErrorChecking = true
      MclErrorNotificationDma0 = NULL_PTR
      Mcl_DeInitApi = false
      Mcl_DmaGetChannelErrorStatusApi = false
      Mcl_DmaGetGlobalErrorStatusApi = false
      Mcl_VersionInfoApi = true
      16 x MclIsrAvailable, all with MclIsrEnabled=true:
        MclIsrAvailable_0: MclIsrName=eDMA_0
        MclIsrAvailable_1: MclIsrName=eDMA_1
        MclIsrAvailable_{10..15}: MclIsrName=eDMA_{10..15}
        MclIsrAvailable_{2..9}: MclIsrName=eDMA_{2..9}
      MclLmem: MclLmemCacheTimeout=2147483647, MclLmemEnableCacheApi=false, MclLmemEnableWriteBuffer=false, MclSynchronizeCache=false
package /Mcu
  module config Mcu: implementation-config-variant=VARIANT-POST-BUILD, module-description=Mcu_Impl
    CommonPublishedInformation:
      ArReleaseMajorVersion = 4
      ArReleaseMinorVersion = 2
      ArReleaseRevisionVersion = 2
      ModuleId = 101
      SwMajorVersion = 1
      SwMinorVersion = 0
      SwPatchVersion = 0
      VendorApiInfix = 
      VendorId = 43
    McuDebugConfiguration: McuDisableDemReportErrorStatus=false, McuGetMidrStructureApi=false, McuGetPeriphStateApi=false
    McuGeneralConfiguration:
      McuCalloutBeforePerformReset = false
      McuDevErrorDetect = true
      McuEnableUserModeSupport = false
      McuEnterLowPowerMode = true
      McuGetRamStateApi = false
      McuInitClock = true
      McuNoPll = false
      McuPerformResetApi = true
      McuPerformResetCallout = NULL_PTR
      McuTimeout = 500
      McuVersionInfoApi = false
    McuModuleConfiguration:
      McuClockSrcFailureNotification = ENABLED
      McuLPO1KClockEnable = true
      McuLPO32KClockEnable = true
      McuLPOClockSelect = LPO_CLK_128K
      McuNumberOfMcuModes = 1
      McuRTCCLKINFrequencyHz = 32000
      McuRamSectors = 0
      McuRtcClkSelect = SOSCDIV1_CLK
      McuAllowedModes: McuAllowHighSpeedRunMode=true, McuAllowVeryLowPowerModes=true
      McuClockSettingConfig_0 (McuClockSettingConfig): McuClockSettingId=0, McuScgClkOutSelect=SCG_SLOW_CLK, McuSysClockUnderMcuControl=true
        3 x McuClockReferencePoint:
          McuClockReferencePoint_0: McuClockFrequencySelect=RUN_SYS_CLK, McuClockReferencePointFrequency=48000000
          McuClockReferencePoint_1: McuClockFrequencySelect=SIRC_CLK, McuClockReferencePointFrequency=8000000
          McuClockReferencePoint_2: McuClockFrequencySelect=FTM1_CLK, McuClockReferencePointFrequency=8000000
        McuFIRCClockConfig:
          McuFIRCDiv1 = 1
          McuFIRCDiv1Frequency = 48000000
          McuFIRCDiv2 = 2
          McuFIRCDiv2Frequency = 24000000
          McuFIRCEnable = true
          McuFIRCFrequency = 48000000
          McuFIRCRangeSelect = TRIMMED_TO_48MHZ
          McuFIRCRegulatorEnable = false
          McuFIRCUnderMcuControl = true
        McuHsrunClockConfig:
          McuBusClockDivider = 3
          McuBusClockFrequency = 32000000
          McuCoreClockDivider = 1
          McuCoreClockFrequency = 96000000
          McuFlashClockFrequency = 24000000
          McuPreDivSystemClockFrequency = 96000000
          McuScgClkOutFrequency = 24000000
          McuSlowClockDivider = 4
          McuSystemClockFrequency = 96000000
          McuSystemClockSwitch = SPLL
        41 x McuPeripheralClockConfig, all with McuPeripheralClockDivider=1, McuPeripheralClockEnable=true, McuPeripheralClockFrequency=8000000, McuPeripheralFractionalDivider=0:
          McuPeripheralClockConfig_0: McuPerName=FTFC, McuPeripheralClockSelect=SPLL
          McuPeripheralClockConfig_1: McuPerName=DMAMUX0, McuPeripheralClockSelect=SOSC
          McuPeripheralClockConfig_10: McuPerName=PDB1, McuPeripheralClockSelect=SOSC
          McuPeripheralClockConfig_11: McuPerName=CRC, McuPeripheralClockSelect=SOSC
          McuPeripheralClockConfig_12: McuPerName=PDB0, McuPeripheralClockSelect=SOSC
          McuPeripheralClockConfig_13: McuPerName=LPIT, McuPeripheralClockSelect=SOSC
          McuPeripheralClockConfig_14: McuPerName=FTM0, McuPeripheralClockSelect=SOSC
          McuPeripheralClockConfig_15: McuPerName=FTM1, McuPeripheralClockSelect=SOSC
          McuPeripheralClockConfig_16: McuPerName=FTM2, McuPeripheralClockSelect=SOSC
          McuPeripheralClockConfig_17: McuPerName=ADC0, McuPeripheralClockSelect=SOSC
          McuPeripheralClockConfig_18: McuPerName=RTC, McuPeripheralClockSelect=SOSC
          McuPeripheralClockConfig_19: McuPerName=LPTMR0, McuPeripheralClockSelect=SOSC
          McuPeripheralClockConfig_2: McuPerName=FLEXCAN0, McuPeripheralClockSelect=SOSC
          McuPeripheralClockConfig_20: McuPerName=PORTA, McuPeripheralClockSelect=SOSC
          McuPeripheralClockConfig_21: McuPerName=PORTB, McuPeripheralClockSelect=SOSC
          McuPeripheralClockConfig_22: McuPerName=PORTC, McuPeripheralClockSelect=SOSC
          McuPeripheralClockConfig_23: McuPerName=PORTD, McuPeripheralClockSelect=SOSC
          McuPeripheralClockConfig_24: McuPerName=PORTE, McuPeripheralClockSelect=SOSC
          McuPeripheralClockConfig_25: McuPerName=SAI0, McuPeripheralClockSelect=SOSC
          McuPeripheralClockConfig_26: McuPerName=SAI1, McuPeripheralClockSelect=SOSC
          McuPeripheralClockConfig_27: McuPerName=FLEXIO, McuPeripheralClockSelect=SOSC
          McuPeripheralClockConfig_28: McuPerName=EWM, McuPeripheralClockSelect=SOSC
          McuPeripheralClockConfig_29: McuPerName=LPI2C0, McuPeripheralClockSelect=SOSC
          McuPeripheralClockConfig_3: McuPerName=FLEXCAN1, McuPeripheralClockSelect=SOSC
          McuPeripheralClockConfig_30: McuPerName=LPI2C1, McuPeripheralClockSelect=SOSC
          McuPeripheralClockConfig_31: McuPerName=LPUART0, McuPeripheralClockSelect=SOSC
          McuPeripheralClockConfig_32: McuPerName=LPUART1, McuPeripheralClockSelect=SOSC
          McuPeripheralClockConfig_33: McuPerName=LPUART2, McuPeripheralClockSelect=SOSC
          McuPeripheralClockConfig_34: McuPerName=FTM4, McuPeripheralClockSelect=SOSC
          McuPeripheralClockConfig_35: McuPerName=FTM5, McuPeripheralClockSelect=SOSC
          McuPeripheralClockConfig_36: McuPerName=FTM6, McuPeripheralClockSelect=SOSC
          McuPeripheralClockConfig_37: McuPerName=FTM7, McuPeripheralClockSelect=SOSC
          McuPeripheralClockConfig_38: McuPerName=CMP0, McuPeripheralClockSelect=SOSC
          McuPeripheralClockConfig_39: McuPerName=QSPI, McuPeripheralClockSelect=SOSC
          McuPeripheralClockConfig_4: McuPerName=FTM3, McuPeripheralClockSelect=SOSC
          McuPeripheralClockConfig_40: McuPerName=ENET, McuPeripheralClockSelect=SOSC
          McuPeripheralClockConfig_5: McuPerName=ADC1, McuPeripheralClockSelect=SOSC
          McuPeripheralClockConfig_6: McuPerName=FLEXCAN2, McuPeripheralClockSelect=SOSC
          McuPeripheralClockConfig_7: McuPerName=LPSPI0, McuPeripheralClockSelect=SOSC
          McuPeripheralClockConfig_8: McuPerName=LPSPI1, McuPeripheralClockSelect=SOSC
          McuPeripheralClockConfig_9: McuPerName=LPSPI2, McuPeripheralClockSelect=SOSC
        McuRunClockConfig:
          McuBusClockDivider = 1
          McuBusClockFrequency = 48000000
          McuCoreClockDivider = 2
          McuCoreClockFrequency = 48000000
          McuFlashClockFrequency = 24000000
          McuPreDivSystemClockFrequency = 96000000
          McuScgClkOutFrequency = 24000000
          McuSlowClockDivider = 2
          McuSystemClockFrequency = 48000000
          McuSystemClockSwitch = SPLL
        McuSIMClockConfig:
          McuClockOutDivider = 1
          McuClockOutEnable = false
          McuClockOutSelect = SCG_CLKOUT
          McuDMAClockGatingEnable = true
          McuDebugTraceDividerEnable = true
          McuEIMClockGatingEnable = true
          McuERMClockGatingEnable = true
          McuMPUClockGatingEnable = true
          McuMSCMClockGatingEnable = true
          McuTraceClockDivider = 1
          McuTraceClockFraction = 0
          McuTraceClockSelect = CORE_CLK
        McuSIRCClockConfig:
          McuSIRCDiv1 = 1
          McuSIRCDiv1Frequency = 8000000
          McuSIRCDiv2 = 2
          McuSIRCDiv2Frequency = 4000000
          McuSIRCEnable = true
          McuSIRCFrequency = 8000000
          McuSIRCLowPowerEnable = false
          McuSIRCRangeSelect = HIGH_RANGE_CLOCK
          McuSIRCStopEnable = false
          McuSIRCUnderMcuControl = true
        McuSystemOSCClockConfig:
          McuSOSCClockMonitorEnable = false
          McuSOSCClockMonitorResetEnable = false
          McuSOSCDiv1 = 1
          McuSOSCDiv1Frequency = 8000000
          McuSOSCDiv2 = 1
          McuSOSCDiv2Frequency = 8000000
          McuSOSCEnable = true
          McuSOSCExternalReferenceSelect = false
          McuSOSCFrequency = 8000000
          McuSOSCHighGainOscillatorSelect = false
          McuSOSCRangeSelect = HIGH_FREQ_RANGE
          McuSOSCUnderMcuControl = true
        McuSystemPll:
          McuSPLLClockMonitorEnable = false
          McuSPLLClockMonitorResetEnable = false
          McuSPLLDiv1 = 1
          McuSPLLDiv1Frequency = 96000000
          McuSPLLDiv2 = 2
          McuSPLLDiv2Frequency = 48000000
          McuSPLLEnable = true
          McuSPLLFrequency = 96000000
          McuSPLLInputClkPreDivider = 1
          McuSPLLInputFrequency = 8000000
          McuSPLLMultiplier = 24
          McuSystemPllUnderMcuControl = true
        McuVlprClockConfig:
          McuBusClockDivider = 1
          McuBusClockFrequency = 4000000
          McuCoreClockDivider = 2
          McuCoreClockFrequency = 4000000
          McuFlashClockFrequency = 1000000
          McuPreDivSystemClockFrequency = 8000000
          McuScgClkOutFrequency = 1000000
          McuSlowClockDivider = 4
          McuSystemClockFrequency = 4000000
          McuSystemClockSwitch = SIRC
        McuClockReferencePoint_ExtOSC (McuClockReferencePoint): McuClockReferencePointFrequency=8000000, McuClockFrequencySelect=SOSC_CLK
        McuClockReferencePoint_FTM0_CLK (McuClockReferencePoint): McuClockReferencePointFrequency=8000000, McuClockFrequencySelect=FTM0_CLK
      McuInterruptEvents: McuAlternateResetEvent=false, McuVoltageErrorEvent=false
      McuModeSettingConf_0 (McuModeSettingConf): McuMode=0, McuPowerMode=RUN
      McuPowerControl:
        McuClockBiasDisable = false
        McuLPODisable = false
        McuLowPowerBiasEnable = false
        McuLowVoltageDetectInterruptEnable = false
        McuLowVoltageDetectResetEnable = false
        McuLowVoltageWarningInterruptEnable = false
        McuLpoTrimming = 0
      McuResetConfig: McuResetPinFilterBusClockSelect=0, McuResetPinFilterInRunAndWait=ALL_FILTERING_DISABLE, McuResetPinFilterInStopMode=ALL_FILTERING_DISABLE
        McuSystemInterruptEnable:
          McuCoreLockupInterrupt = false
          McuExternalResetPinInterrupt = false
          McuGlobalInterrupt = false
          McuJTAGResetInterrupt = false
          McuLossOfClockInterrupt = false
          McuLossOfLockInterrupt = false
          McuMDMAPSystemResetInterrupt = false
          McuResetDelayTime = DELAY_10_LPO_CYCLES
          McuSoftwareInterrupt = false
          McuStopAcknowledgeErrorInterrupt = false
          McuWatchdogInterrupt = false
      McuSIMConfig
        McuAdcOptionsConfiguration:
          McuADC0PreTrigeerSourceSelect = PDB_PRE_TRIGGER
          McuADC0SoftwarePreTrigeerSourceSelect = SW_PRE_TRIGGER_DISABLE
          McuADC0TrigeerSourceSelect = PDB
          McuADC1PreTrigeerSourceSelect = PDB_PRE_TRIGGER
          McuADC1SoftwarePreTrigeerSourceSelect = SW_PRE_TRIGGER_DISABLE
          McuADC1TrigeerSourceSelect = PDB
          McuSoftwareTriggerToTRGMUX = false
        McuChipControlConfiguration:
          McuAdcSupply = VDD
          McuEnableAdcSupplyMonitoring = false
          McuPDBBackToBackSelect = false
          McuPTB0InterleaveChannelSelect = false
          McuPTB13InterleaveChannelSelect = false
          McuPTB14InterleaveChannelSelect = false
          McuPTB1InterleaveChannelSelect = false
        McuFlexTimerConfiguration:
          McuFTM0Ch{0..7}ModulationSelect = false
          McuFTM0ExternalClockPinSelect = TCLK0_PIN
          McuFTM0Fault{0..2}Select = FTM0_FLT{0..2}_PIN
          McuFTM0OBEControl = false
          McuFTM0SyncBit = false
          McuFTM1Ch0InputSelect = FTM1_CH0_INPUT
          McuFTM1ExternalClockPinSelect = TCLK0_PIN
          McuFTM1Fault{0..2}Select = FTM1_FLT{0..2}_PIN
          McuFTM1OBEControl = false
          McuFTM1SyncBit = false
          McuFTM2Ch0InputSelect = FTM2_CH0_INPUT
          McuFTM2Ch1InputSelect = FTM2_CHI1_INPUT
          McuFTM2ExternalClockPinSelect = TCLK0_PIN
          McuFTM2Fault{0..2}Select = FTM2_FLT{0..2}_PIN
          McuFTM2OBEControl = false
          McuFTM2SyncBit = false
          McuFTM3Ch{0..7}ModulationSelect = false
          McuFTM3ExternalClockPinSelect = TCLK0_PIN
          McuFTM3Fault{0..2}Select = FTM3_FLT{0..2}_PIN
          McuFTM3OBEControl = false
          McuFTM3SyncBit = false
          McuFTM4ExternalClockPinSelect = TCLK0_PIN
          McuFTM4OBEControl = false
          McuFTM4SyncBit = false
          McuFTM5ExternalClockPinSelect = TCLK0_PIN
          McuFTM5OBEControl = false
          McuFTM5SyncBit = false
          McuFTM6ExternalClockPinSelect = TCLK0_PIN
          McuFTM6OBEControl = false
          McuFTM6SyncBit = false
          McuFTM7ExternalClockPinSelect = TCLK0_PIN
          McuFTM7OBEControl = false
          McuFTM7SyncBit = false
          McuFTMGlobalLoadEnable = false
          McuFTM_GTBControl = false
          McuQspiClkSelect = false
          McuRMII_ClkSelect = false
          McuRMII_Clk_OBE = false
    McuPublishedInformation
      14 x McuResetReasonConf, all with McuResetReason=5:
        MCU_CORE_LOCKUP_RESET
        MCU_EXTERNAL_PIN_RESET
        MCU_JTAG_RESET
        MCU_LOSS_OF_CLOCK_RESET
        MCU_LOSS_OF_LOCK_RESET
        MCU_LOW_OR_HIGH_VOLTAGE_DETECT_RESET
        MCU_MDM_AP_SYSTEM_RESET
        MCU_MULTIPLE_RESET_REASON
        MCU_NO_RESET_REASON
        MCU_POWER_ON_RESET
        MCU_RESET_UNDEFINED
        MCU_SOFTWARE_RESET
        MCU_STOP_ACKNOWLEDGE_ERROR_RESET
        MCU_WATCHDOG_RESET
