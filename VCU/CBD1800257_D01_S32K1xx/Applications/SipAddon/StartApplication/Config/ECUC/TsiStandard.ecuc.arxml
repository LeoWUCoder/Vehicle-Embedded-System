[part 1 of 5: package /ActiveEcuC]
AUTOSAR XML (schema 4-2-1)
package /ActiveEcuC
  ecuc value collection ActiveEcuC: ecu-extract=SYSTEM
    ecuc-values:
      EcuC
      Os
      Vita
      Com
      Rte
      ComM
      Dem
      Dcm
      CanIf
      Can
      CanTp
      Det
      PduR
      EcuM
      CanSM
      BswM
      Nm
      Fls
      Icu
      Csec
      Resource
      Eep
      Spi
      Base
      Port
      Adc
      Wdg
      Dio
      Pwm
      Gpt
      Mcl
      Mcu
      Ea
      NvM
      WdgIf
      WdgM
      Crc
      MemIf
      RamTst
      Cdd_Com
      NmOsek
      vSet
  module config EcuC: implementation-config-variant=VARIANT-PRE-COMPILE, module-description=EcuC_Impl
    EcucGeneral:
      CPUType = CPU32Bit
      SizeOfInt = Size32Bit
      ByteOrder = LITTLE_ENDIAN
      BitOrder = LSB_to_MSB
      AtomicBitAccessInBitfield = false
      AtomicVariableAccess = Atomic32BitAccess
      SizeOfEnum = Size32Bit
      SizeOfROMPointer = Size32Bit
      SizeOfRAMPointer = Size32Bit
      BitFieldDataType = INT
      StructAlignment = Auto
      ArrayAlignment = Auto
      StructInArrayAlignment = Auto
      DummyFunction = false
      EcuCSafeBswChecks = false
      DummyStatement = true
      DummyStatementKind = SelfAssignment
      ConditionalGenerating = true
      EcucBswImplementationCodeType = EcuCSourceCode
      EcuCUseStdReturnTypeForRte = false
      BswInitialization
        48 x InitFunction:
          Vita_Init: Header=, InitPhase=NO_INIT, ModuleRef=Vita
          BswM_InitMemory: Header=BswM.h, InitPhase=INIT_MEMORY, ModuleRef=BswM
          BswM_Init: Header=BswM.h, InitPhase=NO_INIT, ConfigType=BswM_ConfigType, ConfigPtrName=BswM_Config_Ptr, ConfigPtrClass=BSWM_INIT_DATA, ModuleRef=BswM
          CanIf_Init: Header=CanIf.h, InitPhase=INIT_TWO_IF, ConfigType=CanIf_ConfigType, ConfigPtrName=CanIf_Config_Ptr, ConfigPtrClass=CANIF_INIT_DATA, ModuleRef=CanIf
          CanIf_InitMemory: Header=CanIf.h, InitPhase=INIT_MEMORY, ModuleRef=CanIf
          CanSM_InitMemory: Header=CanSM_EcuM.h, InitPhase=INIT_MEMORY, ModuleRef=CanSM
          CanSM_Init: Header=CanSM_EcuM.h, InitPhase=INIT_TWO_SM, ConfigType=CanSM_ConfigType, ConfigPtrName=CanSM_Config_Ptr, ConfigPtrClass=CANSM_INIT_DATA, ModuleRef=CanSM
          CanTp_Init: Header=CanTp.h, InitPhase=INIT_TWO_TP, ConfigType=CanTp_ConfigType, ConfigPtrName=CanTp_Config_Ptr, ConfigPtrClass=CANTP_INIT_DATA, ModuleRef=CanTp
          CanTp_InitMemory: Header=CanTp.h, InitPhase=INIT_MEMORY, ModuleRef=CanTp
          Can_InitMemory: Header=Can.h, InitPhase=INIT_MEMORY, ModuleRef=Can
          Can_Init: Header=Can.h, InitPhase=INIT_TWO_DRV, ConfigType=Can_ConfigType, ConfigPtrName=Can_Config_Ptr, ConfigPtrClass=CAN_INIT_DATA, ModuleRef=Can
          ComM_Init: Header=ComM.h, InitPhase=INIT_TWO_POST_NVMREADALL, ModuleRef=ComM
          ComM_InitMemory: Header=ComM.h, InitPhase=INIT_MEMORY, ModuleRef=ComM
          Com_Init: Header=Com.h, InitPhase=INIT_TWO_COM, ConfigType=Com_ConfigType, ConfigPtrName=Com_Config_Ptr, ConfigPtrClass=COM_INIT_DATA, ModuleRef=Com
          Com_InitMemory: Header=Com.h, InitPhase=INIT_MEMORY, ModuleRef=Com
          Dcm_Init: Header=Dcm.h, InitPhase=INIT_TWO_POST_NVMREADALL, ConfigType=Dcm_ConfigType, ConfigPtrName=NULL_PTR, ConfigPtrClass=DCM_CONST, ModuleRef=Dcm
          Dcm_InitMemory: Header=Dcm.h, InitPhase=INIT_MEMORY, ModuleRef=Dcm
          Dem_Init: Header=Dem.h, InitPhase=INIT_TWO_POST_NVMREADALL, ConfigType=Dem_ConfigType, ConfigPtrName=Dem_Config_Ptr, ConfigPtrClass=DEM_INIT_DATA, ModuleRef=Dem
          Dem_PreInit: Header=Dem.h, InitPhase=INIT_ZERO, ConfigType=Dem_ConfigType, ConfigPtrName=Dem_Config_Ptr, ConfigPtrClass=DEM_INIT_DATA, ModuleRef=Dem
          Dem_InitMemory: Header=Dem.h, InitPhase=INIT_MEMORY, ModuleRef=Dem
          Det_InitMemory: Header=Det.h, InitPhase=INIT_MEMORY, ModuleRef=Det
          Det_Init: Header=Det.h, InitPhase=INIT_ZERO, ConfigType=Det_ConfigType, ConfigPtrName=Det_Config_Ptr, ConfigPtrClass=DET_INIT_DATA, ModuleRef=Det
          EcuM_Init: Header=EcuM.h, InitPhase=NO_INIT, ConfigType=EcuM_PbConfigType, ConfigPtrName=EcuM_Config_Ptr, ConfigPtrClass=ECUM_INIT_DATA, ModuleRef=EcuM
          Nm_Init: Header=Nm.h, InitPhase=INIT_TWO_NM, ModuleRef=Nm
          Nm_InitMemory: Header=Nm.h, InitPhase=INIT_MEMORY, ModuleRef=Nm
          PduR_InitMemory: Header=PduR.h, InitPhase=INIT_MEMORY, ModuleRef=PduR
          PduR_Init: Header=PduR.h, InitPhase=INIT_TWO_COM, ConfigType=PduR_PBConfigType, ConfigPtrName=PduR_Config_Ptr, ConfigPtrClass=PDUR_INIT_DATA, ModuleRef=PduR
          SchM_Init: Header=Rte_Main.h, InitPhase=NO_INIT, ModuleRef=Rte
          Rte_InitMemory: Header=Rte_Main.h, InitPhase=INIT_MEMORY, ModuleRef=Rte
          Adc_Init: Header=Adc.h, InitPhase=INIT_ONE_LATE, ConfigType=Adc_ConfigType, ConfigPtrName=&AdcConfigSet, ConfigPtrClass=ADC_APPL_CONST, ModuleRef=Adc
          Fls_Init: Header=Fls_Api.h, InitPhase=INIT_ONE_LATE, ConfigType=Fls_ConfigType, ConfigPtrName=&FlsConfigSet, ConfigPtrClass=FLS_APPL_CONST, ModuleRef=Fls
          Gpt_Init: Header=Gpt.h, InitPhase=INIT_ONE, ConfigType=Gpt_ConfigType, ConfigPtrName=&GptChannelConfigSet, ConfigPtrClass=GPT_APPL_CONST, ModuleRef=Gpt
          Icu_Init: Header=Icu.h, InitPhase=INIT_ONE_LATE, ConfigType=Icu_ConfigType, ConfigPtrName=&IcuConfigSet, ConfigPtrClass=ICU_APPL_CONST, ModuleRef=Icu
          Mcl_Init: Header=CDD_Mcl.h, InitPhase=INIT_ONE, ConfigType=Mcl_ConfigType, ConfigPtrName=&MclConfigSet_0, ConfigPtrClass=MCL_APPL_CONST, ModuleRef=Mcl
          Mcu_Init: Header=Mcu.h, InitPhase=INIT_ONE_EARLY, ConfigType=Mcu_ConfigType, ConfigPtrName=&McuModuleConfiguration, ConfigPtrClass=MCU_APPL_CONST, AdditionalInitCode=Mcu_InitClock(McuConf_McuClockSettingConfig_McuClockSettingConfig_0); while (MCU_PLL_LOCKED != Mcu_GetPllStatus()); Mcu_DistributePllClock();, ModuleRef=Mcu
          Port_Init: Header=Port.h, InitPhase=INIT_ONE_EARLY, ConfigType=Port_ConfigType, ConfigPtrName=&PortConfigSet, ConfigPtrClass=PORT_APPL_CONST, ModuleRef=Port
          Pwm_Init: Header=Pwm.h, InitPhase=INIT_ONE, ConfigType=Pwm_ConfigType, ConfigPtrName=&PwmChannelConfigSet, ConfigPtrClass=PWM_APPL_CONST, ModuleRef=Pwm
          Spi_Init: Header=Spi.h, InitPhase=INIT_ONE, ConfigType=Spi_ConfigType, ConfigPtrName=NULL_PTR, ConfigPtrClass=SPI_APPL_CONST, ModuleRef=Spi
          Wdg_Init: Header=Wdg.h, InitPhase=INIT_ONE, ConfigType=Wdg_ConfigType, ConfigPtrName=NULL_PTR, ConfigPtrClass=WDG_APPL_CONST, ModuleRef=Wdg
          Ea_Init: Header=Ea.h, InitPhase=INIT_TWO_IF, ModuleRef=Ea
          NvM_Init: Header=NvM.h, InitPhase=INIT_TWO_SYS, ModuleRef=NvM
          WdgM_Init: Header=WdgM.h, InitPhase=INIT_TWO_IF, ConfigType=WdgM_ConfigType, ConfigPtrName=&WdgMConfig_Mode0_core0, ConfigPtrClass=WDGM_APPL_CONST, ModuleRef=WdgM
          RamTst_InitMemory: Header=RamTst.h, InitPhase=INIT_MEMORY, ModuleRef=RamTst
          RamTst_Init: Header=RamTst.h, InitPhase=INIT_THREE, ModuleRef=RamTst
          NmOsek_Init: Header=NmOsek.h, InitPhase=INIT_TWO_NM, ConfigType=NmOsek_ConfigType, ConfigPtrName=NmOsek_Config_Ptr, ConfigPtrClass=NMOSEK_INIT_DATA, ModuleRef=NmOsek
          NmOsek_InitMemory: Header=NmOsek.h, InitPhase=INIT_MEMORY, ModuleRef=NmOsek
          Csec_Init: Header=Csec.h, InitPhase=INIT_ONE, ConfigType=Csec_ConfigType, ConfigPtrName=NULL_PTR, ConfigPtrClass=CSEC_APPL_CONST, ModuleRef=Csec
          Eep_Init: Header=Eep_Api.h, InitPhase=INIT_ONE, ConfigType=Eep_ConfigType, ConfigPtrName=&EepInitConfiguration, ConfigPtrClass=EEP_APPL_CONST, ModuleRef=Eep
    EcucHardware
      EcucCoreDefinition_CORE0 (EcucCoreDefinition): EcucCoreId=0
    EcucPduCollection: PduIdTypeEnum=UINT16, PduLengthTypeEnum=UINT16
      39 x Pdu, all with J1939Requestable=false:
        msg_StartAppl_Tx_MyECU_oCAN_c14d78df_Tx: PduLength=8, SysTPduToFrameMappingRef=msg_StartAppl_Tx_MyECU
        msg_TxCycle1000_10_oCAN_6dd6f284_Tx: PduLength=2, SysTPduToFrameMappingRef=msg_TxCycle1000_10
        msg_XCP_Response_MyECU_oCAN_5d942f8b_Tx: PduLength=8, SysTPduToFrameMappingRef=msg_XCP_Response_MyECU
        msg_RxEvent_20_oCAN_a1df81ad_Rx: PduLength=4
        msg_diag_Response_MyECU_oCAN_84acb98b_Tx: PduLength=8
        msg_StartAppl_Rx_MyECU_oCAN_0da3c1e2_Rx: PduLength=8
        msg_diag_RequestGlobal_oCAN_2eba11fb_Rx: PduLength=7
        msg_RxCycle500_20_oCAN_266969e8_Rx: PduLength=6, SysTPduToFrameMappingRef=msg_RxCycle500_20
        msg_diag_Request_MyECU_Slave3_oCAN_87f08505_Rx: PduLength=8, SysTPduToFrameMappingRef=msg_diag_Request_MyECU_Slave3
        msg_TxEvent_10_oCAN_b2cd4fc2_Tx: PduLength=7
        msg_RxCycle100_0_oCAN_c71398f9_Rx: PduLength=1, SysTPduToFrameMappingRef=msg_RxCycle100_0
        msg_TxCycle_E2eProf1C_500_30_oCAN_eeefc687_Tx: PduLength=8
        msg_TxCycle10_0_oCAN_85bf3e37_Tx: PduLength=7
        msg_XCP_Request_MyECU_oCAN_24ce420e_Rx: PduLength=8, SysTPduToFrameMappingRef=msg_XCP_Request_MyECU
        msg_diag_RequestGlobal_oCAN_e06c7e2d_Rx: PduLength=7
        msg_diag_Request_MyECU_Tp_oCAN_44a1d668_Rx: PduLength=8, SysTPduToFrameMappingRef=msg_diag_Request_MyECU_Tp
        msg_TxEvent_10_oCAN_b9443fef_Tx: PduLength=7, SysTPduToFrameMappingRef=msg_TxEvent_10
        msg_TxCycle1000_10_oCAN_d74aed68_Tx: PduLength=2
        msg_RxCycle100_0_oCAN_1e247d16_Rx: PduLength=1
        msg_RxEvent_20_oCAN_13517c6b_Rx: PduLength=4, SysTPduToFrameMappingRef=msg_RxEvent_20
        msg_diag_Request_MyECU_oCAN_cd2e72ff_Rx: PduLength=8
        msg_diag_Response_MyECU_oCAN_06426912_Tx: PduLength=8
        msg_TxCycle10_0_oCAN_2d7b6a87_Tx: PduLength=7, SysTPduToFrameMappingRef=msg_TxCycle10_0
        msg_diag_Request_MyECU_oCAN_ca029ee7_Rx: PduLength=8
        GlobalTimeMaster_oCAN_48f281bc_Rx: PduLength=8, SysTPduToFrameMappingRef=GlobalTimeMaster
        msg_diag_Response_MyECU_Slave3_oCAN_659398e3_Tx: PduLength=8, SysTPduToFrameMappingRef=msg_diag_Response_MyECU_Slave3
        msg_diag_Response_MyECU_Tp_oCAN_eec7d8e8_Tx: PduLength=8, SysTPduToFrameMappingRef=msg_diag_Response_MyECU_Tp
        msg_StartAppl_Rx_MyECU_oCAN_fe93a56e_Rx: PduLength=8, SysTPduToFrameMappingRef=msg_StartAppl_Rx_MyECU
        msg_RxCycle500_20_oCAN_a691adb3_Rx: PduLength=6
        msg_diag_Uudt_Response_MyECU_oCAN_f130d337_Tx: PduLength=8
        msg_diag_RequestGlobal_Tp_oCAN_2ced7a67_Rx: PduLength=8, SysTPduToFrameMappingRef=msg_diag_RequestGlobal_Tp
        msg_diag_Uudt_Response_MyECU_oCAN_e0fa8c3a_Tx: PduLength=8, SysTPduToFrameMappingRef=msg_diag_Uudt_Response_MyECU
        msg_RxCycle_E2eProf1C_500_10_oCAN_e8110737_Rx: PduLength=8
        msg_RxCycle_E2eProf1C_500_10_oCAN_23e9789c_Rx: PduLength=8, SysTPduToFrameMappingRef=msg_RxCycle_E2eProf1C_500_10
        msg_TxCycle_E2eProf1C_500_30_oCAN_995018f6_Tx: PduLength=8, SysTPduToFrameMappingRef=msg_TxCycle_E2eProf1C_500_30
        msg_StartAppl_Tx_MyECU_oCAN_ad461e3f_Tx: PduLength=8
        Pdu_NmOsekUserDataTxPdu: PduLength=6
        Pdu_NmOsek_Rx: PduLength=8
        Pdu_NmOsek_Tx: PduLength=8
    EcucPartitionCollection
      EcucPartition_BSW (EcucPartition):
        EcucPartitionBswModuleExecution = true
        PartitionCanBeRestarted = false
        ASIL = QM
        EcucPartitionSoftwareComponentInstanceRef = Os_OsCore0_swc
        EcucPartitionSoftwareComponentInstanceRef = Det
        EcucPartitionSoftwareComponentInstanceRef = WdgM_OsApplication_NonTrusted_Core0
  module config Os: implementation-config-variant=VARIANT-PRE-COMPILE, module-description=Os_Impl
    SystemTimer (OsCounter):
      OsCounterMaxAllowedValue = 2147483647
      OsCounterMinCycle = 1
      OsCounterType = HARDWARE
      OsSecondsPerTick = 0.001
      OsCounterTicksPerBase = 48000
      OsCounterAccessingApplication = SystemApplication_OsCore0
      OsDriver: OsDriverHighResolution=false, OsDriverHardwareTimerChannelRef=SysTick_Ch0, OsDriverIsrRef=CounterIsr_SystemTimer
    OsOS:
      OsGenerateMemMapForNearAddressing = false
      OsStackMonitoring = true
      OsStatus = EXTENDED
      OsUseGetServiceId = false
      OsUseParameterAccess = false
      OsUseResScheduler = false
      OsForcibleTermination = true
      OsGenerateCalloutStubs = true
      OsGenerateMemMap = COMPLETE
      OsGenerateMemMapForThreads = false
      OsServiceProtection = false
      OsStackUsageMeasurement = false
      OsUseXSignalAsyncApiCalls = false
      OsFpuUsage = NONE
      OsNumberOfCores = 1
      OsScalabilityClass = SC3
      OsMasterCore = OsCore0
      OsSystemTimer = SystemTimer
      OsHooks: OsErrorHook=true, OsPostTaskHook=false, OsPreTaskHook=false, OsShutdownHook=false, OsStartupHook=false, OsProtectionHook=true
      OsDebug: OsAssertions=false, OsORTIDebugSupport=ORTI_23_ADDITIONAL
      OsStackSummary
        14 x OsStack, all with OsStackCore=OsCore0:
          OsCore0_Error: OsStackSize=1024, OsStackType=CORE_ERROR_STACK, OsStackUser=OsCore0
          OsCore0_Init: OsStackSize=2048, OsStackType=CORE_INIT_STACK, OsStackUser=OsCore0
          OsCore0_Kernel: OsStackSize=1024, OsStackType=CORE_KERNEL_STACK, OsStackUser=OsCore0
          OsCore0_Isr_Core: OsStackSize=1024, OsStackType=ISR_SHARED_CORE_STACK, OsStackUser=CanIsr_0_BusOff, OsStackUser=CanIsr_0_MB00To15, OsStackUser=CanIsr_0_MB16To31, OsStackUser=CounterIsr_SystemTimer, OsStackUser=FTM_0_CH_0_CH_1_ISR
          Default_Appl_Task: OsStackSize=2048, OsStackType=TASK_EXTENDED_STACK, OsStackUser=Os/Default_Appl_Task
          Default_BSW_Async_Task: OsStackSize=4096, OsStackType=TASK_EXTENDED_STACK, OsStackUser=Os/Default_BSW_Async_Task
          OsCore0_Task_Prio10: OsStackSize=1024, OsStackType=TASK_SHARED_PRIORITY_STACK, OsStackUser=Default_RTE_Mode_switch_Task
          OsCore0_Task_Prio30: OsStackSize=1024, OsStackType=TASK_SHARED_PRIORITY_STACK, OsStackUser=OsTask_WdgM_Cyclic
          OsCore0_Task_Prio40: OsStackSize=1024, OsStackType=TASK_SHARED_PRIORITY_STACK, OsStackUser=Default_BSW_Sync_Task
          OsCore0_Task_Prio4294967295: OsStackSize=1024, OsStackType=TASK_SHARED_PRIORITY_STACK, OsStackUser=IdleTask_OsCore0
          OsCore0_Task_Prio45: OsStackSize=1024, OsStackType=TASK_SHARED_PRIORITY_STACK, OsStackUser=Default_Appl_Init_Task
          OsCore0_Task_Prio50: OsStackSize=2048, OsStackType=TASK_SHARED_PRIORITY_STACK, OsStackUser=Default_Init_Task
          OsCore0_Task_Prio5: OsStackSize=1024, OsStackType=TASK_SHARED_PRIORITY_STACK, OsStackUser=StartApplication_MemoryViolation_Task, OsStackUser=StartApplication_Trusted_Task
          OsCore0_Protection: OsStackSize=1024, OsStackType=CORE_PROTECTION_STACK, OsStackUser=OsCore0
    OSDEFAULTAPPMODE (OsAppMode)
    OS_APPMODE_ANY (OsAppMode)
    OsPublishedInformation: OsKernelVersion=7, OsPlatformName=Arm
      S32K148 (OsDerivativeInformation):
        OsMpuAlignment = 32
        OsStackAlignment = 32
        OsExceptionVectorTableAlignment = 0
        OsInterruptVectorTableAlignment = 128
        OsHardwareManuals = NXP/Freescale - S32K14x Series Reference Manual - Supports S32K142, S32K144, S32K146, and S32K148 Document Number: S32K14XRM - Rev. 3, 03/2017
        Core0 (OsPhysicalCore):
          OsPhysicalCoreId = 0
          OsPhysicalCoreExceptionSources = 8
          OsPhysicalCoreIsAutostart = true
          OsPhysicalCoreMasterStartAllowed = false
          OsPhysicalCorePrivelegedHwAccess = true
          OsPhysicalCoreType = Cortex-M
          OsPhysicalCoreDefaultEntrySymbol = _start
          OsPhysicalCoreStackProtectionUnit = SystemMPU0
        INTC (OsSystemIntCtrl):
          OsSystemIntCtrlMaxPrios = 224
          OsSystemIntCtrlMaxSources = 240
          OsSystemIntCtrlPrioOrder = DESC
          OsSystemIntCtrlBaseAddress = 3758153728
          OsSystemIntCtrlType = NVIC
        OsMemoryRegionDefaults_AppT (OsMemoryRegionDefaults): OsMemoryRegionDefType=APPLICATION_TRUSTED, OsMemoryRegionDefAccessRights=SUPERVISOR_RWX, OsMemoryRegionDefBusMasters=Core
        OsMemoryRegionDefaults_AppNT (OsMemoryRegionDefaults):
          OsMemoryRegionDefType = APPLICATION_NONTRUSTED
          OsMemoryRegionDefBusMasters = Core
          OsMemoryRegionDefAccessRights = USER_R
          OsMemoryRegionDefAccessRights = USER_W
        OsMemoryRegionSpecifics
          3 x OsMemoryRegionAccess:
            SUPERVISOR_RW: OsMemoryRegionAccessRights=RW, OsMemoryRegionAccessType=SUPERVISOR
            SUPERVISOR_RWX: OsMemoryRegionAccessRights=RWX, OsMemoryRegionAccessType=SUPERVISOR
            USER_W: OsMemoryRegionAccessRights=W, OsMemoryRegionAccessType=USER
          4 x OsMemoryRegionBusMaster:
            Core: OsMemoryRegionBusMasterId=0
            Debugger: OsMemoryRegionBusMasterId=1
            DMA: OsMemoryRegionBusMasterId=2
            ENET: OsMemoryRegionBusMasterId=3
          PID_ENABLE (OsMemoryRegionFlag)
          3 x OsMemoryRegionAccess:
            USER_R: OsMemoryRegionAccessRights=R, OsMemoryRegionAccessType=USER
            USER_X: OsMemoryRegionAccessRights=X, OsMemoryRegionAccessType=USER
            SUPERVISOR_RX: OsMemoryRegionAccessRights=RX, OsMemoryRegionAccessType=SUPERVISOR
        SysTick (OsHardwareTimer): OsHardwareTimerBaseAddress=3758153744, OsHardwareTimerId=0, OsHardwareTimerSize=24, OsHardwareTimerUnit=PIT, OsHardwareTimerType=SysTick
          SysTick_Ch0 (OsHardwareTimerChannel): OsHardwareTimerChannelId=0, OsHardwareTimerChannelIntSource=15, OsHardwareTimerChannelOffset=0
        SystemMPU0 (OsSystemMpu): OsSystemMpuBaseAddress=1073795072, OsSystemMpuId=0, OsSystemMpuMaxRegions=16, OsSystemMpuType=SYSTEM_MPU_NXP
        DEFAULT (OsInterruptSupportedType): OsInterruptSupportedTypeSeparateSources=false
    OsCore0 (OsCore):
      OsCoreIsAutostart = true
      OsCoreIsAutosar = true
      OsCoreEntrySymbol = _start
      OsCorePhysicalCoreRef = Core0
      OsCoreEcucCoreRef = EcucCoreDefinition_CORE0
      OsCoreIdleTask = IdleTask_OsCore0
      OsCoreSystemApplication = SystemApplication_OsCore0
      OsCoreStacks:
        OsCoreKernelStackSize = 1024
        OsCoreStartupStackSize = 1024
        OsCoreShutdownStackSize = 1024
        OsCoreErrorStackSize = 1024
        OsCoreProtectionStackSize = 1024
        OsCoreInitStackSize = 2048
    IdleTask_OsCore0 (OsTask):
      OsTaskActivation = 1
      OsTaskPriority = 4294967295
      OsTaskSchedule = FULL
      OsTaskStackSharing = false
      OsTaskStackSize = 1024
      OsTaskType = AUTO
      OsTaskUsesFpu = false
      OsTaskAccessingApplication = SystemApplication_OsCore0
      OsTaskResourceRef = OsResource_EcuM
      OsTaskAutostart: OsTaskAppModeRef=OS_APPMODE_ANY
    SystemApplication_OsCore0 (OsApplication):
      OsTrusted = true
      OsTrustedApplicationDelayTimingViolationCall = false
      OsTrustedApplicationWithProtection = false
      OsApplicationIsPrivileged = true
      OsAppUseTrustedFunctionStubs = false
      OsApplicationCoreRef = EcucCoreDefinition_CORE0
      OsAppTaskRef = IdleTask_OsCore0
      OsAppCounterRef = SystemTimer
      OsAppIsrRef = CounterIsr_SystemTimer
      OsApplicationHooks: OsAppErrorHook=false, OsAppShutdownHook=false, OsAppStartupHook=false
    6 x OsTask, all with OsTaskActivation=1, OsTaskSchedule=NON, OsTaskStackSharing=false, OsTaskUsesFpu=false, OsTaskAccessingApplication=SystemApplication_OsCore0:
      Default_Init_Task: OsTaskPriority=50, OsTaskStackSize=2048, OsTaskType=BASIC
        OsTaskAutostart: OsTaskAppModeRef=OSDEFAULTAPPMODE
      Default_BSW_Sync_Task: OsTaskPriority=40, OsTaskStackSize=1024, OsTaskType=AUTO
      Default_BSW_Async_Task: OsTaskPriority=30, OsTaskStackSize=4096, OsTaskType=AUTO, OsTaskEventRef=Rte_Ev_Cyclic2_Default_BSW_Async_Task_0_10ms, OsTaskEventRef=Rte_Ev_Cyclic2_Default_BSW_Async_Task_0_20ms, OsTaskEventRef=Rte_Ev_Cyclic2_Default_BSW_Async_Task_0_5ms, OsTaskEventRef=Rte_Ev_Cyclic2_Default_BSW_Async_Task_0_1ms, OsTaskAccessingApplication=OsApplication_Trusted_Core0
      Default_RTE_Mode_switch_Task: OsTaskPriority=10, OsTaskStackSize=1024, OsTaskType=AUTO
      Default_Appl_Task: OsTaskPriority=5, OsTaskStackSize=2048, OsTaskType=AUTO, OsTaskEventRef=Rte_Ev_Run_StartApplication_StartApplication_Cyclic1000ms, OsTaskEventRef=Rte_Ev_Run_StartApplication_StartApplication_Cyclic10ms, OsTaskEventRef=Rte_Ev_Run_StartApplication_StartApplication_Cyclic1ms, OsTaskEventRef=Rte_Ev_Run_StartApplication_StartApplication_Cyclic250ms, OsTaskEventRef=Rte_Ev_Run_StartApplication_StartApplication_OnDataRec_RxCtrl, OsTaskEventRef=Rte_Ev_Run_StartApplication_StartApplication_OnDataRec_RxData, OsTaskAccessingApplication=OsApplication_Trusted_Core0
      Default_Appl_Init_Task: OsTaskPriority=45, OsTaskStackSize=1024, OsTaskType=BASIC, OsTaskAccessingApplication=OsApplication_Trusted_Core0
    OsApplication_Trusted_Core0 (OsApplication):
      OsTrusted = true
      OsTrustedApplicationDelayTimingViolationCall = false
      OsTrustedApplicationWithProtection = false
      OsApplicationIsPrivileged = true
      OsAppUseTrustedFunctionStubs = true
      OsApplicationCoreRef = EcucCoreDefinition_CORE0
      OsAppTaskRef = OsTask_WdgM_Cyclic
      OsAppTaskRef = StartApplication_Trusted_Task
      OsAppAlarmRef = Os/Rte_Al_TE2_OsTask_WdgM_Cyclic_0_10ms
      OsApplicationHooks: OsAppErrorHook=false, OsAppShutdownHook=false, OsAppStartupHook=false
    OsApplication_NonTrusted_Core0 (OsApplication):
      OsTrusted = false
      OsTrustedApplicationDelayTimingViolationCall = false
      OsTrustedApplicationWithProtection = false
      OsApplicationIsPrivileged = false
      OsAppUseTrustedFunctionStubs = false
      OsApplicationCoreRef = EcucCoreDefinition_CORE0
      OsAppIsrRef = CanIsr_0_BusOff
      OsAppIsrRef = CanIsr_0_MB00To15
      OsAppIsrRef = CanIsr_0_MB16To31
      OsAppEcucPartitionRef = EcucPartition_BSW
      OsAppAlarmRef = Os/Rte_Al_TE2_Default_BSW_Async_Task_0_5ms
      OsAppAlarmRef = Os/Rte_Al_TE2_Default_BSW_Async_Task_0_10ms
      OsAppAlarmRef = Os/Rte_Al_TE2_Default_BSW_Async_Task_0_20ms
      OsAppAlarmRef = Os/Rte_Al_TE_StartApplication_StartApplication_Cyclic10ms
      OsAppAlarmRef = Os/Rte_Al_TE_StartApplication_StartApplication_Cyclic1ms
      OsAppAlarmRef = Os/Rte_Al_TE_StartApplication_StartApplication_Cyclic250ms
      OsAppAlarmRef = Os/Rte_Al_TE_StartApplication_StartApplication_Cyclic1000ms
      OsAppTaskRef = Default_Appl_Init_Task
      OsAppTaskRef = Os/Default_Appl_Task
      OsAppTaskRef = Os/Default_BSW_Async_Task
      OsAppTaskRef = Default_BSW_Sync_Task
      OsAppTaskRef = Default_Init_Task
      OsAppTaskRef = Default_RTE_Mode_switch_Task
      OsAppTaskRef = StartApplication_MemoryViolation_Task
      OsAppAlarmRef = Os/Rte_Al_TE2_Default_BSW_Async_Task_0_1ms
      OsAppAlarmRef = Os/Rte_Al_TE_StartApplication_StartApplication_MEMORYPROTECTION_Cyclic10ms
      OsAppIsrRef = FTM_0_CH_0_CH_1_ISR
      OsApplicationHooks: OsAppErrorHook=false, OsAppShutdownHook=false, OsAppStartupHook=false
    4 x OsIsr, all with OsIsrCategory=CATEGORY_2, OsIsrInterruptType=EXTERNAL, OsIsrStackSize=1024, OsIsrEnableNesting=false, OsIsrUsesFpu=false, OsIsrInterruptMapping=DEFAULT:
      CanIsr_0_BusOff: OsIsrInterruptSource=94, OsIsrInterruptPriority=16, OsIsrSpecialFunctionName=CanBusOffIsr_0  # Os Interrupt Service Routine PLAIN_TEXT CAN BusOff Interrupt. This OsIsr container has been created automatically based on the driver configuration.
      CanIsr_0_MB16To31: OsIsrInterruptSource=98, OsIsrInterruptPriority=48, OsIsrSpecialFunctionName=CanMailboxIsr_0  # Os Interrupt Service Routine PLAIN_TEXT CAN Tx and Rx Interrupt. This OsIsr container has been created automatically based on the driver configuration.
      CanIsr_0_MB00To15: OsIsrInterruptSource=97, OsIsrInterruptPriority=32, OsIsrSpecialFunctionName=CanMailboxIsr_0  # Os Interrupt Service Routine PLAIN_TEXT CAN Tx and Rx Interrupt. This OsIsr container has been created automatically based on the driver configuration.
      CounterIsr_SystemTimer: OsIsrInterruptSource=15, OsIsrInterruptPriority=64, OsIsrSpecialFunctionName=Os_TimerPitIsr
    OsResource_EcuM (OsResource):
      OsResourceProperty = STANDARD
      OsResourceAccessingApplication = OsApplication_Trusted_Core0
      OsResourceAccessingApplication = SystemApplication_OsCore0
    Rte_Al_TE2_Default_BSW_Async_Task_0_10ms (OsAlarm): OsAlarmCounterRef=SystemTimer, OsAlarmAccessingApplication=SystemApplication_OsCore0, OsAlarmAccessingApplication=OsApplication_Trusted_Core0
      OsAlarmAction
        OsAlarmSetEvent: OsAlarmSetEventRef=Rte_Ev_Cyclic2_Default_BSW_Async_Task_0_10ms, OsAlarmSetEventTaskRef=Os/Default_BSW_Async_Task
    Rte_Al_TE2_Default_BSW_Async_Task_0_20ms (OsAlarm): OsAlarmCounterRef=SystemTimer, OsAlarmAccessingApplication=SystemApplication_OsCore0, OsAlarmAccessingApplication=OsApplication_Trusted_Core0
      OsAlarmAction
        OsAlarmSetEvent: OsAlarmSetEventRef=Rte_Ev_Cyclic2_Default_BSW_Async_Task_0_20ms, OsAlarmSetEventTaskRef=Os/Default_BSW_Async_Task
    Rte_Ev_Cyclic2_Default_BSW_Async_Task_0_10ms (OsEvent)
    Rte_Ev_Cyclic2_Default_BSW_Async_Task_0_20ms (OsEvent)
    OsTask_WdgM_Cyclic (OsTask):
      OsTaskActivation = 1
      OsTaskPriority = 30
      OsTaskSchedule = NON
      OsTaskStackSharing = false
      OsTaskStackSize = 1024
      OsTaskType = AUTO
      OsTaskUsesFpu = false
      OsTaskAccessingApplication = SystemApplication_OsCore0
      OsTaskAccessingApplication = OsApplication_NonTrusted_Core0
    Rte_Al_TE2_Default_BSW_Async_Task_0_5ms (OsAlarm): OsAlarmCounterRef=SystemTimer, OsAlarmAccessingApplication=SystemApplication_OsCore0, OsAlarmAccessingApplication=OsApplication_Trusted_Core0
      OsAlarmAction
        OsAlarmSetEvent: OsAlarmSetEventRef=Rte_Ev_Cyclic2_Default_BSW_Async_Task_0_5ms, OsAlarmSetEventTaskRef=Os/Default_BSW_Async_Task
    Rte_Ev_Cyclic2_Default_BSW_Async_Task_0_5ms (OsEvent)
    4 x OsAlarm, all with OsAlarmCounterRef=SystemTimer, OsAlarmAccessingApplication=SystemApplication_OsCore0, OsAlarmAccessingApplication=OsApplication_Trusted_Core0:
      Rte_Al_TE_StartApplication_StartApplication_Cyclic1000ms
        OsAlarmAction
          OsAlarmSetEvent: OsAlarmSetEventRef=Rte_Ev_Run_StartApplication_StartApplication_Cyclic1000ms, OsAlarmSetEventTaskRef=Os/Default_Appl_Task
      Rte_Al_TE_StartApplication_StartApplication_Cyclic10ms
        OsAlarmAction
          OsAlarmSetEvent: OsAlarmSetEventRef=Rte_Ev_Run_StartApplication_StartApplication_Cyclic10ms, OsAlarmSetEventTaskRef=Os/Default_Appl_Task
      Rte_Al_TE_StartApplication_StartApplication_Cyclic1ms
        OsAlarmAction
          OsAlarmSetEvent: OsAlarmSetEventRef=Rte_Ev_Run_StartApplication_StartApplication_Cyclic1ms, OsAlarmSetEventTaskRef=Os/Default_Appl_Task
      Rte_Al_TE_StartApplication_StartApplication_Cyclic250ms
        OsAlarmAction
          OsAlarmSetEvent: OsAlarmSetEventRef=Rte_Ev_Run_StartApplication_StartApplication_Cyclic250ms, OsAlarmSetEventTaskRef=Os/Default_Appl_Task
    6 x OsEvent:
      Rte_Ev_Run_StartApplication_StartApplication_Cyclic1000ms
      Rte_Ev_Run_StartApplication_StartApplication_Cyclic10ms
      Rte_Ev_Run_StartApplication_StartApplication_Cyclic1ms
      Rte_Ev_Run_StartApplication_StartApplication_Cyclic250ms
      Rte_Ev_Run_StartApplication_StartApplication_OnDataRec_RxCtrl
      Rte_Ev_Run_StartApplication_StartApplication_OnDataRec_RxData
    OsMemoryProtection
      OsMemoryRegion_OsApplication_NonTrusted_Core0_VAR (OsMemoryRegion):
        OsMemoryRegionStartAddress = _OS_OsApplication_NonTrusted_Core0_VAR_ALL_START
        OsMemoryRegionEndAddress = _OS_OsApplication_NonTrusted_Core0_VAR_ALL_END
        OsMemoryRegionProtectionUnit = SystemMPU0
        OsMemoryRegionAccessRights = SUPERVISOR_RWX
        OsMemoryRegionAccessRights = USER_W
        OsMemoryRegionBusMasters = Core
        OsMemoryRegionBusMasters = Debugger
        OsMemoryRegionBusMasters = DMA
        OsMemoryRegionBusMasters = ENET
      OsMemoryRegion_FlexNVM_FlexRAM_DataFlash (OsMemoryRegion):
        OsMemoryRegionStartAddress = 0x10000000
        OsMemoryRegionEndAddress = 0x14000FFF
        OsMemoryRegionProtectionUnit = SystemMPU0
        OsMemoryRegionBusMasters = Core
        OsMemoryRegionBusMasters = Debugger
        OsMemoryRegionBusMasters = DMA
        OsMemoryRegionBusMasters = ENET
        OsMemoryRegionAccessRights = SUPERVISOR_RWX
        OsMemoryRegionAccessRights = USER_W
      CAN_PROTECTED_AREA_CH0 (OsPeripheralRegion):
        OsPeripheralRegionStartAddress = 0x40024000
        OsPeripheralRegionEndAddress = 0x40024FFF
        OsPeripheralRegionAccessingApp = OsApplication_NonTrusted_Core0
      5 x OsMemoryRegion, all with OsMemoryRegionProtectionUnit=SystemMPU0, OsMemoryRegionBusMasters=Core, OsMemoryRegionBusMasters=Debugger, OsMemoryRegionBusMasters=DMA, OsMemoryRegionBusMasters=ENET:
        OsMemoryRegion_GlobalShared: OsMemoryRegionStartAddress=_OS_GLOBALSHARED_VAR_START, OsMemoryRegionEndAddress=_OS_GLOBALSHARED_VAR_END, OsMemoryRegionAccessRights=SUPERVISOR_RW, OsMemoryRegionAccessRights=USER_W
        OsMemoryRegion_ReadAndExe: OsMemoryRegionStartAddress=0, OsMemoryRegionEndAddress=0xFFFFFFFF, OsMemoryRegionAccessRights=SUPERVISOR_RX, OsMemoryRegionAccessRights=USER_R, OsMemoryRegionAccessRights=USER_X
        OsMemoryRegion_SRAM_L: OsMemoryRegionStartAddress=0x1FFE0000, OsMemoryRegionEndAddress=_OS_CORE0_STACKS_START, OsMemoryRegionAccessRights=SUPERVISOR_RW, OsMemoryRegionAccessRights=USER_R
        OsMemoryRegion_Peripherals: OsMemoryRegionStartAddress=0x40000000, OsMemoryRegionEndAddress=0xFFFFFFFF, OsMemoryRegionAccessRights=SUPERVISOR_RWX, OsMemoryRegionAccessRights=USER_W
        OsMemoryRegion_SRAM_U: OsMemoryRegionStartAddress=_OS_CORE0_STACKS_END, OsMemoryRegionEndAddress=0x2001EFFF, OsMemoryRegionAccessRights=SUPERVISOR_RW, OsMemoryRegionAccessRights=USER_R
    StartApplication_MemoryViolation_Task (OsTask):
      OsTaskActivation = 1
      OsTaskPriority = 5
      OsTaskSchedule = NON
      OsTaskStackSharing = false
      OsTaskStackSize = 1024
      OsTaskType = AUTO
      OsTaskUsesFpu = false
      OsTaskAccessingApplication = SystemApplication_OsCore0
      OsTaskAccessingApplication = OsApplication_Trusted_Core0
    StartApplication_Trusted_Task (OsTask):
      OsTaskActivation = 1
      OsTaskPriority = 5
      OsTaskSchedule = NON
      OsTaskStackSharing = false
      OsTaskStackSize = 1024
      OsTaskType = AUTO
      OsTaskUsesFpu = false
      OsTaskAccessingApplication = SystemApplication_OsCore0
      OsTaskAccessingApplication = OsApplication_NonTrusted_Core0
    3 x OsAlarm, all with OsAlarmCounterRef=SystemTimer, OsAlarmAccessingApplication=SystemApplication_OsCore0:
      Rte_Al_TE2_Default_BSW_Async_Task_0_1ms: OsAlarmAccessingApplication=OsApplication_Trusted_Core0
        OsAlarmAction
          OsAlarmSetEvent: OsAlarmSetEventRef=Rte_Ev_Cyclic2_Default_BSW_Async_Task_0_1ms, OsAlarmSetEventTaskRef=Os/Default_BSW_Async_Task
      Rte_Al_TE2_OsTask_WdgM_Cyclic_0_10ms: OsAlarmAccessingApplication=OsApplication_NonTrusted_Core0
        OsAlarmAction
          OsAlarmActivateTask: OsAlarmActivateTaskRef=OsTask_WdgM_Cyclic
      Rte_Al_TE_StartApplication_StartApplication_MEMORYPROTECTION_Cyclic10ms: OsAlarmAccessingApplication=OsApplication_Trusted_Core0
        OsAlarmAction
          OsAlarmActivateTask: OsAlarmActivateTaskRef=StartApplication_MemoryViolation_Task
    Rte_Ev_Cyclic2_Default_BSW_Async_Task_0_1ms (OsEvent)
    FTM_0_CH_0_CH_1_ISR (OsIsr):
      OsIsrCategory = CATEGORY_2
      OsIsrInterruptType = EXTERNAL
      OsIsrInterruptSource = 115
      OsIsrInterruptPriority = 80
      OsIsrStackSize = 1024
      OsIsrEnableNesting = false
      OsIsrUsesFpu = false
      OsIsrInterruptMapping = DEFAULT
  module config Vita: implementation-config-variant=VARIANT-PRE-COMPILE, module-description=Vita_Impl
    VitaGeneral: VitaImplementation=VITAMIN, VitaSwcScaling=SUPERSET, VitaTaskToApplicationMapping=SAFEPARTITIONING
      Vitamax: VitaMaxCom=NONE, VitaMaxDiag=NONE, VitaMaxMem=NONE
      Vitamin:
        VitaMinCom = BASIC
        VitaMinMem = BASIC
        VitaMinDiag = BASIC
        VitaMinModeMgt = BASIC
        VitaMinWdg = BASIC
        VitaMinXcp = NONE
        VitaMinJ1939Diag = NONE
        VitaMinScc = NONE
        VitaMinMulticore = NONE
        VitaMinMemoryProtection = BASIC
        VitaMinEth = NONE
        VitaMinFbl = NONE
      CanChnl1 (VitaCanoeChannel): VitaCanoeChannelName=CT_CAN00, VitaChannelRef=CanConfigSet/CT_CAN_d43e43a4
    VitaPorts: VitaControlCommunication=COM
      VitaControlPorts:
        VitaDataTxSignal = Signal_StartAppl_TxData_MyECU_omsg_StartAppl_Tx_MyECU_oCAN_8c58228b_Tx
        VitaControlTxSignal = Signal_StartAppl_TxCtrl_MyECU_omsg_StartAppl_Tx_MyECU_oCAN_b45ea6bd_Tx
        VitaDataRxSignal = Signal_StartAppl_RxData_MyECU_omsg_StartAppl_Rx_MyECU_oCAN_315f9453_Rx
        VitaControlRxSignal = Signal_StartAppl_RxCtrl_MyECU_omsg_StartAppl_Rx_MyECU_oCAN_09591065_Rx
    VitaTestElements
      VitaCom
  module config Com: implementation-config-variant=VARIANT-PRE-COMPILE, module-description=Com_Impl
    ComGeneration:
      ComOutOfBoundsWriteProtectionStrategy = NONE
      ComOutOfBoundsWriteSanitizer = false
      ComOutOfBoundsReadSanitizer = false
      ComReduceConstantData2Define = false
      ComBoolDataInArrayOfStructStrategy = BOOLEAN
      ComDeduplicateIndirectedData = true
      ComDataDeduplicationStrategy = WITH_CAST
      ComReduceBoolDataByNegationThreshold = 2
      ComReduceBoolDataByNumericalComparisonThreshold = 2
      ComReduceBoolDataByNumericalRelationThreshold = 2
      ComReduceBoolDataByNumericalOperandStrategy = WITH_ANY_VALUE
      ComReduceNumericalDataByOffsetThreshold = 2
      ComReduceNumericalDataByArraySubtractionThreshold = 2
      ComReduceDataByStreaming = false
      ComShortSymbols = false
      ComInterfacesForDeactivatedData = false
      ComReferringKeysInComments = false
    ComOptimization:
      ComTxCyclicProcessingISRLockThreshold = 1
      ComTxDeadlineMonitoringISRLockThreshold = 1
      ComTxProcessingISRLockThreshold = 1
      ComRxDeadlineMonitoringISRLockThreshold = 1
      ComRxDeferredProcessingISRLockThreshold = 1
      ComGatewayProcessingISRLockThreshold = 1
      ComGatewayDescriptionProcessingISRLockThreshold = 1
      ComIPduGroupISRLockThreshold = 1
    ComConfig: ComConfigurationId=0, ComRxDeferredNotificationCacheSize=1, ComRxImmediateNotificationCacheSize=0
      ComTimeBase: ComRxTimeBase=0.01, ComTxTimeBase=0.001, ComGwTimeBase=0.01, ComTxCycleCounterTimeBase=0.01
      SG_RgRx_Prof1C_RxCycle_omsg_RxCycle_E2eProf1C_500_10_oCAN_430c5af9_Rx (ComSignalGroup):
        ComTimeout = 0
        ComTransferProperty = PENDING
        ComSignalGroupAccess = ACCESS_NEEDED_BY_OTHER
        ComHandleId = 0
        ComSystemTemplateSignalGroupRef = SG_RgRx_Prof1C_RxCycle
        6 x ComGroupSignal, all with ComSignalEndianness=LITTLE_ENDIAN, ComSignalInitValue=0, ComSignalAccess=ACCESS_NEEDED_BY_OTHER:
          SigRx_Prof1C_CRC_omsg_RxCycle_E2eProf1C_500_10_oCAN_d6a2f34d_Rx: ComBitPosition=0, ComBitSize=8, ComSignalType=UINT8, ComHandleId=0, ComSystemTemplateSystemSignalRef=SigRx_Prof1C_CRC
          SigRx_Prof1C_DataId_HiByte_LoNib_omsg_RxCycle_E2eProf1C_500_10_oCAN_bdeb2c98_Rx: ComBitPosition=12, ComBitSize=4, ComSignalType=UINT8, ComHandleId=1, ComSystemTemplateSystemSignalRef=SigRx_Prof1C_DataId_HiByte_LoNib
          SigRx_Prof1C_Sig3Bit_omsg_RxCycle_E2eProf1C_500_10_oCAN_95ddcbc9_Rx: ComBitPosition=21, ComBitSize=3, ComSignalType=UINT8, ComHandleId=3, ComSystemTemplateSystemSignalRef=SigRx_Prof1C_Sig3Bit
          SigRx_Prof1C_SQ_omsg_RxCycle_E2eProf1C_500_10_oCAN_263a4149_Rx: ComBitPosition=8, ComBitSize=4, ComSignalType=UINT8, ComHandleId=2, ComSystemTemplateSystemSignalRef=SigRx_Prof1C_SQ
          SigRx_Prof1C_Sig32Bit_omsg_RxCycle_E2eProf1C_500_10_oCAN_f0dd3f4d_Rx: ComBitPosition=24, ComBitSize=32, ComSignalType=UINT32, ComHandleId=5, ComSystemTemplateSystemSignalRef=SigRx_Prof1C_Sig32Bit
          SigRx_Prof1C_Sig4Bit_omsg_RxCycle_E2eProf1C_500_10_oCAN_a713ffd7_Rx: ComBitPosition=16, ComBitSize=4, ComSignalType=UINT8, ComHandleId=4, ComSystemTemplateSystemSignalRef=SigRx_Prof1C_Sig4Bit
      msg_RxCycle500_20_oCAN_a691adb3_Rx (ComIPdu):
        ComIPduDirection = RECEIVE
        ComIPduType = NORMAL
        ComIPduHandleId = 1
        ComIPduSignalProcessing = DEFERRED
        ComIPduCancellationSupport = false
        ComIPduGroupRef = MyECU_oCAN_Rx_63a3e3ce
        ComIPduSignalRef = Signal_Rx16bit_Cyclic_omsg_RxCycle500_20_oCAN_300c1427_Rx
        ComIPduSignalRef = Signal_Rx20bit_Cyclic_omsg_RxCycle500_20_oCAN_983b15aa_Rx
        ComIPduSignalRef = Signal_Rx8bit_Cyclic_omsg_RxCycle500_20_oCAN_f9e4bcc4_Rx
        ComPduIdRef = EcucPduCollection/msg_RxCycle500_20_oCAN_a691adb3_Rx
      3 x ComSignal, all with ComSignalEndianness=LITTLE_ENDIAN, ComTimeout=0:
        Signal_Rx15bit_OnWrite_omsg_RxEvent_20_oCAN_3a85fa13_Rx: ComBitPosition=12, ComBitSize=15, ComSignalInitValue=25, ComSignalType=UINT16, ComSignalAccess=ACCESS_NEEDED_BY_OTHER, ComHandleId=11, ComSystemTemplateSystemSignalRef=Signal_Rx15bit_OnWrite
        Signal_StartAppl_RxCtrl_MyECU_omsg_StartAppl_Rx_MyECU_oCAN_09591065_Rx: ComBitPosition=0, ComBitSize=8, ComSignalInitValue=0, ComSignalType=UINT8, ComSignalAccess=ACCESS_NEEDED_BY_SWC_OR_COM, ComHandleId=14, ComNotification=Rte_COMCbk_Signal_StartAppl_RxCtrl_MyECU_omsg_StartAppl_Rx_MyECU_oCAN_09591065_Rx, ComSystemTemplateSystemSignalRef=Signal_StartAppl_RxCtrl_MyECU
        Signal_RearInteriorLight_omsg_RxCycle100_0_oCAN_44115c66_Rx: ComBitPosition=0, ComBitSize=1, ComSignalInitValue=0, ComSignalType=BOOLEAN, ComSignalAccess=ACCESS_NEEDED_BY_OTHER, ComHandleId=6, ComSystemTemplateSystemSignalRef=Signal_RearInteriorLight
      msg_StartAppl_Rx_MyECU_oCAN_0da3c1e2_Rx (ComIPdu):
        ComIPduDirection = RECEIVE
        ComIPduType = NORMAL
        ComIPduHandleId = 4
        ComIPduSignalProcessing = DEFERRED
        ComIPduCancellationSupport = false
        ComIPduGroupRef = MyECU_oCAN_Rx_63a3e3ce
        ComIPduSignalRef = Signal_StartAppl_RxCtrl_MyECU_omsg_StartAppl_Rx_MyECU_oCAN_09591065_Rx
        ComIPduSignalRef = Signal_StartAppl_RxData_MyECU_omsg_StartAppl_Rx_MyECU_oCAN_315f9453_Rx
        ComPduIdRef = EcucPduCollection/msg_StartAppl_Rx_MyECU_oCAN_0da3c1e2_Rx
      Signal_RearLeftDoor_omsg_RxCycle100_0_oCAN_47d3a185_Rx (ComSignal):
        ComBitPosition = 1
        ComBitSize = 1
        ComSignalEndianness = LITTLE_ENDIAN
        ComSignalInitValue = 0
        ComSignalType = BOOLEAN
        ComTimeout = 0
        ComSignalAccess = ACCESS_NEEDED_BY_OTHER
        ComHandleId = 7
        ComSystemTemplateSystemSignalRef = Signal_RearLeftDoor
      msg_TxCycle1000_10_oCAN_d74aed68_Tx (ComIPdu):
        ComIPduDirection = SEND
        ComIPduType = NORMAL
        ComIPduHandleId = 3
        ComIPduSignalProcessing = DEFERRED
        ComIPduCancellationSupport = false
        ComIPduGroupRef = MyECU_oCAN_Tx_35f94448
        ComIPduSignalRef = Signal_Tx10bit_Cyclic_omsg_TxCycle1000_10_oCAN_9539efc7_Tx
        ComIPduSignalRef = Signal_Tx4bit_Cyclic_omsg_TxCycle1000_10_oCAN_ca549591_Tx
        ComPduIdRef = EcucPduCollection/msg_TxCycle1000_10_oCAN_d74aed68_Tx
        ComTxIPdu: ComMinimumDelayTime=0, ComTxIPduUnusedAreasDefault=0
          ComTxModeTrue
            ComTxMode: ComTxModeMode=PERIODIC, ComTxModeTimeOffset=0.01, ComTxModeTimePeriod=1
          ComTxModeFalse
            ComTxMode: ComTxModeMode=PERIODIC, ComTxModeTimeOffset=0.01, ComTxModeTimePeriod=1
      msg_RxCycle_E2eProf1C_500_10_oCAN_e8110737_Rx (ComIPdu):
        ComIPduDirection = RECEIVE
        ComIPduType = NORMAL
        ComIPduHandleId = 2
        ComIPduSignalProcessing = DEFERRED
        ComIPduCancellationSupport = false
        ComIPduGroupRef = MyECU_oCAN_Rx_63a3e3ce
        ComIPduSignalGroupRef = SG_RgRx_Prof1C_RxCycle_omsg_RxCycle_E2eProf1C_500_10_oCAN_430c5af9_Rx
        ComPduIdRef = EcucPduCollection/msg_RxCycle_E2eProf1C_500_10_oCAN_e8110737_Rx
      3 x ComSignal, all with ComSignalEndianness=LITTLE_ENDIAN:
        Signal_StartAppl_TxData_MyECU_omsg_StartAppl_Tx_MyECU_oCAN_8c58228b_Tx: ComBitPosition=8, ComBitSize=8, ComSignalInitValue=0, ComSignalType=UINT8, ComTransferProperty=PENDING, ComSignalAccess=ACCESS_NEEDED_BY_SWC_OR_COM, ComHandleId=9, ComSystemTemplateSystemSignalRef=Signal_StartAppl_TxData_MyECU
        Signal_Tx32bit_OnWrite_omsg_TxEvent_10_oCAN_298e9335_Tx: ComBitPosition=0, ComBitSize=32, ComSignalInitValue=31, ComSignalType=UINT32, ComTransferProperty=TRIGGERED_WITHOUT_REPETITION, ComSignalAccess=ACCESS_NEEDED_BY_OTHER, ComHandleId=15, ComSystemTemplateSystemSignalRef=Signal_Tx32bit_OnWrite
        Signal_RearRightDoor_omsg_RxCycle100_0_oCAN_cbde8ce7_Rx: ComBitPosition=2, ComBitSize=1, ComSignalInitValue=0, ComSignalType=BOOLEAN, ComTimeout=0, ComSignalAccess=ACCESS_NEEDED_BY_OTHER, ComHandleId=8, ComSystemTemplateSystemSignalRef=Signal_RearRightDoor
      msg_StartAppl_Tx_MyECU_oCAN_ad461e3f_Tx (ComIPdu):
        ComIPduDirection = SEND
        ComIPduType = NORMAL
        ComIPduHandleId = 1
        ComIPduSignalProcessing = DEFERRED
        ComIPduCancellationSupport = false
        ComIPduGroupRef = MyECU_oCAN_Tx_35f94448
        ComIPduSignalRef = Signal_StartAppl_TxCtrl_MyECU_omsg_StartAppl_Tx_MyECU_oCAN_b45ea6bd_Tx
        ComIPduSignalRef = Signal_StartAppl_TxData_MyECU_omsg_StartAppl_Tx_MyECU_oCAN_8c58228b_Tx
        ComPduIdRef = EcucPduCollection/msg_StartAppl_Tx_MyECU_oCAN_ad461e3f_Tx
        ComTxIPdu: ComMinimumDelayTime=0, ComTxIPduUnusedAreasDefault=0
          ComTxModeTrue
            ComTxMode: ComTxModeMode=PERIODIC, ComTxModeTimeOffset=0, ComTxModeTimePeriod=0.05
          ComTxModeFalse
            ComTxMode: ComTxModeMode=PERIODIC, ComTxModeTimeOffset=0, ComTxModeTimePeriod=0.05
      MyECU_oCAN_Tx_35f94448 (ComIPduGroup): ComIPduGroupHandleId=1
      MyECU_oCAN_Rx_63a3e3ce (ComIPduGroup): ComIPduGroupHandleId=0
      9 x ComSignal, all with ComSignalEndianness=LITTLE_ENDIAN:
        Signal_Rx11bit_OnWrite_omsg_RxEvent_20_oCAN_e14fb9df_Rx: ComBitPosition=0, ComBitSize=11, ComSignalInitValue=50, ComSignalType=UINT16, ComTimeout=0, ComSignalAccess=ACCESS_NEEDED_BY_OTHER, ComHandleId=10, ComSystemTemplateSystemSignalRef=Signal_Rx11bit_OnWrite
        Signal_Tx32bit_Cyclic_omsg_TxCycle10_0_oCAN_ab90e6e2_Tx: ComBitPosition=0, ComBitSize=32, ComSignalInitValue=0, ComSignalType=UINT32, ComTransferProperty=PENDING, ComSignalAccess=ACCESS_NEEDED_BY_OTHER, ComHandleId=14, ComSystemTemplateSystemSignalRef=Signal_Tx32bit_Cyclic
        Signal_Tx24bit_Cyclic_omsg_TxCycle10_0_oCAN_393dd5fe_Tx: ComBitPosition=32, ComBitSize=24, ComSignalInitValue=0, ComSignalType=UINT32, ComTransferProperty=PENDING, ComSignalAccess=ACCESS_NEEDED_BY_OTHER, ComHandleId=12, ComSystemTemplateSystemSignalRef=Signal_Tx24bit_Cyclic
        Signal_Rx20bit_Cyclic_omsg_RxCycle500_20_oCAN_983b15aa_Rx: ComBitPosition=8, ComBitSize=20, ComSignalInitValue=1, ComSignalType=UINT32, ComTimeout=0, ComSignalAccess=ACCESS_NEEDED_BY_OTHER, ComHandleId=13, ComSystemTemplateSystemSignalRef=Signal_Rx20bit_Cyclic
        Signal_StartAppl_TxCtrl_MyECU_omsg_StartAppl_Tx_MyECU_oCAN_b45ea6bd_Tx: ComBitPosition=0, ComBitSize=8, ComSignalInitValue=0, ComSignalType=UINT8, ComTransferProperty=PENDING, ComSignalAccess=ACCESS_NEEDED_BY_SWC_OR_COM, ComHandleId=8, ComSystemTemplateSystemSignalRef=Signal_StartAppl_TxCtrl_MyECU
        Signal_Rx16bit_Cyclic_omsg_RxCycle500_20_oCAN_300c1427_Rx: ComBitPosition=32, ComBitSize=16, ComSignalInitValue=32768, ComSignalType=UINT16, ComTimeout=0, ComSignalAccess=ACCESS_NEEDED_BY_OTHER, ComHandleId=12, ComSystemTemplateSystemSignalRef=Signal_Rx16bit_Cyclic
        Signal_Tx4bit_Cyclic_omsg_TxCycle1000_10_oCAN_ca549591_Tx: ComBitPosition=10, ComBitSize=4, ComSignalInitValue=0, ComSignalType=UINT8, ComTransferProperty=PENDING, ComSignalAccess=ACCESS_NEEDED_BY_OTHER, ComHandleId=10, ComSystemTemplateSystemSignalRef=Signal_Tx4bit_Cyclic
        Signal_StartAppl_RxData_MyECU_omsg_StartAppl_Rx_MyECU_oCAN_315f9453_Rx: ComBitPosition=8, ComBitSize=8, ComSignalInitValue=0, ComSignalType=UINT8, ComTimeout=0, ComSignalAccess=ACCESS_NEEDED_BY_SWC_OR_COM, ComHandleId=15, ComNotification=Rte_COMCbk_Signal_StartAppl_RxData_MyECU_omsg_StartAppl_Rx_MyECU_oCAN_315f9453_Rx, ComSystemTemplateSystemSignalRef=Signal_StartAppl_RxData_MyECU
        Signal_Rx8bit_Cyclic_omsg_RxCycle500_20_oCAN_f9e4bcc4_Rx: ComBitPosition=0, ComBitSize=8, ComSignalInitValue=15, ComSignalType=UINT8, ComTimeout=0, ComSignalAccess=ACCESS_NEEDED_BY_OTHER, ComHandleId=9, ComSystemTemplateSystemSignalRef=Signal_Rx8bit_Cyclic
      4 x ComIPdu, all with ComIPduType=NORMAL, ComIPduSignalProcessing=DEFERRED, ComIPduCancellationSupport=false:
        msg_RxCycle100_0_oCAN_1e247d16_Rx: ComIPduDirection=RECEIVE, ComIPduHandleId=0, ComIPduGroupRef=MyECU_oCAN_Rx_63a3e3ce, ComIPduSignalRef=Signal_RearInteriorLight_omsg_RxCycle100_0_oCAN_44115c66_Rx, ComIPduSignalRef=Signal_RearLeftDoor_omsg_RxCycle100_0_oCAN_47d3a185_Rx, ComIPduSignalRef=Signal_RearRightDoor_omsg_RxCycle100_0_oCAN_cbde8ce7_Rx, ComPduIdRef=EcucPduCollection/msg_RxCycle100_0_oCAN_1e247d16_Rx
        msg_RxEvent_20_oCAN_a1df81ad_Rx: ComIPduDirection=RECEIVE, ComIPduHandleId=3, ComIPduGroupRef=MyECU_oCAN_Rx_63a3e3ce, ComIPduSignalRef=Signal_Rx11bit_OnWrite_omsg_RxEvent_20_oCAN_e14fb9df_Rx, ComIPduSignalRef=Signal_Rx15bit_OnWrite_omsg_RxEvent_20_oCAN_3a85fa13_Rx, ComPduIdRef=EcucPduCollection/msg_RxEvent_20_oCAN_a1df81ad_Rx
        msg_TxEvent_10_oCAN_b2cd4fc2_Tx: ComIPduDirection=SEND, ComIPduHandleId=5, ComIPduGroupRef=MyECU_oCAN_Tx_35f94448, ComIPduSignalRef=Signal_Tx24bit_OnWrite_omsg_TxEvent_10_oCAN_bb23a029_Tx, ComIPduSignalRef=Signal_Tx32bit_OnWrite_omsg_TxEvent_10_oCAN_298e9335_Tx, ComPduIdRef=EcucPduCollection/msg_TxEvent_10_oCAN_b2cd4fc2_Tx
          ComTxIPdu: ComMinimumDelayTime=0, ComTxIPduUnusedAreasDefault=0
            ComTxModeTrue
              ComTxMode: ComTxModeMode=DIRECT, ComTxModeNumberOfRepetitions=0, ComTxModeRepetitionPeriod=0
            ComTxModeFalse
              ComTxMode: ComTxModeMode=DIRECT, ComTxModeNumberOfRepetitions=0, ComTxModeRepetitionPeriod=0
        msg_TxCycle10_0_oCAN_85bf3e37_Tx: ComIPduDirection=SEND, ComIPduHandleId=2, ComIPduGroupRef=MyECU_oCAN_Tx_35f94448, ComIPduSignalRef=Signal_Tx24bit_Cyclic_omsg_TxCycle10_0_oCAN_393dd5fe_Tx, ComIPduSignalRef=Signal_Tx32bit_Cyclic_omsg_TxCycle10_0_oCAN_ab90e6e2_Tx, ComPduIdRef=EcucPduCollection/msg_TxCycle10_0_oCAN_85bf3e37_Tx
          ComTxIPdu: ComMinimumDelayTime=0, ComTxIPduUnusedAreasDefault=0
            ComTxModeTrue
              ComTxMode: ComTxModeMode=PERIODIC, ComTxModeTimeOffset=0, ComTxModeTimePeriod=0.01
            ComTxModeFalse
              ComTxMode: ComTxModeMode=PERIODIC, ComTxModeTimeOffset=0, ComTxModeTimePeriod=0.01
      Signal_Tx10bit_Cyclic_omsg_TxCycle1000_10_oCAN_9539efc7_Tx (ComSignal):
        ComBitPosition = 0
        ComBitSize = 10
        ComSignalEndianness = LITTLE_ENDIAN
        ComSignalInitValue = 0
        ComSignalType = UINT16
        ComTransferProperty = PENDING
        ComSignalAccess = ACCESS_NEEDED_BY_OTHER
        ComHandleId = 11
        ComSystemTemplateSystemSignalRef = Signal_Tx10bit_Cyclic
      Signal_Tx24bit_OnWrite_omsg_TxEvent_10_oCAN_bb23a029_Tx (ComSignal):
        ComBitPosition = 32
        ComBitSize = 24
        ComSignalEndianness = LITTLE_ENDIAN
        ComSignalInitValue = 63
        ComSignalType = UINT32
        ComTransferProperty = TRIGGERED_WITHOUT_REPETITION
        ComSignalAccess = ACCESS_NEEDED_BY_OTHER
        ComHandleId = 13
        ComSystemTemplateSystemSignalRef = Signal_Tx24bit_OnWrite
      SG_SgTx_Prof1C_TxCycle_omsg_TxCycle_E2eProf1C_500_30_oCAN_9bfb2a76_Tx (ComSignalGroup): ComTransferProperty=PENDING, ComSignalGroupAccess=ACCESS_NEEDED_BY_OTHER, ComHandleId=0, ComSystemTemplateSignalGroupRef=SG_SgTx_Prof1C_TxCycle
        7 x ComGroupSignal, all with ComSignalEndianness=LITTLE_ENDIAN, ComSignalInitValue=0, ComTransferProperty=PENDING, ComSignalAccess=ACCESS_NEEDED_BY_OTHER:
          SigTx_Prof1C_SQ_omsg_TxCycle_E2eProf1C_500_30_oCAN_8ca3bde6_Tx: ComBitPosition=8, ComBitSize=4, ComSignalType=UINT8, ComHandleId=3, ComSystemTemplateSystemSignalRef=SigTx_Prof1C_SQ
          SigTx_Prof1C_Sig8Bit_omsg_TxCycle_E2eProf1C_500_30_oCAN_f6b84f66_Tx: ComBitPosition=48, ComBitSize=8, ComSignalType=UINT8, ComHandleId=6, ComSystemTemplateSystemSignalRef=SigTx_Prof1C_Sig8Bit
          SigTx_Prof1C_CRC_omsg_TxCycle_E2eProf1C_500_30_oCAN_5df85835_Tx: ComBitPosition=0, ComBitSize=8, ComSignalType=UINT8, ComHandleId=1, ComSystemTemplateSystemSignalRef=SigTx_Prof1C_CRC
          SigTx_Prof1C_Sig2Bit_omsg_TxCycle_E2eProf1C_500_30_oCAN_72710fbf_Tx: ComBitPosition=30, ComBitSize=2, ComSignalType=UINT8, ComHandleId=4, ComSystemTemplateSystemSignalRef=SigTx_Prof1C_Sig2Bit
          SigTx_Prof1C_DataId_HiByte_LoNib_omsg_TxCycle_E2eProf1C_500_30_oCAN_2f490cd4_Tx: ComBitPosition=12, ComBitSize=4, ComSignalType=UINT8, ComHandleId=2, ComSystemTemplateSystemSignalRef=SigTx_Prof1C_DataId_HiByte_LoNib
          SigTx_Prof1C_Sig16Bit_omsg_TxCycle_E2eProf1C_500_30_oCAN_4f2c5310_Tx: ComBitPosition=32, ComBitSize=16, ComSignalType=UINT16, ComHandleId=7, ComSystemTemplateSystemSignalRef=SigTx_Prof1C_Sig16Bit
          SigTx_Prof1C_Sig4Bit_omsg_TxCycle_E2eProf1C_500_30_oCAN_0e363008_Tx: ComBitPosition=16, ComBitSize=4, ComSignalType=UINT8, ComHandleId=5, ComSystemTemplateSystemSignalRef=SigTx_Prof1C_Sig4Bit
      msg_TxCycle_E2eProf1C_500_30_oCAN_eeefc687_Tx (ComIPdu):
        ComIPduDirection = SEND
        ComIPduType = NORMAL
        ComIPduHandleId = 4
        ComIPduSignalProcessing = DEFERRED
        ComIPduCancellationSupport = false
        ComIPduGroupRef = MyECU_oCAN_Tx_35f94448
        ComIPduSignalGroupRef = SG_SgTx_Prof1C_TxCycle_omsg_TxCycle_E2eProf1C_500_30_oCAN_9bfb2a76_Tx
        ComPduIdRef = EcucPduCollection/msg_TxCycle_E2eProf1C_500_30_oCAN_eeefc687_Tx
        ComTxIPdu: ComMinimumDelayTime=0, ComTxIPduUnusedAreasDefault=0
          ComTxModeTrue
            ComTxMode: ComTxModeMode=PERIODIC, ComTxModeTimeOffset=0.03, ComTxModeTimePeriod=0.5
          ComTxModeFalse
            ComTxMode: ComTxModeMode=PERIODIC, ComTxModeTimeOffset=0.03, ComTxModeTimePeriod=0.5
      ComIPdu_NmOsek_UserData (ComIPdu):
        ComIPduDirection = SEND
        ComIPduHandleId = 0
        ComIPduSignalProcessing = DEFERRED
        ComIPduType = NORMAL
        ComIPduCancellationSupport = false
        ComPduIdRef = Pdu_NmOsekUserDataTxPdu
        ComIPduSignalRef = ComSignal_NmOsek_UserData
        ComTxIPdu: ComMinimumDelayTime=0, ComTxIPduUnusedAreasDefault=0
          ComTxModeFalse
            ComTxMode: ComTxModeMode=NONE
          ComTxModeTrue
            ComTxMode: ComTxModeMode=NONE
      ComSignal_NmOsek_UserData (ComSignal):
        ComBitPosition = 0
        ComSignalEndianness = LITTLE_ENDIAN
        ComSignalInitValue = 0
        ComSignalType = UINT64
        ComSignalAccess = ACCESS_NEEDED_BY_OTHER
        ComHandleId = 0
        ComBitSize = 48
        ComTransferProperty = PENDING
    ComGeneral:
      ComConfigurationUseDet = true
      ComEnableSignalGroupArrayApi = false
      ComRetryFailedTransmitRequests = true
      ComSupportedIPduGroups = 2
      ComVersionInfoApi = false
      ComAdvancedIPduCallouts = true
      ComOptimizedIPduGroupHandling = false
      ComMetaDataSupport = false
      ComReceiveSignalMacroAPI = false
      ComDeferredEventCacheSupport = false
      ComMainfunctionTimingDomainSupport = true
      ComDescriptionRoutingCodeGeneration = false
      ComSafeBswChecks = false
      ComUserCbkHeaderFile = Rte_Cbk.h
  module config Rte: implementation-config-variant=VARIANT-PRE-COMPILE, module-description=Rte_Impl
    RteInitializationBehavior: RteInitializationStrategy=RTE_INITIALIZATION_STRATEGY_AT_DATA_DECLARATION, RteSectionInitializationPolicy=INIT
    RteGeneration:
      RteGenerationMode = COMPATIBILITY_MODE
      RteIocInteractionReturnValue = RTE_IOC
      RteValueRangeCheckEnabled = false
      RteCalibrationSupport = NONE
      RteCodeVendorId = 30
      RteDevErrorDetect = true
      RteDevErrorDetectUninit = false
      RteMeasurementSupport = false
      RteOptimizationMode = MEMORY
      RteVfbTraceEnabled = false
    RteBswGeneral: RteSchMVersionInfoApi=false, RteUseComShadowSignalApi=false
    RteOsInteraction
      10 x RteUsedOsActivation, all with RteExpectedActivationOffset=0, RteExpectedTickDuration=0:
        Rte_Al_TE2_Default_BSW_Async_Task_0_10ms: RteActivationOsAlarmRef=Os/Rte_Al_TE2_Default_BSW_Async_Task_0_10ms, RteActivationOsTaskRef=Os/Default_BSW_Async_Task
        Rte_Al_TE2_Default_BSW_Async_Task_0_20ms: RteActivationOsAlarmRef=Os/Rte_Al_TE2_Default_BSW_Async_Task_0_20ms, RteActivationOsTaskRef=Os/Default_BSW_Async_Task
        Rte_Al_TE2_Default_BSW_Async_Task_0_5ms: RteActivationOsAlarmRef=Os/Rte_Al_TE2_Default_BSW_Async_Task_0_5ms, RteActivationOsTaskRef=Os/Default_BSW_Async_Task
        Rte_Al_TE_StartApplication_StartApplication_Cyclic1000ms: RteActivationOsAlarmRef=Os/Rte_Al_TE_StartApplication_StartApplication_Cyclic1000ms, RteActivationOsTaskRef=Os/Default_Appl_Task
        Rte_Al_TE_StartApplication_StartApplication_Cyclic10ms: RteActivationOsAlarmRef=Os/Rte_Al_TE_StartApplication_StartApplication_Cyclic10ms, RteActivationOsTaskRef=Os/Default_Appl_Task
        Rte_Al_TE_StartApplication_StartApplication_Cyclic1ms: RteActivationOsAlarmRef=Os/Rte_Al_TE_StartApplication_StartApplication_Cyclic1ms, RteActivationOsTaskRef=Os/Default_Appl_Task
        Rte_Al_TE_StartApplication_StartApplication_Cyclic250ms: RteActivationOsAlarmRef=Os/Rte_Al_TE_StartApplication_StartApplication_Cyclic250ms, RteActivationOsTaskRef=Os/Default_Appl_Task
        Rte_Al_TE2_Default_BSW_Async_Task_0_1ms: RteActivationOsAlarmRef=Os/Rte_Al_TE2_Default_BSW_Async_Task_0_1ms, RteActivationOsTaskRef=Os/Default_BSW_Async_Task
        Rte_Al_TE2_OsTask_WdgM_Cyclic_0_10ms: RteActivationOsAlarmRef=Os/Rte_Al_TE2_OsTask_WdgM_Cyclic_0_10ms, RteActivationOsTaskRef=OsTask_WdgM_Cyclic
        Rte_Al_TE_StartApplication_StartApplication_MEMORYPROTECTION_Cyclic10ms: RteActivationOsAlarmRef=Os/Rte_Al_TE_StartApplication_StartApplication_MEMORYPROTECTION_Cyclic10ms, RteActivationOsTaskRef=StartApplication_MemoryViolation_Task
    14 x RteBswModuleInstance:
      BswM: RteBswImplementationRef=BswM_Impl, RteBswModuleConfigurationRef=BswM
        BSWM_EXCLUSIVE_AREA_0 (RteBswExclusiveAreaImpl): RteExclusiveAreaImplMechanism=ALL_INTERRUPT_BLOCKING, RteBswExclusiveAreaRef=BSWM_EXCLUSIVE_AREA_0
        BswM_MainFunctionTimingEvent0 (RteBswEventToTaskMapping):
          RteBswImmediateRestart = false
          RteBswPositionInTask = 0
          RteBswEventRef = BswM_MainFunctionTimingEvent0
          RteBswMappedToTaskRef = Os/Default_BSW_Async_Task
          RteBswUsedOsEventRef = Rte_Ev_Cyclic2_Default_BSW_Async_Task_0_10ms
          RteBswUsedOsAlarmRef = Os/Rte_Al_TE2_Default_BSW_Async_Task_0_10ms
      Can: RteBswImplementationRef=Can_Impl, RteBswModuleConfigurationRef=Can
        3 x RteBswEventToTaskMapping, all with RteBswImmediateRestart=false, RteBswMappedToTaskRef=Os/Default_BSW_Async_Task, RteBswUsedOsEventRef=Rte_Ev_Cyclic2_Default_BSW_Async_Task_0_10ms, RteBswUsedOsAlarmRef=Os/Rte_Al_TE2_Default_BSW_Async_Task_0_10ms:
          Can_MainFunction_BusOffTimingEvent0: RteBswPositionInTask=3, RteBswEventRef=Can_MainFunction_BusOffTimingEvent0
          Can_MainFunction_WakeupTimingEvent0: RteBswPositionInTask=5, RteBswEventRef=Can_MainFunction_WakeupTimingEvent0
          Can_MainFunction_ModeTimingEvent0: RteBswPositionInTask=4, RteBswEventRef=Can_MainFunction_ModeTimingEvent0
        7 x RteBswExclusiveAreaImpl:
          CAN_EXCLUSIVE_AREA_{0..5}: RteExclusiveAreaImplMechanism=ALL_INTERRUPT_BLOCKING, RteBswExclusiveAreaRef=CAN_EXCLUSIVE_AREA_{0..5}
          CAN_EXCLUSIVE_AREA_6: RteExclusiveAreaImplMechanism=CUSTOM, RteBswExclusiveAreaRef=CAN_EXCLUSIVE_AREA_6
        Can_MainFunction_WriteTimingEvent0 (RteBswEventToTaskMapping):
          RteBswImmediateRestart = false
          RteBswPositionInTask = 21
          RteBswEventRef = Can_MainFunction_WriteTimingEvent0
          RteBswMappedToTaskRef = Os/Default_BSW_Async_Task
          RteBswUsedOsEventRef = Rte_Ev_Cyclic2_Default_BSW_Async_Task_0_10ms
          RteBswUsedOsAlarmRef = Os/Rte_Al_TE2_Default_BSW_Async_Task_0_10ms
      CanIf: RteBswImplementationRef=CanIf_Impl, RteBswModuleConfigurationRef=CanIf
        8 x RteBswExclusiveAreaImpl:
          CANIF_EXCLUSIVE_AREA_0: RteExclusiveAreaImplMechanism=CUSTOM, RteBswExclusiveAreaRef=CANIF_EXCLUSIVE_AREA_0
          CANIF_EXCLUSIVE_AREA_{1..7}: RteExclusiveAreaImplMechanism=ALL_INTERRUPT_BLOCKING, RteBswExclusiveAreaRef=CANIF_EXCLUSIVE_AREA_{1..7}
      CanSM: RteBswImplementationRef=CanSM_Impl, RteBswModuleConfigurationRef=CanSM
        CanSM_MainFunctionTimingEvent0 (RteBswEventToTaskMapping):
          RteBswImmediateRestart = false
          RteBswPositionInTask = 1
          RteBswEventRef = CanSM_MainFunctionTimingEvent0
          RteBswMappedToTaskRef = Os/Default_BSW_Async_Task
          RteBswUsedOsEventRef = Rte_Ev_Cyclic2_Default_BSW_Async_Task_0_10ms
          RteBswUsedOsAlarmRef = Os/Rte_Al_TE2_Default_BSW_Async_Task_0_10ms
        6 x RteBswExclusiveAreaImpl:
          CANSM_EXCLUSIVE_AREA_1: RteExclusiveAreaImplMechanism=CUSTOM, RteBswExclusiveAreaRef=CANSM_EXCLUSIVE_AREA_1
          CANSM_EXCLUSIVE_AREA_2: RteExclusiveAreaImplMechanism=ALL_INTERRUPT_BLOCKING, RteBswExclusiveAreaRef=CANSM_EXCLUSIVE_AREA_2
          CANSM_EXCLUSIVE_AREA_3: RteExclusiveAreaImplMechanism=ALL_INTERRUPT_BLOCKING, RteBswExclusiveAreaRef=CANSM_EXCLUSIVE_AREA_3
          CANSM_EXCLUSIVE_AREA_4: RteExclusiveAreaImplMechanism=CUSTOM, RteBswExclusiveAreaRef=CANSM_EXCLUSIVE_AREA_4
          CANSM_EXCLUSIVE_AREA_5: RteExclusiveAreaImplMechanism=ALL_INTERRUPT_BLOCKING, RteBswExclusiveAreaRef=CANSM_EXCLUSIVE_AREA_5
          CANSM_EXCLUSIVE_AREA_6: RteExclusiveAreaImplMechanism=ALL_INTERRUPT_BLOCKING, RteBswExclusiveAreaRef=CANSM_EXCLUSIVE_AREA_6
      CanTp: RteBswImplementationRef=CanTp_Impl, RteBswModuleConfigurationRef=CanTp
        CanTp_MainFunctionTimingEvent0 (RteBswEventToTaskMapping):
          RteBswImmediateRestart = false
          RteBswPositionInTask = 2
          RteBswEventRef = CanTp_MainFunctionTimingEvent0
          RteBswMappedToTaskRef = Os/Default_BSW_Async_Task
          RteBswUsedOsEventRef = Rte_Ev_Cyclic2_Default_BSW_Async_Task_0_5ms
          RteBswUsedOsAlarmRef = Os/Rte_Al_TE2_Default_BSW_Async_Task_0_5ms
        CANTP_EXCLUSIVE_AREA_0 (RteBswExclusiveAreaImpl): RteExclusiveAreaImplMechanism=ALL_INTERRUPT_BLOCKING, RteBswExclusiveAreaRef=CANTP_EXCLUSIVE_AREA_0
      Com: RteBswImplementationRef=Com_Impl, RteBswModuleConfigurationRef=Com
        Com_MainFunctionTxTimingEvent0 (RteBswEventToTaskMapping):
          RteBswImmediateRestart = false
          RteBswPositionInTask = 8
          RteBswEventRef = Com_MainFunctionTxTimingEvent0
          RteBswMappedToTaskRef = Os/Default_BSW_Async_Task
          RteBswUsedOsEventRef = Rte_Ev_Cyclic2_Default_BSW_Async_Task_0_1ms
          RteBswUsedOsAlarmRef = Os/Rte_Al_TE2_Default_BSW_Async_Task_0_1ms
        Com_MainFunctionRxTimingEvent0 (RteBswEventToTaskMapping):
          RteBswImmediateRestart = false
          RteBswPositionInTask = 7
          RteBswEventRef = Com_MainFunctionRxTimingEvent0
          RteBswMappedToTaskRef = Os/Default_BSW_Async_Task
          RteBswUsedOsEventRef = Rte_Ev_Cyclic2_Default_BSW_Async_Task_0_10ms
          RteBswUsedOsAlarmRef = Os/Rte_Al_TE2_Default_BSW_Async_Task_0_10ms
        3 x RteBswExclusiveAreaImpl, all with RteExclusiveAreaImplMechanism=ALL_INTERRUPT_BLOCKING:
          COM_EXCLUSIVE_AREA_TX: RteBswExclusiveAreaRef=COM_EXCLUSIVE_AREA_TX
          COM_EXCLUSIVE_AREA_RX: RteBswExclusiveAreaRef=COM_EXCLUSIVE_AREA_RX
          COM_EXCLUSIVE_AREA_BOTH: RteBswExclusiveAreaRef=COM_EXCLUSIVE_AREA_BOTH
      ComM: RteBswImplementationRef=ComM_Impl, RteBswModuleConfigurationRef=ComM
        ComM_MainFunction_0TimingEvent0 (RteBswEventToTaskMapping):
          RteBswImmediateRestart = false
          RteBswPositionInTask = 6
          RteBswEventRef = ComM_MainFunction_0TimingEvent0
          RteBswMappedToTaskRef = Os/Default_BSW_Async_Task
          RteBswUsedOsEventRef = Rte_Ev_Cyclic2_Default_BSW_Async_Task_0_20ms
          RteBswUsedOsAlarmRef = Os/Rte_Al_TE2_Default_BSW_Async_Task_0_20ms
        COMM_EXCLUSIVE_AREA_0 (RteBswExclusiveAreaImpl): RteExclusiveAreaImplMechanism=ALL_INTERRUPT_BLOCKING, RteBswExclusiveAreaRef=COMM_EXCLUSIVE_AREA_0
        COMM_EXCLUSIVE_AREA_1 (RteBswExclusiveAreaImpl): RteExclusiveAreaImplMechanism=CUSTOM, RteBswExclusiveAreaRef=COMM_EXCLUSIVE_AREA_1
      Dcm: RteBswImplementationRef=Dcm_Impl, RteBswModuleConfigurationRef=Dcm
        Dcm_MainFunctionTimingEvent0 (RteBswEventToTaskMapping):
          RteBswImmediateRestart = false
          RteBswPositionInTask = 9
          RteBswEventRef = Dcm_MainFunctionTimingEvent0
          RteBswMappedToTaskRef = Os/Default_BSW_Async_Task
          RteBswUsedOsEventRef = Rte_Ev_Cyclic2_Default_BSW_Async_Task_0_10ms
          RteBswUsedOsAlarmRef = Os/Rte_Al_TE2_Default_BSW_Async_Task_0_10ms
        DCM_EXCLUSIVE_AREA_0 (RteBswExclusiveAreaImpl): RteExclusiveAreaImplMechanism=ALL_INTERRUPT_BLOCKING, RteBswExclusiveAreaRef=DCM_EXCLUSIVE_AREA_0
      Dem: RteBswImplementationRef=Dem_Impl, RteBswModuleConfigurationRef=Dem
        Dem_MasterMainFunctionTimingEvent0 (RteBswEventToTaskMapping):
          RteBswImmediateRestart = false
          RteBswPositionInTask = 10
          RteBswEventRef = Dem_MasterMainFunctionTimingEvent0
          RteBswMappedToTaskRef = Os/Default_BSW_Async_Task
          RteBswUsedOsEventRef = Rte_Ev_Cyclic2_Default_BSW_Async_Task_0_10ms
          RteBswUsedOsAlarmRef = Os/Rte_Al_TE2_Default_BSW_Async_Task_0_10ms
        Dem_SatelliteMainFunctionTimingEvent0 (RteBswEventToTaskMapping):
          RteBswImmediateRestart = false
          RteBswPositionInTask = 11
          RteBswEventRef = Dem_SatelliteMainFunctionTimingEvent0
          RteBswMappedToTaskRef = Os/Default_BSW_Async_Task
          RteBswUsedOsEventRef = Rte_Ev_Cyclic2_Default_BSW_Async_Task_0_10ms
          RteBswUsedOsAlarmRef = Os/Rte_Al_TE2_Default_BSW_Async_Task_0_10ms
        5 x RteBswExclusiveAreaImpl, all with RteExclusiveAreaImplMechanism=ALL_INTERRUPT_BLOCKING:
          DEM_EXCLUSIVE_AREA_{0..4}: RteBswExclusiveAreaRef=DEM_EXCLUSIVE_AREA_{0..4}
      Det: RteBswImplementationRef=Det_Impl, RteBswModuleConfigurationRef=Det
        DET_EXCLUSIVE_AREA_0 (RteBswExclusiveAreaImpl): RteExclusiveAreaImplMechanism=ALL_INTERRUPT_BLOCKING, RteBswExclusiveAreaRef=DET_EXCLUSIVE_AREA_0
      EcuM: RteBswImplementationRef=EcuM_Impl, RteBswModuleConfigurationRef=EcuM
        EcuM_MainFunctionTimingEvent0 (RteBswEventToTaskMapping):
          RteBswImmediateRestart = false
          RteBswPositionInTask = 12
          RteBswEventRef = EcuM_MainFunctionTimingEvent0
          RteBswMappedToTaskRef = Os/Default_BSW_Async_Task
          RteBswUsedOsEventRef = Rte_Ev_Cyclic2_Default_BSW_Async_Task_0_10ms
          RteBswUsedOsAlarmRef = Os/Rte_Al_TE2_Default_BSW_Async_Task_0_10ms
        3 x RteBswExclusiveAreaImpl, all with RteExclusiveAreaImplMechanism=ALL_INTERRUPT_BLOCKING:
          ECUM_EXCLUSIVE_AREA_{0..2}: RteBswExclusiveAreaRef=ECUM_EXCLUSIVE_AREA_{0..2}
      Nm: RteBswImplementationRef=Nm_Impl, RteBswModuleConfigurationRef=Nm
        NM_EXCLUSIVE_AREA_0 (RteBswExclusiveAreaImpl): RteExclusiveAreaImplMechanism=ALL_INTERRUPT_BLOCKING, RteBswExclusiveAreaRef=NM_EXCLUSIVE_AREA_0
        NM_EXCLUSIVE_AREA_1 (RteBswExclusiveAreaImpl): RteExclusiveAreaImplMechanism=ALL_INTERRUPT_BLOCKING, RteBswExclusiveAreaRef=NM_EXCLUSIVE_AREA_1
      PduR: RteBswImplementationRef=PduR_Impl, RteBswModuleConfigurationRef=PduR
        PDUR_EXCLUSIVE_AREA_0 (RteBswExclusiveAreaImpl): RteExclusiveAreaImplMechanism=ALL_INTERRUPT_BLOCKING, RteBswExclusiveAreaRef=PDUR_EXCLUSIVE_AREA_0
      Rte: RteBswImplementationRef=Rte_Impl, RteBswModuleConfigurationRef=Rte
        Rte_ComSendSignalProxyPeriodicTimingEvent0 (RteBswEventToTaskMapping):
          RteBswImmediateRestart = false
          RteBswPositionInTask = 14
          RteBswEventRef = Rte_ComSendSignalProxyPeriodicTimingEvent0
          RteBswMappedToTaskRef = Os/Default_BSW_Async_Task
    7 x RteSwComponentInstance:
      BswM_EcuSwComposition: RteSoftwareComponentInstanceRef=BswM
        Timer_BswM_MainFunction (RteEventToTaskMapping):
          RteImmediateRestart = false
          RtePositionInTask = 0
          RteEventRef = Timer_BswM_MainFunction
          RteMappedToTaskRef = Os/Default_BSW_Async_Task
          RteUsedOsEventRef = Rte_Ev_Cyclic2_Default_BSW_Async_Task_0_10ms
          RteUsedOsAlarmRef = Os/Rte_Al_TE2_Default_BSW_Async_Task_0_10ms
      EcuM_EcuSwComposition: RteSoftwareComponentInstanceRef=EcuM
        8 x RteEventToTaskMapping, all with RteImmediateRestart=false:
          Timer_EcuM_MainFunction: RtePositionInTask=12, RteEventRef=Timer_EcuM_MainFunction, RteMappedToTaskRef=Os/Default_BSW_Async_Task, RteUsedOsEventRef=Rte_Ev_Cyclic2_Default_BSW_Async_Task_0_10ms, RteUsedOsAlarmRef=Os/Rte_Al_TE2_Default_BSW_Async_Task_0_10ms
          OpEventSelectShutdownTarget_SelectShutdownTarget_EcuM_ShutdownTarget: RteEventRef=OpEventSelectShutdownTarget_SelectShutdownTarget_EcuM_ShutdownTarget
          OpEventGetShutdownTarget_GetShutdownTarget_EcuM_ShutdownTarget: RteEventRef=OpEventGetShutdownTarget_GetShutdownTarget_EcuM_ShutdownTarget
          OpEventGetLastShutdownTarget_GetLastShutdownTarget_EcuM_ShutdownTarget: RteEventRef=OpEventGetLastShutdownTarget_GetLastShutdownTarget_EcuM_ShutdownTarget
          OpEventSelectShutdownCause_SelectShutdownCause_EcuM_ShutdownTarget: RteEventRef=OpEventSelectShutdownCause_SelectShutdownCause_EcuM_ShutdownTarget
          OpEventGetShutdownCause_GetShutdownCause_EcuM_ShutdownTarget: RteEventRef=OpEventGetShutdownCause_GetShutdownCause_EcuM_ShutdownTarget
          OpEventSelectBootTarget_SelectBootTarget_EcuM_BootTarget: RteEventRef=OpEventSelectBootTarget_SelectBootTarget_EcuM_BootTarget
          OpEventGetBootTarget_GetBootTarget_EcuM_BootTarget: RteEventRef=OpEventGetBootTarget_GetBootTarget_EcuM_BootTarget
