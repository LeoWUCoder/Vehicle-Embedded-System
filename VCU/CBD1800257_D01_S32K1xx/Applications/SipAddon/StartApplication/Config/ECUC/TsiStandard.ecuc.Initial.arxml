AUTOSAR XML (schema 4-2-1)
package /InitialEcuC
  ecuc value collection InitialEcuC: ecuc-values=[Can, CanIf, CanNm, CanSM, CanTp, Com, ComM, Dcm, Dem, EcuC, EcuM, Nm, PduR, Xcp]
  module config Can
    CanConfigSet
      CT_CAN_d43e43a4 (CanController):
        CanControllerActivation = true
        CanControllerDefaultBaudrate = CanControllerBaudrateConfig
        CanControllerSystemRef = CT_CAN
        CanWakeupSourceRef = EcuMCommonConfiguration/CN_CAN_fe6ecc87
        CanControllerBaudrateConfig: CanControllerBaudRate=500
      CN_CAN_23287e84_Rx (CanHardwareObject): CanHandleType=BASIC, CanIdType=STANDARD, CanIdValue=0, CanObjectType=RECEIVE, CanControllerRef=CanConfigSet/CT_CAN_d43e43a4
      CN_CAN_fe6ecc87_Tx (CanHardwareObject): CanHandleType=BASIC, CanIdValue=0, CanObjectType=TRANSMIT, CanControllerRef=CanConfigSet/CT_CAN_d43e43a4
    CanGeneral: CanIndex=0
  module config CanIf
    CanIfCtrlDrvCfg_7d254554 (CanIfCtrlDrvCfg): CanIfCtrlDrvInitHohConfigRef=CanIfInitHohCfg, CanIfCtrlDrvNameRef=CanGeneral
      CT_CAN_d43e43a4 (CanIfCtrlCfg): CanIfCtrlCanCtrlRef=CanConfigSet/CT_CAN_d43e43a4
    CanIfInitCfg
      CHNL_346f2748 (CanIfBufferCfg): CanIfBufferSize=0, CanIfBufferHthRef=CanIfInitHohCfg/CN_CAN_fe6ecc87_Tx
      CanIfInitHohCfg: CanIfInitRefCfgSet=CanConfigSet
        CN_CAN_23287e84_Rx (CanIfHrhCfg): CanIfHrhCanCtrlIdRef=CanIfCtrlDrvCfg_7d254554/CT_CAN_d43e43a4, CanIfHrhIdSymRef=CanConfigSet/CN_CAN_23287e84_Rx
        CN_CAN_fe6ecc87_Tx (CanIfHthCfg): CanIfHthCanCtrlIdRef=CanIfCtrlDrvCfg_7d254554/CT_CAN_d43e43a4, CanIfHthIdSymRef=CanConfigSet/CN_CAN_fe6ecc87_Tx
      11 x CanIfRxPduCfg, all with CanIfRxPduCanIdType=STANDARD_CAN, CanIfRxPduHrhIdRef=CanIfInitHohCfg/CN_CAN_23287e84_Rx:
        GlobalTimeMaster_oCAN_aa79fe59_Rx: CanIfRxPduCanId=896, CanIfRxPduDlc=8, CanIfRxPduRef=GlobalTimeMaster_oCAN_48f281bc_Rx
        MyECU_aa57c804_Rx: CanIfRxPduDlc=8, CanIfRxPduUserRxIndicationName=CanNm_RxIndication, CanIfRxPduUserRxIndicationUL=CAN_NM, CanIfRxPduRef=MyECU_dcffebb2_Rx
          CHNL_4e002d2e (CanIfRxPduCanIdRange): CanIfRxPduCanIdRangeLowerCanId=1024, CanIfRxPduCanIdRangeUpperCanId=1087
        msg_RxCycle100_0_oCAN_e369bba0_Rx: CanIfRxPduCanId=528, CanIfRxPduDlc=1, CanIfRxPduUserRxIndicationName=PduR_CanIfRxIndication, CanIfRxPduUserRxIndicationUL=PDUR, CanIfRxPduRef=EcucPduCollection/msg_RxCycle100_0_oCAN_c71398f9_Rx
        msg_RxCycle500_20_oCAN_a62cdda0_Rx: CanIfRxPduCanId=272, CanIfRxPduDlc=6, CanIfRxPduUserRxIndicationName=PduR_CanIfRxIndication, CanIfRxPduUserRxIndicationUL=PDUR, CanIfRxPduRef=EcucPduCollection/msg_RxCycle500_20_oCAN_266969e8_Rx
        msg_RxCycle_E2eProf1C_500_10_oCAN_223145ae_Rx: CanIfRxPduCanId=288, CanIfRxPduDlc=8, CanIfRxPduUserRxIndicationName=PduR_CanIfRxIndication, CanIfRxPduUserRxIndicationUL=PDUR, CanIfRxPduRef=EcucPduCollection/msg_RxCycle_E2eProf1C_500_10_oCAN_23e9789c_Rx
        msg_RxEvent_20_oCAN_8771683b_Rx: CanIfRxPduCanId=784, CanIfRxPduDlc=4, CanIfRxPduUserRxIndicationName=PduR_CanIfRxIndication, CanIfRxPduUserRxIndicationUL=PDUR, CanIfRxPduRef=EcucPduCollection/msg_RxEvent_20_oCAN_13517c6b_Rx
        msg_StartAppl_Rx_MyECU_oCAN_2369e80d_Rx: CanIfRxPduCanId=1281, CanIfRxPduDlc=8, CanIfRxPduUserRxIndicationName=PduR_CanIfRxIndication, CanIfRxPduUserRxIndicationUL=PDUR, CanIfRxPduRef=EcucPduCollection/msg_StartAppl_Rx_MyECU_oCAN_fe93a56e_Rx
        msg_XCP_Request_MyECU_oCAN_3fb53b34_Rx: CanIfRxPduCanId=1795, CanIfRxPduDlc=8, CanIfRxPduUserRxIndicationName=Xcp_CanIfRxIndication, CanIfRxPduUserRxIndicationUL=XCP, CanIfRxPduRef=EcucPduCollection/msg_XCP_Request_MyECU_oCAN_24ce420e_Rx
        msg_diag_RequestGlobal_Tp_oCAN_37844e48_Rx: CanIfRxPduCanId=1556, CanIfRxPduDlc=8, CanIfRxPduUserRxIndicationName=CanTp_RxIndication, CanIfRxPduUserRxIndicationType=PDUID_PDUINFOPTR, CanIfRxPduUserRxIndicationUL=CAN_TP, CanIfRxPduRef=msg_diag_RequestGlobal_Tp_oCAN_2ced7a67_Rx
        msg_diag_Request_MyECU_Slave3_oCAN_b0f04ace_Rx: CanIfRxPduCanId=1553, CanIfRxPduDlc=8, CanIfRxPduRef=msg_diag_Request_MyECU_Slave3_oCAN_87f08505_Rx
        msg_diag_Request_MyECU_Tp_oCAN_0b2d11a0_Rx: CanIfRxPduCanId=1552, CanIfRxPduDlc=8, CanIfRxPduUserRxIndicationName=CanTp_RxIndication, CanIfRxPduUserRxIndicationType=PDUID_PDUINFOPTR, CanIfRxPduUserRxIndicationUL=CAN_TP, CanIfRxPduRef=msg_diag_Request_MyECU_Tp_oCAN_44a1d668_Rx
      10 x CanIfTxPduCfg, all with CanIfTxPduCanIdType=STANDARD_CAN, CanIfTxPduBufferRef=CanIfInitCfg/CHNL_346f2748:
        msg_StartAppl_Tx_MyECU_oCAN_b6f80cd2_Tx: CanIfTxPduCanId=1280, CanIfTxPduDlc=8, CanIfTxPduUserTxConfirmationName=PduR_CanIfTxConfirmation, CanIfTxPduUserTxConfirmationUL=PDUR, CanIfTxPduRef=EcucPduCollection/msg_StartAppl_Tx_MyECU_oCAN_c14d78df_Tx
        msg_TxCycle1000_10_oCAN_fd90faa0_Tx: CanIfTxPduCanId=872, CanIfTxPduDlc=2, CanIfTxPduUserTxConfirmationName=PduR_CanIfTxConfirmation, CanIfTxPduUserTxConfirmationUL=PDUR, CanIfTxPduRef=EcucPduCollection/msg_TxCycle1000_10_oCAN_6dd6f284_Tx
        msg_TxCycle10_0_oCAN_9c370e88_Tx: CanIfTxPduCanId=616, CanIfTxPduDlc=7, CanIfTxPduUserTxConfirmationName=PduR_CanIfTxConfirmation, CanIfTxPduUserTxConfirmationUL=PDUR, CanIfTxPduRef=EcucPduCollection/msg_TxCycle10_0_oCAN_2d7b6a87_Tx
        msg_TxCycle_E2eProf1C_500_30_oCAN_f209e413_Tx: CanIfTxPduCanId=888, CanIfTxPduDlc=8, CanIfTxPduUserTxConfirmationName=PduR_CanIfTxConfirmation, CanIfTxPduUserTxConfirmationUL=PDUR, CanIfTxPduRef=EcucPduCollection/msg_TxCycle_E2eProf1C_500_30_oCAN_995018f6_Tx
        msg_TxEvent_10_oCAN_b963731b_Tx: CanIfTxPduCanId=360, CanIfTxPduDlc=7, CanIfTxPduUserTxConfirmationName=PduR_CanIfTxConfirmation, CanIfTxPduUserTxConfirmationUL=PDUR, CanIfTxPduRef=EcucPduCollection/msg_TxEvent_10_oCAN_b9443fef_Tx
        msg_XCP_Response_MyECU_oCAN_7223ed6d_Tx: CanIfTxPduCanId=1796, CanIfTxPduDlc=8, CanIfTxPduUserTxConfirmationName=Xcp_CanIfTxConfirmation, CanIfTxPduUserTxConfirmationUL=XCP, CanIfTxPduRef=EcucPduCollection/msg_XCP_Response_MyECU_oCAN_5d942f8b_Tx
        msg_diag_Response_MyECU_Slave3_oCAN_df0f7cb5_Tx: CanIfTxPduCanId=1555, CanIfTxPduDlc=8, CanIfTxPduRef=msg_diag_Response_MyECU_Slave3_oCAN_659398e3_Tx
        msg_diag_Response_MyECU_Tp_oCAN_ee3092c6_Tx: CanIfTxPduCanId=1554, CanIfTxPduDlc=8, CanIfTxPduUserTxConfirmationName=CanTp_TxConfirmation, CanIfTxPduUserTxConfirmationUL=CAN_TP, CanIfTxPduRef=msg_diag_Response_MyECU_Tp_oCAN_eec7d8e8_Tx
        msg_diag_Uudt_Response_MyECU_oCAN_6917a2df_Tx: CanIfTxPduCanId=1558, CanIfTxPduDlc=8, CanIfTxPduUserTxConfirmationName=PduR_CanIfTxConfirmation, CanIfTxPduUserTxConfirmationUL=PDUR, CanIfTxPduRef=EcucPduCollection/msg_diag_Uudt_Response_MyECU_oCAN_e0fa8c3a_Tx
        msg_nm_MyECU_oCAN_6fd77547_Tx: CanIfTxPduCanId=1024, CanIfTxPduDlc=8, CanIfTxPduUserTxConfirmationName=CanNm_TxConfirmation, CanIfTxPduUserTxConfirmationUL=CAN_NM, CanIfTxPduRef=EcucPduCollection/msg_nm_MyECU_oCAN_9090bd79_Tx
    CanIfPrivateCfg: CanIfPrivateSoftwareFilterType=LINEAR
    CanIfPublicCfg: CanIfPublicPnSupport=false
  module config CanNm
    CanNmGlobalConfig: CanNmComUserDataSupport=true, CanNmPnEiraCalcEnabled=false, CanNmUserDataEnabled=true
      CAN_5f8bc0cc (CanNmChannelConfig):
        CanNmMsgCycleTime = 0.1
        CanNmMsgReducedTime = 0.05
        CanNmNodeId = 0
        CanNmPduCbvPosition = CANNM_PDU_BYTE_0
        CanNmPduNidPosition = CANNM_PDU_BYTE_1
        CanNmRepeatMessageTime = 0.4
        CanNmTimeoutTime = 1
        CanNmUserDataLength = 6
        CanNmWaitBusSleepTime = 0.75
        CanNmComMNetworkHandleRef = ComMConfigSet/CN_CAN_fe6ecc87
        CAN_5f8bc0cc_Rx (CanNmRxPdu): CanNmRxPduRef=MyECU_dcffebb2_Rx
        msg_nm_MyECU_oCAN_9090bd79_Tx (CanNmTxPdu): CanNmTxPduRef=EcucPduCollection/msg_nm_MyECU_oCAN_9090bd79_Tx
        msg_nm_MyECU_oCAN_3680fbe4 (CanNmUserDataTxPdu): CanNmTxUserDataPduRef=EcucPduCollection/msg_nm_MyECU_oCAN_c97b60cc_Tx
  module config CanSM
    CanSMConfiguration
      CHNL_346f2748 (CanSMManagerNetwork): CanSMComMNetworkHandleRef=ComMConfigSet/CN_CAN_fe6ecc87
        CT_CAN_956be4cd (CanSMController): CanSMControllerId=CanIfCtrlDrvCfg_7d254554/CT_CAN_d43e43a4
  module config CanTp
    CanTpConfig: CanTpMainFunctionPeriod=0.005
      TPCH_5a4d0643 (CanTpChannel): CanTpChannelMode=CANTP_MODE_FULL_DUPLEX
        CanTpRxNSdu_456adda8 (CanTpRxNSdu):
          CanTpRxAddressingFormat = CANTP_STANDARD
          CanTpRxDl = 8
          CanTpRxTaType = CANTP_FUNCTIONAL
          CanTpRxNSduRef = EcucPduCollection/msg_diag_RequestGlobal_oCAN_e06c7e2d_Rx
          CanTpRxNPdu_e872022a (CanTpRxNPdu): CanTpRxNPduRef=msg_diag_RequestGlobal_Tp_oCAN_2ced7a67_Rx
      TPCH_6f424b54 (CanTpChannel): CanTpChannelMode=CANTP_MODE_FULL_DUPLEX
        CanTpRxNSdu_dab96b77 (CanTpRxNSdu):
          CanTpRxAddressingFormat = CANTP_STANDARD
          CanTpRxDl = 8
          CanTpRxTaType = CANTP_PHYSICAL
          CanTpRxNSduRef = EcucPduCollection/msg_diag_Request_MyECU_oCAN_ca029ee7_Rx
          CanTpRxNPdu_29945216 (CanTpRxNPdu): CanTpRxNPduRef=msg_diag_Request_MyECU_Tp_oCAN_44a1d668_Rx
          CanTpTxFcNPdu_29945216 (CanTpTxFcNPdu): CanTpTxFcNPduRef=msg_diag_Response_MyECU_Tp_oCAN_eec7d8e8_Tx
        CanTpTxNSdu_dab96b77 (CanTpTxNSdu):
          CanTpTxAddressingFormat = CANTP_STANDARD
          CanTpTxDl = 8
          CanTpTxTaType = CANTP_PHYSICAL
          CanTpTxNSduRef = EcucPduCollection/msg_diag_Response_MyECU_oCAN_84acb98b_Tx
          CanTpRxFcNPdu_0b6e86e4 (CanTpRxFcNPdu): CanTpRxFcNPduRef=msg_diag_Request_MyECU_Tp_oCAN_44a1d668_Rx
          CanTpTxNPdu_0b6e86e4 (CanTpTxNPdu): CanTpTxNPduRef=msg_diag_Response_MyECU_Tp_oCAN_eec7d8e8_Tx
  module config Com
    ComConfig
      11 x ComIPdu, all with ComIPduType=NORMAL:
        msg_RxCycle100_0_oCAN_1e247d16_Rx: ComIPduDirection=RECEIVE, ComIPduGroupRef=MyECU_oCAN_Rx_63a3e3ce, ComIPduSignalRef=Signal_RearInteriorLight_omsg_RxCycle100_0_oCAN_44115c66_Rx, ComIPduSignalRef=Signal_RearLeftDoor_omsg_RxCycle100_0_oCAN_47d3a185_Rx, ComIPduSignalRef=Signal_RearRightDoor_omsg_RxCycle100_0_oCAN_cbde8ce7_Rx, ComPduIdRef=EcucPduCollection/msg_RxCycle100_0_oCAN_1e247d16_Rx
        msg_RxCycle500_20_oCAN_a691adb3_Rx: ComIPduDirection=RECEIVE, ComIPduGroupRef=MyECU_oCAN_Rx_63a3e3ce, ComIPduSignalRef=Signal_Rx16bit_Cyclic_omsg_RxCycle500_20_oCAN_300c1427_Rx, ComIPduSignalRef=Signal_Rx20bit_Cyclic_omsg_RxCycle500_20_oCAN_983b15aa_Rx, ComIPduSignalRef=Signal_Rx8bit_Cyclic_omsg_RxCycle500_20_oCAN_f9e4bcc4_Rx, ComPduIdRef=EcucPduCollection/msg_RxCycle500_20_oCAN_a691adb3_Rx
        msg_RxCycle_E2eProf1C_500_10_oCAN_e8110737_Rx: ComIPduDirection=RECEIVE, ComIPduGroupRef=MyECU_oCAN_Rx_63a3e3ce, ComIPduSignalGroupRef=SG_RgRx_Prof1C_RxCycle_omsg_RxCycle_E2eProf1C_500_10_oCAN_430c5af9_Rx, ComPduIdRef=EcucPduCollection/msg_RxCycle_E2eProf1C_500_10_oCAN_e8110737_Rx
        msg_RxEvent_20_oCAN_a1df81ad_Rx: ComIPduDirection=RECEIVE, ComIPduGroupRef=MyECU_oCAN_Rx_63a3e3ce, ComIPduSignalRef=Signal_Rx11bit_OnWrite_omsg_RxEvent_20_oCAN_e14fb9df_Rx, ComIPduSignalRef=Signal_Rx15bit_OnWrite_omsg_RxEvent_20_oCAN_3a85fa13_Rx, ComPduIdRef=EcucPduCollection/msg_RxEvent_20_oCAN_a1df81ad_Rx
        msg_StartAppl_Rx_MyECU_oCAN_0da3c1e2_Rx: ComIPduDirection=RECEIVE, ComIPduGroupRef=MyECU_oCAN_Rx_63a3e3ce, ComIPduSignalRef=Signal_StartAppl_RxCtrl_MyECU_omsg_StartAppl_Rx_MyECU_oCAN_09591065_Rx, ComIPduSignalRef=Signal_StartAppl_RxData_MyECU_omsg_StartAppl_Rx_MyECU_oCAN_315f9453_Rx, ComPduIdRef=EcucPduCollection/msg_StartAppl_Rx_MyECU_oCAN_0da3c1e2_Rx
        msg_StartAppl_Tx_MyECU_oCAN_ad461e3f_Tx: ComIPduDirection=SEND, ComIPduGroupRef=MyECU_oCAN_Tx_35f94448, ComIPduSignalRef=Signal_StartAppl_TxCtrl_MyECU_omsg_StartAppl_Tx_MyECU_oCAN_b45ea6bd_Tx, ComIPduSignalRef=Signal_StartAppl_TxData_MyECU_omsg_StartAppl_Tx_MyECU_oCAN_8c58228b_Tx, ComPduIdRef=EcucPduCollection/msg_StartAppl_Tx_MyECU_oCAN_ad461e3f_Tx
          ComTxIPdu: ComMinimumDelayTime=0, ComTxIPduUnusedAreasDefault=0
            ComTxModeFalse
              ComTxMode: ComTxModeMode=PERIODIC, ComTxModeTimeOffset=0, ComTxModeTimePeriod=0.05
            ComTxModeTrue
              ComTxMode: ComTxModeMode=PERIODIC, ComTxModeTimeOffset=0, ComTxModeTimePeriod=0.05
        msg_TxCycle1000_10_oCAN_d74aed68_Tx: ComIPduDirection=SEND, ComIPduGroupRef=MyECU_oCAN_Tx_35f94448, ComIPduSignalRef=Signal_Tx10bit_Cyclic_omsg_TxCycle1000_10_oCAN_9539efc7_Tx, ComIPduSignalRef=Signal_Tx4bit_Cyclic_omsg_TxCycle1000_10_oCAN_ca549591_Tx, ComPduIdRef=EcucPduCollection/msg_TxCycle1000_10_oCAN_d74aed68_Tx
          ComTxIPdu: ComMinimumDelayTime=0, ComTxIPduUnusedAreasDefault=0
            ComTxModeFalse
              ComTxMode: ComTxModeMode=PERIODIC, ComTxModeTimeOffset=0.01, ComTxModeTimePeriod=1
            ComTxModeTrue
              ComTxMode: ComTxModeMode=PERIODIC, ComTxModeTimeOffset=0.01, ComTxModeTimePeriod=1
        msg_TxCycle10_0_oCAN_85bf3e37_Tx: ComIPduDirection=SEND, ComIPduGroupRef=MyECU_oCAN_Tx_35f94448, ComIPduSignalRef=Signal_Tx24bit_Cyclic_omsg_TxCycle10_0_oCAN_393dd5fe_Tx, ComIPduSignalRef=Signal_Tx32bit_Cyclic_omsg_TxCycle10_0_oCAN_ab90e6e2_Tx, ComPduIdRef=EcucPduCollection/msg_TxCycle10_0_oCAN_85bf3e37_Tx
          ComTxIPdu: ComMinimumDelayTime=0, ComTxIPduUnusedAreasDefault=0
            ComTxModeFalse
              ComTxMode: ComTxModeMode=PERIODIC, ComTxModeTimeOffset=0, ComTxModeTimePeriod=0.01
            ComTxModeTrue
              ComTxMode: ComTxModeMode=PERIODIC, ComTxModeTimeOffset=0, ComTxModeTimePeriod=0.01
        msg_TxCycle_E2eProf1C_500_30_oCAN_eeefc687_Tx: ComIPduDirection=SEND, ComIPduGroupRef=MyECU_oCAN_Tx_35f94448, ComIPduSignalGroupRef=SG_SgTx_Prof1C_TxCycle_omsg_TxCycle_E2eProf1C_500_30_oCAN_9bfb2a76_Tx, ComPduIdRef=EcucPduCollection/msg_TxCycle_E2eProf1C_500_30_oCAN_eeefc687_Tx
          ComTxIPdu: ComMinimumDelayTime=0, ComTxIPduUnusedAreasDefault=0
            ComTxModeFalse
              ComTxMode: ComTxModeMode=PERIODIC, ComTxModeTimeOffset=0.03, ComTxModeTimePeriod=0.5
            ComTxModeTrue
              ComTxMode: ComTxModeMode=PERIODIC, ComTxModeTimeOffset=0.03, ComTxModeTimePeriod=0.5
        msg_TxEvent_10_oCAN_b2cd4fc2_Tx: ComIPduDirection=SEND, ComIPduGroupRef=MyECU_oCAN_Tx_35f94448, ComIPduSignalRef=Signal_Tx24bit_OnWrite_omsg_TxEvent_10_oCAN_bb23a029_Tx, ComIPduSignalRef=Signal_Tx32bit_OnWrite_omsg_TxEvent_10_oCAN_298e9335_Tx, ComPduIdRef=EcucPduCollection/msg_TxEvent_10_oCAN_b2cd4fc2_Tx
          ComTxIPdu: ComMinimumDelayTime=0, ComTxIPduUnusedAreasDefault=0
            ComTxModeFalse
              ComTxMode: ComTxModeMode=DIRECT, ComTxModeNumberOfRepetitions=0, ComTxModeRepetitionPeriod=0
            ComTxModeTrue
              ComTxMode: ComTxModeMode=DIRECT, ComTxModeNumberOfRepetitions=0, ComTxModeRepetitionPeriod=0
        msg_nm_MyECU_oCAN_c97b60cc_Tx: ComIPduDirection=SEND, ComIPduSignalRef=NmUd_MyECU_16bit_omsg_nm_MyECU_oCAN_3d555341_Tx, ComIPduSignalRef=NmUd_MyECU_32bit_omsg_nm_MyECU_oCAN_e4323edd_Tx, ComPduIdRef=EcucPduCollection/msg_nm_MyECU_oCAN_c97b60cc_Tx
          ComTxIPdu: ComTxIPduUnusedAreasDefault=0  # msg_nm_MyECU_oCAN
      MyECU_oCAN_Rx_63a3e3ce (ComIPduGroup)
      MyECU_oCAN_Tx_35f94448 (ComIPduGroup)
      20 x ComSignal, all with ComSignalEndianness=LITTLE_ENDIAN:
        NmUd_MyECU_16bit_omsg_nm_MyECU_oCAN_3d555341_Tx: ComBitPosition=0, ComBitSize=16, ComSignalInitValue=0, ComSignalType=UINT16, ComTransferProperty=PENDING, ComSystemTemplateSystemSignalRef=NmUd_MyECU_16bit
        NmUd_MyECU_32bit_omsg_nm_MyECU_oCAN_e4323edd_Tx: ComBitPosition=16, ComBitSize=32, ComSignalInitValue=0, ComSignalType=UINT32, ComTransferProperty=PENDING, ComSystemTemplateSystemSignalRef=NmUd_MyECU_32bit
        Signal_RearInteriorLight_omsg_RxCycle100_0_oCAN_44115c66_Rx: ComBitPosition=0, ComBitSize=1, ComSignalInitValue=0, ComSignalType=BOOLEAN, ComTimeout=0, ComSystemTemplateSystemSignalRef=Signal_RearInteriorLight
        Signal_RearLeftDoor_omsg_RxCycle100_0_oCAN_47d3a185_Rx: ComBitPosition=1, ComBitSize=1, ComSignalInitValue=0, ComSignalType=BOOLEAN, ComTimeout=0, ComSystemTemplateSystemSignalRef=Signal_RearLeftDoor
        Signal_RearRightDoor_omsg_RxCycle100_0_oCAN_cbde8ce7_Rx: ComBitPosition=2, ComBitSize=1, ComSignalInitValue=0, ComSignalType=BOOLEAN, ComTimeout=0, ComSystemTemplateSystemSignalRef=Signal_RearRightDoor
        Signal_Rx11bit_OnWrite_omsg_RxEvent_20_oCAN_e14fb9df_Rx: ComBitPosition=0, ComBitSize=11, ComSignalInitValue=50, ComSignalType=UINT16, ComTimeout=0, ComSystemTemplateSystemSignalRef=Signal_Rx11bit_OnWrite
        Signal_Rx15bit_OnWrite_omsg_RxEvent_20_oCAN_3a85fa13_Rx: ComBitPosition=12, ComBitSize=15, ComSignalInitValue=25, ComSignalType=UINT16, ComTimeout=0, ComSystemTemplateSystemSignalRef=Signal_Rx15bit_OnWrite
        Signal_Rx16bit_Cyclic_omsg_RxCycle500_20_oCAN_300c1427_Rx: ComBitPosition=32, ComBitSize=16, ComSignalInitValue=32768, ComSignalType=UINT16, ComTimeout=0, ComSystemTemplateSystemSignalRef=Signal_Rx16bit_Cyclic
        Signal_Rx20bit_Cyclic_omsg_RxCycle500_20_oCAN_983b15aa_Rx: ComBitPosition=8, ComBitSize=20, ComSignalInitValue=1, ComSignalType=UINT32, ComTimeout=0, ComSystemTemplateSystemSignalRef=Signal_Rx20bit_Cyclic
        Signal_Rx8bit_Cyclic_omsg_RxCycle500_20_oCAN_f9e4bcc4_Rx: ComBitPosition=0, ComBitSize=8, ComSignalInitValue=15, ComSignalType=UINT8, ComTimeout=0, ComSystemTemplateSystemSignalRef=Signal_Rx8bit_Cyclic
        Signal_StartAppl_RxCtrl_MyECU_omsg_StartAppl_Rx_MyECU_oCAN_09591065_Rx: ComBitPosition=0, ComBitSize=8, ComSignalInitValue=0, ComSignalType=UINT8, ComTimeout=0, ComSystemTemplateSystemSignalRef=Signal_StartAppl_RxCtrl_MyECU
        Signal_StartAppl_RxData_MyECU_omsg_StartAppl_Rx_MyECU_oCAN_315f9453_Rx: ComBitPosition=8, ComBitSize=8, ComSignalInitValue=0, ComSignalType=UINT8, ComTimeout=0, ComSystemTemplateSystemSignalRef=Signal_StartAppl_RxData_MyECU
        Signal_StartAppl_TxCtrl_MyECU_omsg_StartAppl_Tx_MyECU_oCAN_b45ea6bd_Tx: ComBitPosition=0, ComBitSize=8, ComSignalInitValue=0, ComSignalType=UINT8, ComTransferProperty=PENDING, ComSystemTemplateSystemSignalRef=Signal_StartAppl_TxCtrl_MyECU
        Signal_StartAppl_TxData_MyECU_omsg_StartAppl_Tx_MyECU_oCAN_8c58228b_Tx: ComBitPosition=8, ComBitSize=8, ComSignalInitValue=0, ComSignalType=UINT8, ComTransferProperty=PENDING, ComSystemTemplateSystemSignalRef=Signal_StartAppl_TxData_MyECU
        Signal_Tx10bit_Cyclic_omsg_TxCycle1000_10_oCAN_9539efc7_Tx: ComBitPosition=0, ComBitSize=10, ComSignalInitValue=0, ComSignalType=UINT16, ComTransferProperty=PENDING, ComSystemTemplateSystemSignalRef=Signal_Tx10bit_Cyclic
        Signal_Tx24bit_Cyclic_omsg_TxCycle10_0_oCAN_393dd5fe_Tx: ComBitPosition=32, ComBitSize=24, ComSignalInitValue=0, ComSignalType=UINT32, ComTransferProperty=PENDING, ComSystemTemplateSystemSignalRef=Signal_Tx24bit_Cyclic
        Signal_Tx24bit_OnWrite_omsg_TxEvent_10_oCAN_bb23a029_Tx: ComBitPosition=32, ComBitSize=24, ComSignalInitValue=63, ComSignalType=UINT32, ComTransferProperty=TRIGGERED_WITHOUT_REPETITION, ComSystemTemplateSystemSignalRef=Signal_Tx24bit_OnWrite
        Signal_Tx32bit_Cyclic_omsg_TxCycle10_0_oCAN_ab90e6e2_Tx: ComBitPosition=0, ComBitSize=32, ComSignalInitValue=0, ComSignalType=UINT32, ComTransferProperty=PENDING, ComSystemTemplateSystemSignalRef=Signal_Tx32bit_Cyclic
        Signal_Tx32bit_OnWrite_omsg_TxEvent_10_oCAN_298e9335_Tx: ComBitPosition=0, ComBitSize=32, ComSignalInitValue=31, ComSignalType=UINT32, ComTransferProperty=TRIGGERED_WITHOUT_REPETITION, ComSystemTemplateSystemSignalRef=Signal_Tx32bit_OnWrite
        Signal_Tx4bit_Cyclic_omsg_TxCycle1000_10_oCAN_ca549591_Tx: ComBitPosition=10, ComBitSize=4, ComSignalInitValue=0, ComSignalType=UINT8, ComTransferProperty=PENDING, ComSystemTemplateSystemSignalRef=Signal_Tx4bit_Cyclic
      SG_RgRx_Prof1C_RxCycle_omsg_RxCycle_E2eProf1C_500_10_oCAN_430c5af9_Rx (ComSignalGroup): ComTimeout=0, ComTransferProperty=PENDING, ComSystemTemplateSignalGroupRef=SG_RgRx_Prof1C_RxCycle
        6 x ComGroupSignal, all with ComSignalEndianness=LITTLE_ENDIAN, ComSignalInitValue=0:
          SigRx_Prof1C_CRC_omsg_RxCycle_E2eProf1C_500_10_oCAN_d6a2f34d_Rx: ComBitPosition=0, ComBitSize=8, ComSignalType=UINT8, ComSystemTemplateSystemSignalRef=SigRx_Prof1C_CRC
          SigRx_Prof1C_DataId_HiByte_LoNib_omsg_RxCycle_E2eProf1C_500_10_oCAN_bdeb2c98_Rx: ComBitPosition=12, ComBitSize=4, ComSignalType=UINT8, ComSystemTemplateSystemSignalRef=SigRx_Prof1C_DataId_HiByte_LoNib
          SigRx_Prof1C_SQ_omsg_RxCycle_E2eProf1C_500_10_oCAN_263a4149_Rx: ComBitPosition=8, ComBitSize=4, ComSignalType=UINT8, ComSystemTemplateSystemSignalRef=SigRx_Prof1C_SQ
          SigRx_Prof1C_Sig32Bit_omsg_RxCycle_E2eProf1C_500_10_oCAN_f0dd3f4d_Rx: ComBitPosition=24, ComBitSize=32, ComSignalType=UINT32, ComSystemTemplateSystemSignalRef=SigRx_Prof1C_Sig32Bit
          SigRx_Prof1C_Sig3Bit_omsg_RxCycle_E2eProf1C_500_10_oCAN_95ddcbc9_Rx: ComBitPosition=21, ComBitSize=3, ComSignalType=UINT8, ComSystemTemplateSystemSignalRef=SigRx_Prof1C_Sig3Bit
          SigRx_Prof1C_Sig4Bit_omsg_RxCycle_E2eProf1C_500_10_oCAN_a713ffd7_Rx: ComBitPosition=16, ComBitSize=4, ComSignalType=UINT8, ComSystemTemplateSystemSignalRef=SigRx_Prof1C_Sig4Bit
      SG_SgTx_Prof1C_TxCycle_omsg_TxCycle_E2eProf1C_500_30_oCAN_9bfb2a76_Tx (ComSignalGroup): ComTransferProperty=PENDING, ComSystemTemplateSignalGroupRef=SG_SgTx_Prof1C_TxCycle
        7 x ComGroupSignal, all with ComSignalEndianness=LITTLE_ENDIAN, ComSignalInitValue=0, ComTransferProperty=PENDING:
          SigTx_Prof1C_CRC_omsg_TxCycle_E2eProf1C_500_30_oCAN_5df85835_Tx: ComBitPosition=0, ComBitSize=8, ComSignalType=UINT8, ComSystemTemplateSystemSignalRef=SigTx_Prof1C_CRC
          SigTx_Prof1C_DataId_HiByte_LoNib_omsg_TxCycle_E2eProf1C_500_30_oCAN_2f490cd4_Tx: ComBitPosition=12, ComBitSize=4, ComSignalType=UINT8, ComSystemTemplateSystemSignalRef=SigTx_Prof1C_DataId_HiByte_LoNib
          SigTx_Prof1C_SQ_omsg_TxCycle_E2eProf1C_500_30_oCAN_8ca3bde6_Tx: ComBitPosition=8, ComBitSize=4, ComSignalType=UINT8, ComSystemTemplateSystemSignalRef=SigTx_Prof1C_SQ
          SigTx_Prof1C_Sig16Bit_omsg_TxCycle_E2eProf1C_500_30_oCAN_4f2c5310_Tx: ComBitPosition=32, ComBitSize=16, ComSignalType=UINT16, ComSystemTemplateSystemSignalRef=SigTx_Prof1C_Sig16Bit
          SigTx_Prof1C_Sig2Bit_omsg_TxCycle_E2eProf1C_500_30_oCAN_72710fbf_Tx: ComBitPosition=30, ComBitSize=2, ComSignalType=UINT8, ComSystemTemplateSystemSignalRef=SigTx_Prof1C_Sig2Bit
          SigTx_Prof1C_Sig4Bit_omsg_TxCycle_E2eProf1C_500_30_oCAN_0e363008_Tx: ComBitPosition=16, ComBitSize=4, ComSignalType=UINT8, ComSystemTemplateSystemSignalRef=SigTx_Prof1C_Sig4Bit
          SigTx_Prof1C_Sig8Bit_omsg_TxCycle_E2eProf1C_500_30_oCAN_f6b84f66_Tx: ComBitPosition=48, ComBitSize=8, ComSignalType=UINT8, ComSystemTemplateSystemSignalRef=SigTx_Prof1C_Sig8Bit
    ComGeneral
  module config ComM
    ComMConfigSet: ComMPncEnabled=false
      CN_CAN_fe6ecc87 (ComMChannel): ComMBusType=COMM_BUS_TYPE_CAN, ComMChannelId=0
        ComMNetworkManagement: ComMNmVariant=FULL
        CN_CAN_6e33c5a0 (ComMUserPerChannel): ComMUserChannel=CN_CAN_52ce3533
      CN_CAN_52ce3533 (ComMUser): ComMUserIdentifier=0
    ComMGeneral: ComMPncIdCounting=COMM_PNC_ID_COUNT_FROM_NM_MESSAGE, ComMPncSupport=false
  module config Dcm
    DcmConfigSet  # Diagnostics Data Import
      DcmDsl
        DcmDslProtocol
          DcmDslProtocolRow_29812fbf (DcmDslProtocolRow)
            DC_0xE001_oMyECU_oCAN_9c85e87b (DcmDslConnection)
              DcmDslMainConnection: DcmDslProtocolRxTesterSourceAddr=224
                msg_diag_RequestGlobal_oCAN_2eba11fb_Rx_1026d879 (DcmDslProtocolRx):
                  DcmDslProtocolRxAddrType = DCM_FUNCTIONAL_TYPE
                  DcmDslProtocolRxPduId = 1
                  DcmDslProtocolRxComMChannelRef = ComMConfigSet/CN_CAN_fe6ecc87
                  DcmDslProtocolRxPduRef = msg_diag_RequestGlobal_oCAN_2eba11fb_Rx
                msg_diag_Request_MyECU_oCAN_cd2e72ff_Rx_db217017 (DcmDslProtocolRx):
                  DcmDslProtocolRxAddrType = DCM_PHYSICAL_TYPE
                  DcmDslProtocolRxPduId = 2
                  DcmDslProtocolRxComMChannelRef = ComMConfigSet/CN_CAN_fe6ecc87
                  DcmDslProtocolRxPduRef = msg_diag_Request_MyECU_oCAN_cd2e72ff_Rx
                msg_diag_Response_MyECU_oCAN_06426912_Tx_5d336398 (DcmDslProtocolTx): DcmDslTxConfirmationPduId=0, DcmDslProtocolTxPduRef=EcucPduCollection/msg_diag_Response_MyECU_oCAN_06426912_Tx
      DcmDsp: DcmDspMaxDidToRead=5  # Diagnostics Data Import
        ComControl (DcmDspComControl)  # Diagnostics Data Import
          DspComContolAllChannel (DcmDspComControlAllChannel)  # Diagnostics Data Import
        DcmDspSession  # Diagnostics Data Import
          Extended (DcmDspSessionRow): DcmDspSessionLevel=3, DcmDspSessionP2ServerMax=0.05, DcmDspSessionP2StarServerMax=5  # Diagnostics Data Import
          Default (DcmDspSessionRow): DcmDspSessionLevel=1, DcmDspSessionP2ServerMax=0.05, DcmDspSessionP2StarServerMax=5  # Diagnostics Data Import
        DcmDspSecurity  # Diagnostics Data Import
          UnlockedL1 (DcmDspSecurityRow):  # Diagnostics Data Import
            DcmDspSecurityDelayTime = 10
            DcmDspSecurityDelayTimeOnBoot = 0
            DcmDspSecurityKeySize = 4
            DcmDspSecurityLevel = 1
            DcmDspSecurityNumAttDelay = 3
            DcmDspSecuritySeedSize = 4
          Locked (DcmDspSecurityRow): DcmDspSecurityLevel=0  # Diagnostics Data Import
        RoutineInfo_HUT_self_check (DcmDspRoutineInfo)  # Diagnostics Data Import
          DcmDspRoutineAuthorization: DcmDspRoutineSessionRef=DcmDspSession/Extended, DcmDspRoutineSecurityLevelRef=UnlockedL1  # Diagnostics Data Import
        HUT_self_check (DcmDspRoutine):  # Diagnostics Data Import
          DcmDspRequestResultsRoutineSupported = true
          DcmDspStopRoutineSupported = true
          DcmDspRoutineIdentifier = 57601
          DcmDspRoutineInfoRef = RoutineInfo_HUT_self_check
        84 x DcmDspDidInfo:
          DidInfo_Switch_HU_boot_mode_FDF1  # Diagnostics Data Import
            DcmDspDidAccess  # Diagnostics Data Import
              DcmDspDidWrite  # Diagnostics Data Import
          DidInfo_Set_debug_on_off_control_FDF0  # Diagnostics Data Import
            DcmDspDidAccess  # Diagnostics Data Import
              DcmDspDidWrite  # Diagnostics Data Import
              DcmDspDidRead  # Diagnostics Data Import
          DidInfo_AME_Set_External_Output_Status_FD93  # Diagnostics Data Import
            DcmDspDidAccess  # Diagnostics Data Import
              DcmDspDidWrite  # Diagnostics Data Import
          DidInfo_AME_Read_Detection_Input_Info_FD92  # Diagnostics Data Import
            DcmDspDidAccess  # Diagnostics Data Import
              DcmDspDidRead  # Diagnostics Data Import
          DidInfo_AME_Read_Head_Unit_Connector_Status_FD90  # Diagnostics Data Import
            DcmDspDidAccess  # Diagnostics Data Import
              DcmDspDidRead  # Diagnostics Data Import
          DidInfo_AME_TBOX_communication_status_check_FD80  # Diagnostics Data Import
            DcmDspDidAccess  # Diagnostics Data Import
              DcmDspDidRead  # Diagnostics Data Import
          DidInfo_AME_ReadGPSSNR_FD73  # Diagnostics Data Import
            DcmDspDidAccess  # Diagnostics Data Import
              DcmDspDidRead  # Diagnostics Data Import
          DidInfo_AME_Read_GPS_Info_FD72  # Diagnostics Data Import
            DcmDspDidAccess  # Diagnostics Data Import
              DcmDspDidRead  # Diagnostics Data Import
          DidInfo_AME_Read_GYRO_Status_FD71  # Diagnostics Data Import
            DcmDspDidAccess  # Diagnostics Data Import
              DcmDspDidRead  # Diagnostics Data Import
          DidInfo_AME_Enter_NAV_Demo_Mode_FD70  # Diagnostics Data Import
            DcmDspDidAccess  # Diagnostics Data Import
              DcmDspDidWrite  # Diagnostics Data Import
          DidInfo_AME_Ethernet_IP_Ping_Function_FD6E  # Diagnostics Data Import
            DcmDspDidAccess  # Diagnostics Data Import
              DcmDspDidWrite  # Diagnostics Data Import
          DidInfo_AME_Mirror_Link_connection_FD6D  # Diagnostics Data Import
            DcmDspDidAccess  # Diagnostics Data Import
              DcmDspDidWrite: DcmDspDidWriteSessionRef=DcmDspSession/Extended  # Diagnostics Data Import
          DidInfo_AME_BT_Handfree_Loopback_Test_FD6B  # Diagnostics Data Import
            DcmDspDidAccess  # Diagnostics Data Import
              DcmDspDidWrite  # Diagnostics Data Import
          DidInfo_AME_Set_WIFI_Mode_FD67  # Diagnostics Data Import
            DcmDspDidAccess  # Diagnostics Data Import
              DcmDspDidWrite  # Diagnostics Data Import
          DidInfo_AME_Play_BT_Audio_Control_FD64  # Diagnostics Data Import
            DcmDspDidAccess  # Diagnostics Data Import
              DcmDspDidWrite  # Diagnostics Data Import
          DidInfo_AME_BT_Auto_Pairing_FD63  # Diagnostics Data Import
            DcmDspDidAccess  # Diagnostics Data Import
              DcmDspDidWrite  # Diagnostics Data Import
          DidInfo_AME_Connectivy_OnOff_Control_FD62  # Diagnostics Data Import
            DcmDspDidAccess  # Diagnostics Data Import
              DcmDspDidWrite  # Diagnostics Data Import
          DidInfo_AME_Write_MAC_Address_FD61  # Diagnostics Data Import
            DcmDspDidAccess  # Diagnostics Data Import
              DcmDspDidWrite  # Diagnostics Data Import
          DidInfo_AME_Read_MAC_Address_FD60  # Diagnostics Data Import
            DcmDspDidAccess  # Diagnostics Data Import
              DcmDspDidRead  # Diagnostics Data Import
          DidInfo_AME_Set_AM_Frequency_FD52  # Diagnostics Data Import
            DcmDspDidAccess  # Diagnostics Data Import
              DcmDspDidWrite  # Diagnostics Data Import
          DidInfo_AME_Set_FM_Frequency_FD50  # Diagnostics Data Import
            DcmDspDidAccess  # Diagnostics Data Import
              DcmDspDidWrite  # Diagnostics Data Import
          DidInfo_AME_TrackMedia_Audio_Source_Play_FD41  # Diagnostics Data Import
            DcmDspDidAccess  # Diagnostics Data Import
              DcmDspDidWrite  # Diagnostics Data Import
          DidInfo_AME_Switch_Source_FD40  # Diagnostics Data Import
            DcmDspDidAccess  # Diagnostics Data Import
              DcmDspDidWrite  # Diagnostics Data Import
          DidInfo_AME_Select_Audio_Buffer_Channel_Output_FD39  # Diagnostics Data Import
            DcmDspDidAccess  # Diagnostics Data Import
              DcmDspDidWrite  # Diagnostics Data Import
          DidInfo_AME_Display_Color_Bar_Control_FD38  # Diagnostics Data Import
            DcmDspDidAccess  # Diagnostics Data Import
              DcmDspDidWrite  # Diagnostics Data Import
          DidInfo_AME_Route_Video_To_HMI_FD37  # Diagnostics Data Import
            DcmDspDidAccess  # Diagnostics Data Import
              DcmDspDidWrite  # Diagnostics Data Import
          DidInfo_AME_Route_MIC_To_Internal_Speaker_FD36  # Diagnostics Data Import
            DcmDspDidAccess  # Diagnostics Data Import
              DcmDspDidWrite  # Diagnostics Data Import
          DidInfo_Select_Speaker_Test_Tone_FD34  # Diagnostics Data Import
            DcmDspDidAccess  # Diagnostics Data Import
              DcmDspDidWrite  # Diagnostics Data Import
          DidInfo_AME_Select_Speaker_Zone_FD33  # Diagnostics Data Import
            DcmDspDidAccess  # Diagnostics Data Import
              DcmDspDidWrite  # Diagnostics Data Import
          DidInfo_AME_Set_Mute_Control_FD31  # Diagnostics Data Import
            DcmDspDidAccess  # Diagnostics Data Import
              DcmDspDidWrite  # Diagnostics Data Import
          DidInfo_AME_Set_Volume_FD30  # Diagnostics Data Import
            DcmDspDidAccess  # Diagnostics Data Import
              DcmDspDidWrite  # Diagnostics Data Import
          DidInfo_AME_Set_HMI_Language_FD21  # Diagnostics Data Import
            DcmDspDidAccess  # Diagnostics Data Import
              DcmDspDidWrite  # Diagnostics Data Import
          DidInfo_AME_Skip_welcome_confirm_FD20  # Diagnostics Data Import
            DcmDspDidAccess  # Diagnostics Data Import
              DcmDspDidWrite  # Diagnostics Data Import
          DidInfo_AME_Input_Output_OnOff_control_FD18  # Diagnostics Data Import
            DcmDspDidAccess  # Diagnostics Data Import
              DcmDspDidWrite  # Diagnostics Data Import
          DidInfo_AME_Read_system_voltage_FD14  # Diagnostics Data Import
            DcmDspDidAccess  # Diagnostics Data Import
              DcmDspDidRead  # Diagnostics Data Import
          DidInfo_AME_Read_system_temperature_FD13  # Diagnostics Data Import
            DcmDspDidAccess  # Diagnostics Data Import
              DcmDspDidRead  # Diagnostics Data Import
          DidInfo_AME_Set_FAN_speed_FD12  # Diagnostics Data Import
            DcmDspDidAccess  # Diagnostics Data Import
              DcmDspDidWrite  # Diagnostics Data Import
          DidInfo_AME_Read_FAN_speed_FD11  # Diagnostics Data Import
            DcmDspDidAccess  # Diagnostics Data Import
              DcmDspDidRead  # Diagnostics Data Import
          DidInfo_AME_Read_AME_diagnostic_version_FD08  # Diagnostics Data Import
            DcmDspDidAccess  # Diagnostics Data Import
              DcmDspDidRead  # Diagnostics Data Import
          DidInfo_AME_Write_harman_manufactory_part_number_FD07  # Diagnostics Data Import
            DcmDspDidAccess  # Diagnostics Data Import
              DcmDspDidWrite  # Diagnostics Data Import
          DidInfo_AME_Read_harman_manufactory_part_number_FD06  # Diagnostics Data Import
            DcmDspDidAccess  # Diagnostics Data Import
              DcmDspDidRead  # Diagnostics Data Import
          DidInfo_AME_Reset_Factory_Mode_FD05  # Diagnostics Data Import
            DcmDspDidAccess  # Diagnostics Data Import
              DcmDspDidWrite  # Diagnostics Data Import
          DidInfo_AME_Read_SW_and_HW_Version_FD04  # Diagnostics Data Import
            DcmDspDidAccess  # Diagnostics Data Import
              DcmDspDidRead  # Diagnostics Data Import
          DidInfo_AME_Switch_BIOS_Mode_FD02  # Diagnostics Data Import
            DcmDspDidAccess  # Diagnostics Data Import
              DcmDspDidWrite  # Diagnostics Data Import
          DidInfo_AME_Power_Control_FD01  # Diagnostics Data Import
            DcmDspDidAccess  # Diagnostics Data Import
              DcmDspDidWrite  # Diagnostics Data Import
          DidInfo_C_matrix_Version_of_the_ECU_product_F1A2  # Diagnostics Data Import
            DcmDspDidAccess  # Diagnostics Data Import
              DcmDspDidRead  # Diagnostics Data Import
          DidInfo_VehicleNetworkConfiguration_F1A1  # Diagnostics Data Import
            DcmDspDidAccess  # Diagnostics Data Import
              DcmDspDidWrite: DcmDspDidWriteSessionRef=DcmDspSession/Extended, DcmDspDidWriteSecurityLevelRef=UnlockedL1  # Diagnostics Data Import
              DcmDspDidRead  # Diagnostics Data Import
          DidInfo_System_Supplier_ECU_Software_Version_Number_F195  # Diagnostics Data Import
            DcmDspDidAccess  # Diagnostics Data Import
              DcmDspDidRead  # Diagnostics Data Import
          DidInfo_System_Supplier_ECU_Hardware_Version_Number_F193  # Diagnostics Data Import
            DcmDspDidAccess  # Diagnostics Data Import
              DcmDspDidRead  # Diagnostics Data Import
          DidInfo_Vehicle_Identification_Number_F190  # Diagnostics Data Import
            DcmDspDidAccess  # Diagnostics Data Import
              DcmDspDidWrite: DcmDspDidWriteSessionRef=DcmDspSession/Extended, DcmDspDidWriteSecurityLevelRef=UnlockedL1  # Diagnostics Data Import
              DcmDspDidRead  # Diagnostics Data Import
          DidInfo_ECU_Serial_Number_F18C  # Diagnostics Data Import
            DcmDspDidAccess  # Diagnostics Data Import
              DcmDspDidWrite: DcmDspDidWriteSessionRef=DcmDspSession/Extended, DcmDspDidWriteSecurityLevelRef=UnlockedL1  # Diagnostics Data Import
              DcmDspDidRead  # Diagnostics Data Import
          DidInfo_System_Supplier_Identifier_F18A  # Diagnostics Data Import
            DcmDspDidAccess  # Diagnostics Data Import
              DcmDspDidRead  # Diagnostics Data Import
          DidInfo_Vehicle_Manufacture_Spare_Part_Number_F187  # Diagnostics Data Import
            DcmDspDidAccess  # Diagnostics Data Import
              DcmDspDidRead  # Diagnostics Data Import
          DidInfo_Number_of_installed_speakers_E01C  # Diagnostics Data Import
            DcmDspDidAccess  # Diagnostics Data Import
              DcmDspDidRead  # Diagnostics Data Import
          DidInfo_Telematics_Module_Status_E01A  # Diagnostics Data Import
            DcmDspDidAccess  # Diagnostics Data Import
              DcmDspDidRead  # Diagnostics Data Import
          DidInfo_Tbox_geographical_coordinates_when_connection_lost_E019  # Diagnostics Data Import
            DcmDspDidAccess  # Diagnostics Data Import
              DcmDspDidRead  # Diagnostics Data Import
          DidInfo_Tbox_Last_connection_lost_time_stamp_E018  # Diagnostics Data Import
            DcmDspDidAccess  # Diagnostics Data Import
              DcmDspDidRead  # Diagnostics Data Import
          DidInfo_Tbox_Gateway_sub_mask_E017  # Diagnostics Data Import
            DcmDspDidAccess  # Diagnostics Data Import
              DcmDspDidRead  # Diagnostics Data Import
          DidInfo_Tbox_IP_Address_E016  # Diagnostics Data Import
            DcmDspDidAccess  # Diagnostics Data Import
              DcmDspDidRead  # Diagnostics Data Import
          DidInfo_Wi_Fi_Module_Hardware_Part_Number_E015  # Diagnostics Data Import
            DcmDspDidAccess  # Diagnostics Data Import
              DcmDspDidRead  # Diagnostics Data Import
          DidInfo_Wi_Fi_Module_Firmware_Version_E014  # Diagnostics Data Import
            DcmDspDidAccess  # Diagnostics Data Import
              DcmDspDidRead  # Diagnostics Data Import
          DidInfo_Wi_Fi_Module_Status_E013  # Diagnostics Data Import
            DcmDspDidAccess  # Diagnostics Data Import
              DcmDspDidRead  # Diagnostics Data Import
          DidInfo_FM_signal_Strength_E012  # Diagnostics Data Import
            DcmDspDidAccess  # Diagnostics Data Import
              DcmDspDidRead  # Diagnostics Data Import
          DidInfo_AM_signal_Strength_E011  # Diagnostics Data Import
            DcmDspDidAccess  # Diagnostics Data Import
              DcmDspDidRead  # Diagnostics Data Import
          DidInfo_Support_FM_frequency_Max_E010  # Diagnostics Data Import
            DcmDspDidAccess  # Diagnostics Data Import
              DcmDspDidRead  # Diagnostics Data Import
          DidInfo_Support_FM_frequency_Min_E00F  # Diagnostics Data Import
            DcmDspDidAccess  # Diagnostics Data Import
              DcmDspDidRead  # Diagnostics Data Import
          DidInfo_Support_AM_frequency_Max_E00E  # Diagnostics Data Import
            DcmDspDidAccess  # Diagnostics Data Import
              DcmDspDidRead  # Diagnostics Data Import
          DidInfo_Support_AM_frequency_Min_E00D  # Diagnostics Data Import
            DcmDspDidAccess  # Diagnostics Data Import
              DcmDspDidRead  # Diagnostics Data Import
          DidInfo_Currently_connected_USB_Type_E00C  # Diagnostics Data Import
            DcmDspDidAccess  # Diagnostics Data Import
              DcmDspDidRead  # Diagnostics Data Import
          DidInfo_Number_of_external_USB_devices_plugged_E00B  # Diagnostics Data Import
            DcmDspDidAccess  # Diagnostics Data Import
              DcmDspDidRead  # Diagnostics Data Import
          DidInfo_Audio_jack_status_E00A  # Diagnostics Data Import
            DcmDspDidAccess  # Diagnostics Data Import
              DcmDspDidRead  # Diagnostics Data Import
          DidInfo_BT_firmware_version_E009  # Diagnostics Data Import
            DcmDspDidAccess  # Diagnostics Data Import
              DcmDspDidRead  # Diagnostics Data Import
          DidInfo_BT_active_profile_list_E008  # Diagnostics Data Import
            DcmDspDidAccess  # Diagnostics Data Import
              DcmDspDidRead  # Diagnostics Data Import
          DidInfo_BT_Power_Class_E007  # Diagnostics Data Import
            DcmDspDidAccess  # Diagnostics Data Import
              DcmDspDidRead  # Diagnostics Data Import
          DidInfo_Bluetooth_Status_E006  # Diagnostics Data Import
            DcmDspDidAccess  # Diagnostics Data Import
              DcmDspDidRead  # Diagnostics Data Import
          DidInfo_Bluetooth_Current_Discoverability_modes_E005  # Diagnostics Data Import
            DcmDspDidAccess  # Diagnostics Data Import
              DcmDspDidRead  # Diagnostics Data Import
          DidInfo_Present_GPS_coordinates_shift_data_E003  # Diagnostics Data Import
            DcmDspDidAccess  # Diagnostics Data Import
              DcmDspDidRead  # Diagnostics Data Import
          DidInfo_Screen_resolution_E002  # Diagnostics Data Import
            DcmDspDidAccess  # Diagnostics Data Import
              DcmDspDidRead  # Diagnostics Data Import
          DidInfo_Number_of_installed_cameras_E001  # Diagnostics Data Import
            DcmDspDidAccess  # Diagnostics Data Import
              DcmDspDidRead  # Diagnostics Data Import
          DidInfo_DTC_Occurrence_Timer_D005  # Diagnostics Data Import
            DcmDspDidAccess  # Diagnostics Data Import
              DcmDspDidRead  # Diagnostics Data Import
          DidInfo_Odometer_D004  # Diagnostics Data Import
            DcmDspDidAccess  # Diagnostics Data Import
              DcmDspDidRead  # Diagnostics Data Import
          DidInfo_Operating_Voltage_Value_D003  # Diagnostics Data Import
            DcmDspDidAccess  # Diagnostics Data Import
              DcmDspDidRead  # Diagnostics Data Import
          DidInfo_Engine_Speed_D002  # Diagnostics Data Import
            DcmDspDidAccess  # Diagnostics Data Import
              DcmDspDidRead  # Diagnostics Data Import
          DidInfo_Vehicle_Speed_D001  # Diagnostics Data Import
            DcmDspDidAccess  # Diagnostics Data Import
              DcmDspDidRead  # Diagnostics Data Import
        84 x DcmDspDid:
          Switch_HU_boot_mode_FDF1: DcmDspDidIdentifier=65009, DcmDspDidInfoRef=DidInfo_Switch_HU_boot_mode_FDF1  # Diagnostics Data Import
            Boot_Mode (DcmDspDidSignal): DcmDspDidDataPos=0, DcmDspDidDataRef=Switch_HU_boot_mode_FDF1_Boot_Mode  # Diagnostics Data Import
          Set_debug_on_off_control_FDF0: DcmDspDidIdentifier=65008, DcmDspDidInfoRef=DidInfo_Set_debug_on_off_control_FDF0  # Diagnostics Data Import
            CombinedDataElement (DcmDspDidSignal): DcmDspDidDataPos=0, DcmDspDidDataRef=Set_debug_on_off_control_FDF0_CombinedDataElement  # Diagnostics Data Import
          AME_Set_External_Output_Status_FD93: DcmDspDidIdentifier=64915, DcmDspDidInfoRef=DidInfo_AME_Set_External_Output_Status_FD93  # Diagnostics Data Import
            Status (DcmDspDidSignal): DcmDspDidDataPos=8, DcmDspDidDataRef=AME_Set_External_Output_Status_FD93_Status  # Diagnostics Data Import
            HW (DcmDspDidSignal): DcmDspDidDataPos=0, DcmDspDidDataRef=AME_Set_External_Output_Status_FD93_HW  # Diagnostics Data Import
          AME_Read_Detection_Input_Info_FD92: DcmDspDidIdentifier=64914, DcmDspDidInfoRef=DidInfo_AME_Read_Detection_Input_Info_FD92  # Diagnostics Data Import
            CombinedDataElement (DcmDspDidSignal): DcmDspDidDataPos=0, DcmDspDidDataRef=AME_Read_Detection_Input_Info_FD92_CombinedDataElement  # Diagnostics Data Import
          AME_Read_Head_Unit_Connector_Status_FD90: DcmDspDidIdentifier=64912, DcmDspDidInfoRef=DidInfo_AME_Read_Head_Unit_Connector_Status_FD90  # Diagnostics Data Import
            CombinedDataElement (DcmDspDidSignal): DcmDspDidDataPos=0, DcmDspDidDataRef=AME_Read_Head_Unit_Connector_Status_FD90_CombinedDataElement  # Diagnostics Data Import
          AME_TBOX_communication_status_check_FD80: DcmDspDidIdentifier=64896, DcmDspDidInfoRef=DidInfo_AME_TBOX_communication_status_check_FD80  # Diagnostics Data Import
            TBOX_status (DcmDspDidSignal): DcmDspDidDataPos=0, DcmDspDidDataRef=AME_TBOX_communication_status_check_FD80_TBOX_status  # Diagnostics Data Import
          AME_ReadGPSSNR_FD73: DcmDspDidIdentifier=64883, DcmDspDidInfoRef=DidInfo_AME_ReadGPSSNR_FD73  # Diagnostics Data Import
            GPSSNR (DcmDspDidSignal): DcmDspDidDataPos=0, DcmDspDidDataRef=AME_ReadGPSSNR_FD73_GPSSNR  # Diagnostics Data Import
          AME_Read_GPS_Info_FD72: DcmDspDidIdentifier=64882, DcmDspDidInfoRef=DidInfo_AME_Read_GPS_Info_FD72  # Diagnostics Data Import
            3 x DcmDspDidSignal:
              Number_of_used_satellite: DcmDspDidDataPos=16, DcmDspDidDataRef=AME_Read_GPS_Info_FD72_Number_of_used_satellite  # Diagnostics Data Import
              Number_of_fix: DcmDspDidDataPos=8, DcmDspDidDataRef=AME_Read_GPS_Info_FD72_Number_of_fix  # Diagnostics Data Import
              Number_of_visible_staellite: DcmDspDidDataPos=0, DcmDspDidDataRef=AME_Read_GPS_Info_FD72_Number_of_visible_staellite  # Diagnostics Data Import
          AME_Read_GYRO_Status_FD71: DcmDspDidIdentifier=64881, DcmDspDidInfoRef=DidInfo_AME_Read_GYRO_Status_FD71  # Diagnostics Data Import
            GYRO_Status (DcmDspDidSignal): DcmDspDidDataPos=0, DcmDspDidDataRef=AME_Read_GYRO_Status_FD71_GYRO_Status  # Diagnostics Data Import
          AME_Enter_NAV_Demo_Mode_FD70: DcmDspDidIdentifier=64880, DcmDspDidInfoRef=DidInfo_AME_Enter_NAV_Demo_Mode_FD70  # Diagnostics Data Import
            INVALID_SHORTNAME_Demo_Mode (DcmDspDidSignal): DcmDspDidDataPos=0, DcmDspDidDataRef=AME_Enter_NAV_Demo_Mode_FD70_Demo_Mode  # Diagnostics Data Import
          AME_Ethernet_IP_Ping_Function_FD6E: DcmDspDidIdentifier=64878, DcmDspDidInfoRef=DidInfo_AME_Ethernet_IP_Ping_Function_FD6E  # Diagnostics Data Import
            5 x DcmDspDidSignal:
              IPAddress_Byte4: DcmDspDidDataPos=32, DcmDspDidDataRef=AME_Ethernet_IP_Ping_Function_FD6E_IPAddress_Byte4  # Diagnostics Data Import
              IPAddress_Byte3: DcmDspDidDataPos=24, DcmDspDidDataRef=AME_Ethernet_IP_Ping_Function_FD6E_IPAddress_Byte3  # Diagnostics Data Import
              IPAddress_Byte2: DcmDspDidDataPos=16, DcmDspDidDataRef=AME_Ethernet_IP_Ping_Function_FD6E_IPAddress_Byte2  # Diagnostics Data Import
              IPAddress_Byte1: DcmDspDidDataPos=8, DcmDspDidDataRef=AME_Ethernet_IP_Ping_Function_FD6E_IPAddress_Byte1  # Diagnostics Data Import
              Ethernet_Channel: DcmDspDidDataPos=0, DcmDspDidDataRef=AME_Ethernet_IP_Ping_Function_FD6E_Ethernet_Channel  # Diagnostics Data Import
          AME_Mirror_Link_connection_FD6D: DcmDspDidIdentifier=64877, DcmDspDidInfoRef=DidInfo_AME_Mirror_Link_connection_FD6D  # Diagnostics Data Import
            Mirror_Link_connection (DcmDspDidSignal): DcmDspDidDataPos=0, DcmDspDidDataRef=AME_Mirror_Link_connection_FD6D_Mirror_Link_connection  # Diagnostics Data Import
          AME_BT_Handfree_Loopback_Test_FD6B: DcmDspDidIdentifier=64875, DcmDspDidInfoRef=DidInfo_AME_BT_Handfree_Loopback_Test_FD6B  # Diagnostics Data Import
            Reserved_Byte (DcmDspDidSignal): DcmDspDidDataPos=0, DcmDspDidDataRef=AME_BT_Handfree_Loopback_Test_FD6B_Reserved_Byte  # Diagnostics Data Import
          AME_Set_WIFI_Mode_FD67: DcmDspDidIdentifier=64871, DcmDspDidInfoRef=DidInfo_AME_Set_WIFI_Mode_FD67  # Diagnostics Data Import
            WiFi_Mode (DcmDspDidSignal): DcmDspDidDataPos=0, DcmDspDidDataRef=AME_Set_WIFI_Mode_FD67_WiFi_Mode  # Diagnostics Data Import
          AME_Play_BT_Audio_Control_FD64: DcmDspDidIdentifier=64868, DcmDspDidInfoRef=DidInfo_AME_Play_BT_Audio_Control_FD64  # Diagnostics Data Import
            Reserved_Byte (DcmDspDidSignal): DcmDspDidDataPos=0, DcmDspDidDataRef=AME_Play_BT_Audio_Control_FD64_Reserved_Byte  # Diagnostics Data Import
          AME_BT_Auto_Pairing_FD63: DcmDspDidIdentifier=64867, DcmDspDidInfoRef=DidInfo_AME_BT_Auto_Pairing_FD63  # Diagnostics Data Import
            BT_MAC_Address (DcmDspDidSignal): DcmDspDidDataPos=8, DcmDspDidDataRef=AME_BT_Auto_Pairing_FD63_BT_MAC_Address  # Diagnostics Data Import
            BT_Chip (DcmDspDidSignal): DcmDspDidDataPos=0, DcmDspDidDataRef=AME_BT_Auto_Pairing_FD63_BT_Chip  # Diagnostics Data Import
          AME_Connectivy_OnOff_Control_FD62: DcmDspDidIdentifier=64866, DcmDspDidInfoRef=DidInfo_AME_Connectivy_OnOff_Control_FD62  # Diagnostics Data Import
            ON_OFF (DcmDspDidSignal): DcmDspDidDataPos=8, DcmDspDidDataRef=AME_Connectivy_OnOff_Control_FD62_ON_OFF  # Diagnostics Data Import
            BT_WiFi (DcmDspDidSignal): DcmDspDidDataPos=0, DcmDspDidDataRef=AME_Connectivy_OnOff_Control_FD62_BT_WiFi  # Diagnostics Data Import
          AME_Write_MAC_Address_FD61: DcmDspDidIdentifier=64865, DcmDspDidInfoRef=DidInfo_AME_Write_MAC_Address_FD61  # Diagnostics Data Import
            7 x DcmDspDidSignal:
              A5: DcmDspDidDataPos=48, DcmDspDidDataRef=AME_Write_MAC_Address_FD61_A5  # Diagnostics Data Import
              A4: DcmDspDidDataPos=40, DcmDspDidDataRef=AME_Write_MAC_Address_FD61_A4  # Diagnostics Data Import
              A3: DcmDspDidDataPos=32, DcmDspDidDataRef=AME_Write_MAC_Address_FD61_A3  # Diagnostics Data Import
              A2: DcmDspDidDataPos=24, DcmDspDidDataRef=AME_Write_MAC_Address_FD61_A2  # Diagnostics Data Import
              A1: DcmDspDidDataPos=16, DcmDspDidDataRef=AME_Write_MAC_Address_FD61_A1  # Diagnostics Data Import
              A0: DcmDspDidDataPos=8, DcmDspDidDataRef=AME_Write_MAC_Address_FD61_A0  # Diagnostics Data Import
              subID: DcmDspDidDataPos=0, DcmDspDidDataRef=AME_Write_MAC_Address_FD61_subID  # Diagnostics Data Import
          AME_Read_MAC_Address_FD60: DcmDspDidIdentifier=64864, DcmDspDidInfoRef=DidInfo_AME_Read_MAC_Address_FD60  # Diagnostics Data Import
            CombinedDataElement (DcmDspDidSignal): DcmDspDidDataPos=0, DcmDspDidDataRef=AME_Read_MAC_Address_FD60_CombinedDataElement  # Diagnostics Data Import
          AME_Set_AM_Frequency_FD52: DcmDspDidIdentifier=64850, DcmDspDidInfoRef=DidInfo_AME_Set_AM_Frequency_FD52  # Diagnostics Data Import
            AM_Frequency (DcmDspDidSignal): DcmDspDidDataPos=0, DcmDspDidDataRef=AME_Set_AM_Frequency_FD52_AM_Frequency  # Diagnostics Data Import
          AME_Set_FM_Frequency_FD50: DcmDspDidIdentifier=64848, DcmDspDidInfoRef=DidInfo_AME_Set_FM_Frequency_FD50  # Diagnostics Data Import
            FM_Frequency (DcmDspDidSignal): DcmDspDidDataPos=0, DcmDspDidDataRef=AME_Set_FM_Frequency_FD50_FM_Frequency  # Diagnostics Data Import
          AME_TrackMedia_Audio_Source_Play_FD41: DcmDspDidIdentifier=64833, DcmDspDidInfoRef=DidInfo_AME_TrackMedia_Audio_Source_Play_FD41  # Diagnostics Data Import
            TrackMedia_AudioSourcePlay (DcmDspDidSignal): DcmDspDidDataPos=0, DcmDspDidDataRef=AME_TrackMedia_Audio_Source_Play_FD41_TrackMedia_AudioSourcePlay  # Diagnostics Data Import
          AME_Switch_Source_FD40: DcmDspDidIdentifier=64832, DcmDspDidInfoRef=DidInfo_AME_Switch_Source_FD40  # Diagnostics Data Import
            SelectAudioBufferChannelOutput (DcmDspDidSignal): DcmDspDidDataPos=0, DcmDspDidDataRef=AME_Switch_Source_FD40_SelectAudioBufferChannelOutput  # Diagnostics Data Import
          AME_Select_Audio_Buffer_Channel_Output_FD39: DcmDspDidIdentifier=64825, DcmDspDidInfoRef=DidInfo_AME_Select_Audio_Buffer_Channel_Output_FD39  # Diagnostics Data Import
            SelectAudioBufferChannelOutput (DcmDspDidSignal): DcmDspDidDataPos=0, DcmDspDidDataRef=AME_Select_Audio_Buffer_Channel_Output_FD39_SelectAudioBufferChannelOutput  # Diagnostics Data Import
          AME_Display_Color_Bar_Control_FD38: DcmDspDidIdentifier=64824, DcmDspDidInfoRef=DidInfo_AME_Display_Color_Bar_Control_FD38  # Diagnostics Data Import
            Display_Color_Bar_Control (DcmDspDidSignal): DcmDspDidDataPos=0, DcmDspDidDataRef=AME_Display_Color_Bar_Control_FD38_Display_Color_Bar_Control  # Diagnostics Data Import
          AME_Route_Video_To_HMI_FD37: DcmDspDidIdentifier=64823, DcmDspDidInfoRef=DidInfo_AME_Route_Video_To_HMI_FD37  # Diagnostics Data Import
            Route_Vedio_To_HMI (DcmDspDidSignal): DcmDspDidDataPos=0, DcmDspDidDataRef=AME_Route_Video_To_HMI_FD37_Route_Vedio_To_HMI  # Diagnostics Data Import
          AME_Route_MIC_To_Internal_Speaker_FD36: DcmDspDidIdentifier=64822, DcmDspDidInfoRef=DidInfo_AME_Route_MIC_To_Internal_Speaker_FD36  # Diagnostics Data Import
            Control (DcmDspDidSignal): DcmDspDidDataPos=8, DcmDspDidDataRef=AME_Route_MIC_To_Internal_Speaker_FD36_Control  # Diagnostics Data Import
            Mic (DcmDspDidSignal): DcmDspDidDataPos=0, DcmDspDidDataRef=AME_Route_MIC_To_Internal_Speaker_FD36_Mic  # Diagnostics Data Import
          Select_Speaker_Test_Tone_FD34: DcmDspDidIdentifier=64820, DcmDspDidInfoRef=DidInfo_Select_Speaker_Test_Tone_FD34  # Diagnostics Data Import
            Select_tone (DcmDspDidSignal): DcmDspDidDataPos=0, DcmDspDidDataRef=Select_Speaker_Test_Tone_FD34_Select_tone  # Diagnostics Data Import
          AME_Select_Speaker_Zone_FD33: DcmDspDidIdentifier=64819, DcmDspDidInfoRef=DidInfo_AME_Select_Speaker_Zone_FD33  # Diagnostics Data Import
            Select_Speaker_Zone (DcmDspDidSignal): DcmDspDidDataPos=0, DcmDspDidDataRef=AME_Select_Speaker_Zone_FD33_Select_Speaker_Zone  # Diagnostics Data Import
          AME_Set_Mute_Control_FD31: DcmDspDidIdentifier=64817, DcmDspDidInfoRef=DidInfo_AME_Set_Mute_Control_FD31  # Diagnostics Data Import
            Set_Mute_Control (DcmDspDidSignal): DcmDspDidDataPos=0, DcmDspDidDataRef=AME_Set_Mute_Control_FD31_Set_Mute_Control  # Diagnostics Data Import
          AME_Set_Volume_FD30: DcmDspDidIdentifier=64816, DcmDspDidInfoRef=DidInfo_AME_Set_Volume_FD30  # Diagnostics Data Import
            Set_Volume (DcmDspDidSignal): DcmDspDidDataPos=0, DcmDspDidDataRef=AME_Set_Volume_FD30_Set_Volume  # Diagnostics Data Import
          AME_Set_HMI_Language_FD21: DcmDspDidIdentifier=64801, DcmDspDidInfoRef=DidInfo_AME_Set_HMI_Language_FD21  # Diagnostics Data Import
            Set_HMI_Language (DcmDspDidSignal): DcmDspDidDataPos=0, DcmDspDidDataRef=AME_Set_HMI_Language_FD21_Set_HMI_Language  # Diagnostics Data Import
          AME_Skip_welcome_confirm_FD20: DcmDspDidIdentifier=64800, DcmDspDidInfoRef=DidInfo_AME_Skip_welcome_confirm_FD20  # Diagnostics Data Import
            Reserved_Byte (DcmDspDidSignal): DcmDspDidDataPos=0, DcmDspDidDataRef=AME_Skip_welcome_confirm_FD20_Reserved_Byte  # Diagnostics Data Import
          AME_Input_Output_OnOff_control_FD18: DcmDspDidIdentifier=64792, DcmDspDidInfoRef=DidInfo_AME_Input_Output_OnOff_control_FD18  # Diagnostics Data Import
            OnOffValue (DcmDspDidSignal): DcmDspDidDataPos=8, DcmDspDidDataRef=AME_Input_Output_OnOff_control_FD18_OnOffValue  # Diagnostics Data Import
            OnOffModule (DcmDspDidSignal): DcmDspDidDataPos=0, DcmDspDidDataRef=AME_Input_Output_OnOff_control_FD18_OnOffModule  # Diagnostics Data Import
          AME_Read_system_voltage_FD14: DcmDspDidIdentifier=64788, DcmDspDidInfoRef=DidInfo_AME_Read_system_voltage_FD14  # Diagnostics Data Import
            CombinedDataElement (DcmDspDidSignal): DcmDspDidDataPos=0, DcmDspDidDataRef=AME_Read_system_voltage_FD14_CombinedDataElement  # Diagnostics Data Import
          AME_Read_system_temperature_FD13: DcmDspDidIdentifier=64787, DcmDspDidInfoRef=DidInfo_AME_Read_system_temperature_FD13  # Diagnostics Data Import
            CombinedDataElement (DcmDspDidSignal): DcmDspDidDataPos=0, DcmDspDidDataRef=AME_Read_system_temperature_FD13_CombinedDataElement  # Diagnostics Data Import
          AME_Set_FAN_speed_FD12: DcmDspDidIdentifier=64786, DcmDspDidInfoRef=DidInfo_AME_Set_FAN_speed_FD12  # Diagnostics Data Import
            FAN_Speed (DcmDspDidSignal): DcmDspDidDataPos=0, DcmDspDidDataRef=AME_Set_FAN_speed_FD12_FAN_Speed  # Diagnostics Data Import
          AME_Read_FAN_speed_FD11: DcmDspDidIdentifier=64785, DcmDspDidInfoRef=DidInfo_AME_Read_FAN_speed_FD11  # Diagnostics Data Import
            FAN_Speed (DcmDspDidSignal): DcmDspDidDataPos=0, DcmDspDidDataRef=AME_Read_FAN_speed_FD11_FAN_Speed  # Diagnostics Data Import
          AME_Read_AME_diagnostic_version_FD08: DcmDspDidIdentifier=64776, DcmDspDidInfoRef=DidInfo_AME_Read_AME_diagnostic_version_FD08  # Diagnostics Data Import
            CombinedDataElement (DcmDspDidSignal): DcmDspDidDataPos=0, DcmDspDidDataRef=AME_Read_AME_diagnostic_version_FD08_CombinedDataElement  # Diagnostics Data Import
          AME_Write_harman_manufactory_part_number_FD07: DcmDspDidIdentifier=64775, DcmDspDidInfoRef=DidInfo_AME_Write_harman_manufactory_part_number_FD07  # Diagnostics Data Import
            Harman_Manufactory_Part_Number (DcmDspDidSignal): DcmDspDidDataPos=0, DcmDspDidDataRef=AME_Write_harman_manufactory_part_number_FD07_Harman_Manufactory_Part_Number  # Diagnostics Data Import
          AME_Read_harman_manufactory_part_number_FD06: DcmDspDidIdentifier=64774, DcmDspDidInfoRef=DidInfo_AME_Read_harman_manufactory_part_number_FD06  # Diagnostics Data Import
            Harman_Manufactory_Part_Number (DcmDspDidSignal): DcmDspDidDataPos=0, DcmDspDidDataRef=AME_Read_harman_manufactory_part_number_FD06_Harman_Manufactory_Part_Number  # Diagnostics Data Import
          INVALID_SHORTNAME_AME_Reset_Factory_Mode_FD05: DcmDspDidIdentifier=64773, DcmDspDidInfoRef=DidInfo_AME_Reset_Factory_Mode_FD05  # Diagnostics Data Import
            Reset_Factory_Mode (DcmDspDidSignal): DcmDspDidDataPos=0, DcmDspDidDataRef=INVALID_SHORTNAME_AME_Reset_Factory_Mode_FD05_Reset_Factory_Mode  # Diagnostics Data Import
          AME_Read_SW_and_HW_Version_FD04: DcmDspDidIdentifier=64772, DcmDspDidInfoRef=DidInfo_AME_Read_SW_and_HW_Version_FD04  # Diagnostics Data Import
            CombinedDataElement (DcmDspDidSignal): DcmDspDidDataPos=0, DcmDspDidDataRef=AME_Read_SW_and_HW_Version_FD04_CombinedDataElement  # Diagnostics Data Import
          AME_Switch_BIOS_Mode_FD02: DcmDspDidIdentifier=64770, DcmDspDidInfoRef=DidInfo_AME_Switch_BIOS_Mode_FD02  # Diagnostics Data Import
            Switch_BIOS (DcmDspDidSignal): DcmDspDidDataPos=0, DcmDspDidDataRef=AME_Switch_BIOS_Mode_FD02_Switch_BIOS  # Diagnostics Data Import
          AME_Power_Control_FD01: DcmDspDidIdentifier=64769, DcmDspDidInfoRef=DidInfo_AME_Power_Control_FD01  # Diagnostics Data Import
            Power_Control (DcmDspDidSignal): DcmDspDidDataPos=0, DcmDspDidDataRef=AME_Power_Control_FD01_Power_Control  # Diagnostics Data Import
          C_matrix_Version_of_the_ECU_product_F1A2: DcmDspDidIdentifier=61858, DcmDspDidInfoRef=DidInfo_C_matrix_Version_of_the_ECU_product_F1A2  # Diagnostics Data Import
            C_matrix_Version (DcmDspDidSignal): DcmDspDidDataPos=0, DcmDspDidDataRef=C_matrix_Version_of_the_ECU_product_F1A2_C_matrix_Version  # Diagnostics Data Import
          VehicleNetworkConfiguration_F1A1: DcmDspDidIdentifier=61857, DcmDspDidInfoRef=DidInfo_VehicleNetworkConfiguration_F1A1  # Diagnostics Data Import
            VehicleNetworkConfiguration (DcmDspDidSignal): DcmDspDidDataPos=0, DcmDspDidDataRef=VehicleNetworkConfiguration_F1A1_VehicleNetworkConfiguration  # Diagnostics Data Import
          System_Supplier_ECU_Software_Version_Number_F195: DcmDspDidIdentifier=61845, DcmDspDidInfoRef=DidInfo_System_Supplier_ECU_Software_Version_Number_F195  # Diagnostics Data Import
            INVALID_SHORTNAME_Software_Version_Number (DcmDspDidSignal): DcmDspDidDataPos=0, DcmDspDidDataRef=System_Supplier_ECU_Software_Version_Number_F195_Software_Version_Number  # Diagnostics Data Import
          System_Supplier_ECU_Hardware_Version_Number_F193: DcmDspDidIdentifier=61843, DcmDspDidInfoRef=DidInfo_System_Supplier_ECU_Hardware_Version_Number_F193  # Diagnostics Data Import
            Hardware_Version_Number (DcmDspDidSignal): DcmDspDidDataPos=0, DcmDspDidDataRef=System_Supplier_ECU_Hardware_Version_Number_F193_Hardware_Version_Number  # Diagnostics Data Import
          Vehicle_Identification_Number_F190: DcmDspDidIdentifier=61840, DcmDspDidInfoRef=DidInfo_Vehicle_Identification_Number_F190  # Diagnostics Data Import
            VIN (DcmDspDidSignal): DcmDspDidDataPos=0, DcmDspDidDataRef=Vehicle_Identification_Number_F190_VIN  # Diagnostics Data Import
          ECU_Serial_Number_F18C: DcmDspDidIdentifier=61836, DcmDspDidInfoRef=DidInfo_ECU_Serial_Number_F18C  # Diagnostics Data Import
            ECU_Serial_Number (DcmDspDidSignal): DcmDspDidDataPos=0, DcmDspDidDataRef=ECU_Serial_Number_F18C_ECU_Serial_Number  # Diagnostics Data Import
          System_Supplier_Identifier_F18A: DcmDspDidIdentifier=61834, DcmDspDidInfoRef=DidInfo_System_Supplier_Identifier_F18A  # Diagnostics Data Import
            System_Supplier_Identifier (DcmDspDidSignal): DcmDspDidDataPos=0, DcmDspDidDataRef=System_Supplier_Identifier_F18A_System_Supplier_Identifier  # Diagnostics Data Import
          Vehicle_Manufacture_Spare_Part_Number_F187: DcmDspDidIdentifier=61831, DcmDspDidInfoRef=DidInfo_Vehicle_Manufacture_Spare_Part_Number_F187  # Diagnostics Data Import
            Vehicle_Manufacture_Spare_Part_Number (DcmDspDidSignal): DcmDspDidDataPos=0, DcmDspDidDataRef=Vehicle_Manufacture_Spare_Part_Number_F187_Vehicle_Manufacture_Spare_Part_Number  # Diagnostics Data Import
          Number_of_installed_speakers_E01C: DcmDspDidIdentifier=57372, DcmDspDidInfoRef=DidInfo_Number_of_installed_speakers_E01C  # Diagnostics Data Import
            Number_of_installed_speakers (DcmDspDidSignal): DcmDspDidDataPos=0, DcmDspDidDataRef=Number_of_installed_speakers_E01C_Number_of_installed_speakers  # Diagnostics Data Import
          Telematics_Module_Status_E01A: DcmDspDidIdentifier=57370, DcmDspDidInfoRef=DidInfo_Telematics_Module_Status_E01A  # Diagnostics Data Import
            Telematics_Module_Status (DcmDspDidSignal): DcmDspDidDataPos=0, DcmDspDidDataRef=Telematics_Module_Status_E01A_Telematics_Module_Status  # Diagnostics Data Import
          Tbox_geographical_coordinates_when_connection_lost_E019: DcmDspDidIdentifier=57369, DcmDspDidInfoRef=DidInfo_Tbox_geographical_coordinates_when_connection_lost_E019  # Diagnostics Data Import
            Tbox_geographical_coordinates_when_connection_lost (DcmDspDidSignal):  # Diagnostics Data Import
              DcmDspDidDataPos = 0
              DcmDspDidDataRef = Tbox_geographical_coordinates_when_connection_lost_E019_Tbox_geographical_coordinates_when_connection_lost
          Tbox_Last_connection_lost_time_stamp_E018: DcmDspDidIdentifier=57368, DcmDspDidInfoRef=DidInfo_Tbox_Last_connection_lost_time_stamp_E018  # Diagnostics Data Import
            Tbox_Last_connection_lost_time_stamp (DcmDspDidSignal): DcmDspDidDataPos=0, DcmDspDidDataRef=Tbox_Last_connection_lost_time_stamp_E018_Tbox_Last_connection_lost_time_stamp  # Diagnostics Data Import
          Tbox_Gateway_sub_mask_E017: DcmDspDidIdentifier=57367, DcmDspDidInfoRef=DidInfo_Tbox_Gateway_sub_mask_E017  # Diagnostics Data Import
            Tbox_Gateway_sub_mask (DcmDspDidSignal): DcmDspDidDataPos=0, DcmDspDidDataRef=Tbox_Gateway_sub_mask_E017_Tbox_Gateway_sub_mask  # Diagnostics Data Import
          Tbox_IP_Address_E016: DcmDspDidIdentifier=57366, DcmDspDidInfoRef=DidInfo_Tbox_IP_Address_E016  # Diagnostics Data Import
            Tbox_IP_Address (DcmDspDidSignal): DcmDspDidDataPos=0, DcmDspDidDataRef=Tbox_IP_Address_E016_Tbox_IP_Address  # Diagnostics Data Import
          Wi_Fi_Module_Hardware_Part_Number_E015: DcmDspDidIdentifier=57365, DcmDspDidInfoRef=DidInfo_Wi_Fi_Module_Hardware_Part_Number_E015  # Diagnostics Data Import
            Wi_Fi_Module_Hardware_Part_Number (DcmDspDidSignal): DcmDspDidDataPos=0, DcmDspDidDataRef=Wi_Fi_Module_Hardware_Part_Number_E015_Wi_Fi_Module_Hardware_Part_Number  # Diagnostics Data Import
          Wi_Fi_Module_Firmware_Version_E014: DcmDspDidIdentifier=57364, DcmDspDidInfoRef=DidInfo_Wi_Fi_Module_Firmware_Version_E014  # Diagnostics Data Import
            Wi_Fi_Module_Firmware_Version (DcmDspDidSignal): DcmDspDidDataPos=0, DcmDspDidDataRef=Wi_Fi_Module_Firmware_Version_E014_Wi_Fi_Module_Firmware_Version  # Diagnostics Data Import
          Wi_Fi_Module_Status_E013: DcmDspDidIdentifier=57363, DcmDspDidInfoRef=DidInfo_Wi_Fi_Module_Status_E013  # Diagnostics Data Import
            Wi_Fi_Module_Status (DcmDspDidSignal): DcmDspDidDataPos=0, DcmDspDidDataRef=Wi_Fi_Module_Status_E013_Wi_Fi_Module_Status  # Diagnostics Data Import
          FM_signal_Strength_E012: DcmDspDidIdentifier=57362, DcmDspDidInfoRef=DidInfo_FM_signal_Strength_E012  # Diagnostics Data Import
            FM_signal_Strength (DcmDspDidSignal): DcmDspDidDataPos=0, DcmDspDidDataRef=FM_signal_Strength_E012_FM_signal_Strength  # Diagnostics Data Import
          AM_signal_Strength_E011: DcmDspDidIdentifier=57361, DcmDspDidInfoRef=DidInfo_AM_signal_Strength_E011  # Diagnostics Data Import
            AM_signal_Strength (DcmDspDidSignal): DcmDspDidDataPos=0, DcmDspDidDataRef=AM_signal_Strength_E011_AM_signal_Strength  # Diagnostics Data Import
          Support_FM_frequency_Max_E010: DcmDspDidIdentifier=57360, DcmDspDidInfoRef=DidInfo_Support_FM_frequency_Max_E010  # Diagnostics Data Import
            Support_FM_frequency_Max (DcmDspDidSignal): DcmDspDidDataPos=0, DcmDspDidDataRef=Support_FM_frequency_Max_E010_Support_FM_frequency_Max  # Diagnostics Data Import
          Support_FM_frequency_Min_E00F: DcmDspDidIdentifier=57359, DcmDspDidInfoRef=DidInfo_Support_FM_frequency_Min_E00F  # Diagnostics Data Import
            Support_FM_frequency_Min (DcmDspDidSignal): DcmDspDidDataPos=0, DcmDspDidDataRef=Support_FM_frequency_Min_E00F_Support_FM_frequency_Min  # Diagnostics Data Import
          Support_AM_frequency_Max_E00E: DcmDspDidIdentifier=57358, DcmDspDidInfoRef=DidInfo_Support_AM_frequency_Max_E00E  # Diagnostics Data Import
            Support_AM_frequency_Max (DcmDspDidSignal): DcmDspDidDataPos=0, DcmDspDidDataRef=Support_AM_frequency_Max_E00E_Support_AM_frequency_Max  # Diagnostics Data Import
          Support_AM_frequency_Min_E00D: DcmDspDidIdentifier=57357, DcmDspDidInfoRef=DidInfo_Support_AM_frequency_Min_E00D  # Diagnostics Data Import
            Support_AM_frequency_Min (DcmDspDidSignal): DcmDspDidDataPos=0, DcmDspDidDataRef=Support_AM_frequency_Min_E00D_Support_AM_frequency_Min  # Diagnostics Data Import
          Currently_connected_USB_Type_E00C: DcmDspDidIdentifier=57356, DcmDspDidInfoRef=DidInfo_Currently_connected_USB_Type_E00C  # Diagnostics Data Import
            Currently_connected_USB_Type (DcmDspDidSignal): DcmDspDidDataPos=0, DcmDspDidDataRef=Currently_connected_USB_Type_E00C_Currently_connected_USB_Type  # Diagnostics Data Import
          Number_of_external_USB_devices_plugged_E00B: DcmDspDidIdentifier=57355, DcmDspDidInfoRef=DidInfo_Number_of_external_USB_devices_plugged_E00B  # Diagnostics Data Import
            Number_of_external_USB_devices_plugged (DcmDspDidSignal): DcmDspDidDataPos=0, DcmDspDidDataRef=Number_of_external_USB_devices_plugged_E00B_Number_of_external_USB_devices_plugged  # Diagnostics Data Import
          Audio_jack_status_E00A: DcmDspDidIdentifier=57354, DcmDspDidInfoRef=DidInfo_Audio_jack_status_E00A  # Diagnostics Data Import
            Audio_jack_status (DcmDspDidSignal): DcmDspDidDataPos=0, DcmDspDidDataRef=Audio_jack_status_E00A_Audio_jack_status  # Diagnostics Data Import
          BT_firmware_version_E009: DcmDspDidIdentifier=57353, DcmDspDidInfoRef=DidInfo_BT_firmware_version_E009  # Diagnostics Data Import
            BT_firmware_version (DcmDspDidSignal): DcmDspDidDataPos=0, DcmDspDidDataRef=BT_firmware_version_E009_BT_firmware_version  # Diagnostics Data Import
          BT_active_profile_list_E008: DcmDspDidIdentifier=57352, DcmDspDidInfoRef=DidInfo_BT_active_profile_list_E008  # Diagnostics Data Import
            BT_active_profile_list (DcmDspDidSignal): DcmDspDidDataPos=0, DcmDspDidDataRef=BT_active_profile_list_E008_BT_active_profile_list  # Diagnostics Data Import
          BT_Power_Class_E007: DcmDspDidIdentifier=57351, DcmDspDidInfoRef=DidInfo_BT_Power_Class_E007  # Diagnostics Data Import
            BT_Power_Class (DcmDspDidSignal): DcmDspDidDataPos=0, DcmDspDidDataRef=BT_Power_Class_E007_BT_Power_Class  # Diagnostics Data Import
          Bluetooth_Status_E006: DcmDspDidIdentifier=57350, DcmDspDidInfoRef=DidInfo_Bluetooth_Status_E006  # Diagnostics Data Import
            Bluetooth_Status (DcmDspDidSignal): DcmDspDidDataPos=0, DcmDspDidDataRef=Bluetooth_Status_E006_Bluetooth_Status  # Diagnostics Data Import
          Bluetooth_Current_Discoverability_modes_E005: DcmDspDidIdentifier=57349, DcmDspDidInfoRef=DidInfo_Bluetooth_Current_Discoverability_modes_E005  # Diagnostics Data Import
            Bluetooth_Current_Discoverability_modes (DcmDspDidSignal): DcmDspDidDataPos=0, DcmDspDidDataRef=Bluetooth_Current_Discoverability_modes_E005_Bluetooth_Current_Discoverability_modes  # Diagnostics Data Import
          Present_GPS_coordinates_shift_data_E003: DcmDspDidIdentifier=57347, DcmDspDidInfoRef=DidInfo_Present_GPS_coordinates_shift_data_E003  # Diagnostics Data Import
            GPS_coordinates (DcmDspDidSignal): DcmDspDidDataPos=0, DcmDspDidDataRef=Present_GPS_coordinates_shift_data_E003_GPS_coordinates  # Diagnostics Data Import
          Screen_resolution_E002: DcmDspDidIdentifier=57346, DcmDspDidInfoRef=DidInfo_Screen_resolution_E002  # Diagnostics Data Import
            Height (DcmDspDidSignal): DcmDspDidDataPos=16, DcmDspDidDataRef=Screen_resolution_E002_Height  # Diagnostics Data Import
            Width (DcmDspDidSignal): DcmDspDidDataPos=0, DcmDspDidDataRef=Screen_resolution_E002_Width  # Diagnostics Data Import
          Number_of_installed_cameras_E001: DcmDspDidIdentifier=57345, DcmDspDidInfoRef=DidInfo_Number_of_installed_cameras_E001  # Diagnostics Data Import
            Number_of_installed_cameras (DcmDspDidSignal): DcmDspDidDataPos=0, DcmDspDidDataRef=Number_of_installed_cameras_E001_Number_of_installed_cameras  # Diagnostics Data Import
          DTC_Occurrence_Timer_D005: DcmDspDidIdentifier=53253, DcmDspDidInfoRef=DidInfo_DTC_Occurrence_Timer_D005  # Diagnostics Data Import
            Occure_Time_Inforamation (DcmDspDidSignal): DcmDspDidDataPos=0, DcmDspDidDataRef=DTC_Occurrence_Timer_D005_Occure_Time_Inforamation  # Diagnostics Data Import
          Odometer_D004: DcmDspDidIdentifier=53252, DcmDspDidInfoRef=DidInfo_Odometer_D004  # Diagnostics Data Import
            Odometer (DcmDspDidSignal): DcmDspDidDataPos=0, DcmDspDidDataRef=Odometer_D004_Odometer  # Diagnostics Data Import
          Operating_Voltage_Value_D003: DcmDspDidIdentifier=53251, DcmDspDidInfoRef=DidInfo_Operating_Voltage_Value_D003  # Diagnostics Data Import
            Operating_Voltage_Value (DcmDspDidSignal): DcmDspDidDataPos=0, DcmDspDidDataRef=Operating_Voltage_Value_D003_Operating_Voltage_Value  # Diagnostics Data Import
          Engine_Speed_D002: DcmDspDidIdentifier=53250, DcmDspDidInfoRef=DidInfo_Engine_Speed_D002  # Diagnostics Data Import
            Engine_Speed (DcmDspDidSignal): DcmDspDidDataPos=0, DcmDspDidDataRef=Engine_Speed_D002_Engine_Speed  # Diagnostics Data Import
          Vehicle_Speed_D001: DcmDspDidIdentifier=53249, DcmDspDidInfoRef=DidInfo_Vehicle_Speed_D001  # Diagnostics Data Import
            Vehicle_Speed (DcmDspDidSignal): DcmDspDidDataPos=0, DcmDspDidDataRef=Vehicle_Speed_D001_Vehicle_Speed  # Diagnostics Data Import
        DataInfo_Switch_HU_boot_mode_FDF1_Boot_Mode (DcmDspDataInfo): DcmDspDataFixedLength=true  # Diagnostics Data Import
        Switch_HU_boot_mode_FDF1_Boot_Mode (DcmDspData): DcmDspDataSize=8, DcmDspDataType=UINT8, DcmDspDataInfoRef=DataInfo_Switch_HU_boot_mode_FDF1_Boot_Mode  # Diagnostics Data Import
        DataInfo_Set_debug_on_off_control_FDF0_CombinedDataElement (DcmDspDataInfo): DcmDspDataFixedLength=false  # Diagnostics Data Import
        Set_debug_on_off_control_FDF0_CombinedDataElement (DcmDspData): DcmDspDataSize=16, DcmDspDataType=UINT8_N, DcmDspDataInfoRef=DataInfo_Set_debug_on_off_control_FDF0_CombinedDataElement  # Diagnostics Data Import
        DataInfo_AME_Set_External_Output_Status_FD93_Status (DcmDspDataInfo): DcmDspDataFixedLength=true  # Diagnostics Data Import
        AME_Set_External_Output_Status_FD93_Status (DcmDspData): DcmDspDataSize=8, DcmDspDataType=UINT8, DcmDspDataInfoRef=DataInfo_AME_Set_External_Output_Status_FD93_Status  # Diagnostics Data Import
        DataInfo_AME_Set_External_Output_Status_FD93_HW (DcmDspDataInfo): DcmDspDataFixedLength=true  # Diagnostics Data Import
        AME_Set_External_Output_Status_FD93_HW (DcmDspData): DcmDspDataSize=8, DcmDspDataType=UINT8, DcmDspDataInfoRef=DataInfo_AME_Set_External_Output_Status_FD93_HW  # Diagnostics Data Import
        DataInfo_AME_Read_Detection_Input_Info_FD92_CombinedDataElement (DcmDspDataInfo): DcmDspDataFixedLength=true  # Diagnostics Data Import
        AME_Read_Detection_Input_Info_FD92_CombinedDataElement (DcmDspData): DcmDspDataSize=16, DcmDspDataType=UINT8_N, DcmDspDataInfoRef=DataInfo_AME_Read_Detection_Input_Info_FD92_CombinedDataElement  # Diagnostics Data Import
        DataInfo_AME_Read_Head_Unit_Connector_Status_FD90_CombinedDataElement (DcmDspDataInfo): DcmDspDataFixedLength=true  # Diagnostics Data Import
        AME_Read_Head_Unit_Connector_Status_FD90_CombinedDataElement (DcmDspData): DcmDspDataSize=16, DcmDspDataType=UINT8_N, DcmDspDataInfoRef=DataInfo_AME_Read_Head_Unit_Connector_Status_FD90_CombinedDataElement  # Diagnostics Data Import
        DataInfo_AME_TBOX_communication_status_check_FD80_TBOX_status (DcmDspDataInfo): DcmDspDataFixedLength=true  # Diagnostics Data Import
        AME_TBOX_communication_status_check_FD80_TBOX_status (DcmDspData): DcmDspDataSize=8, DcmDspDataType=UINT8, DcmDspDataInfoRef=DataInfo_AME_TBOX_communication_status_check_FD80_TBOX_status  # Diagnostics Data Import
        DataInfo_AME_ReadGPSSNR_FD73_GPSSNR (DcmDspDataInfo): DcmDspDataFixedLength=true  # Diagnostics Data Import
        AME_ReadGPSSNR_FD73_GPSSNR (DcmDspData): DcmDspDataSize=8, DcmDspDataType=UINT8, DcmDspDataInfoRef=DataInfo_AME_ReadGPSSNR_FD73_GPSSNR  # Diagnostics Data Import
        DataInfo_AME_Read_GPS_Info_FD72_Number_of_used_satellite (DcmDspDataInfo): DcmDspDataFixedLength=true  # Diagnostics Data Import
        AME_Read_GPS_Info_FD72_Number_of_used_satellite (DcmDspData): DcmDspDataSize=8, DcmDspDataType=UINT8, DcmDspDataInfoRef=DataInfo_AME_Read_GPS_Info_FD72_Number_of_used_satellite  # Diagnostics Data Import
        DataInfo_AME_Read_GPS_Info_FD72_Number_of_fix (DcmDspDataInfo): DcmDspDataFixedLength=true  # Diagnostics Data Import
        AME_Read_GPS_Info_FD72_Number_of_fix (DcmDspData): DcmDspDataSize=8, DcmDspDataType=UINT8, DcmDspDataInfoRef=DataInfo_AME_Read_GPS_Info_FD72_Number_of_fix  # Diagnostics Data Import
        DataInfo_AME_Read_GPS_Info_FD72_Number_of_visible_staellite (DcmDspDataInfo): DcmDspDataFixedLength=true  # Diagnostics Data Import
        AME_Read_GPS_Info_FD72_Number_of_visible_staellite (DcmDspData): DcmDspDataSize=8, DcmDspDataType=UINT8, DcmDspDataInfoRef=DataInfo_AME_Read_GPS_Info_FD72_Number_of_visible_staellite  # Diagnostics Data Import
        DataInfo_AME_Read_GYRO_Status_FD71_GYRO_Status (DcmDspDataInfo): DcmDspDataFixedLength=true  # Diagnostics Data Import
        AME_Read_GYRO_Status_FD71_GYRO_Status (DcmDspData): DcmDspDataSize=8, DcmDspDataType=UINT8, DcmDspDataInfoRef=DataInfo_AME_Read_GYRO_Status_FD71_GYRO_Status  # Diagnostics Data Import
        DataInfo_AME_Enter_NAV_Demo_Mode_FD70_Demo_Mode (DcmDspDataInfo): DcmDspDataFixedLength=true  # Diagnostics Data Import
        AME_Enter_NAV_Demo_Mode_FD70_Demo_Mode (DcmDspData): DcmDspDataSize=8, DcmDspDataType=UINT8, DcmDspDataInfoRef=DataInfo_AME_Enter_NAV_Demo_Mode_FD70_Demo_Mode  # Diagnostics Data Import
        DataInfo_AME_Ethernet_IP_Ping_Function_FD6E_IPAddress_Byte4 (DcmDspDataInfo): DcmDspDataFixedLength=true  # Diagnostics Data Import
        AME_Ethernet_IP_Ping_Function_FD6E_IPAddress_Byte4 (DcmDspData): DcmDspDataSize=8, DcmDspDataType=UINT8, DcmDspDataInfoRef=DataInfo_AME_Ethernet_IP_Ping_Function_FD6E_IPAddress_Byte4  # Diagnostics Data Import
        DataInfo_AME_Ethernet_IP_Ping_Function_FD6E_IPAddress_Byte3 (DcmDspDataInfo): DcmDspDataFixedLength=true  # Diagnostics Data Import
        AME_Ethernet_IP_Ping_Function_FD6E_IPAddress_Byte3 (DcmDspData): DcmDspDataSize=8, DcmDspDataType=UINT8, DcmDspDataInfoRef=DataInfo_AME_Ethernet_IP_Ping_Function_FD6E_IPAddress_Byte3  # Diagnostics Data Import
        DataInfo_AME_Ethernet_IP_Ping_Function_FD6E_IPAddress_Byte2 (DcmDspDataInfo): DcmDspDataFixedLength=true  # Diagnostics Data Import
        AME_Ethernet_IP_Ping_Function_FD6E_IPAddress_Byte2 (DcmDspData): DcmDspDataSize=8, DcmDspDataType=UINT8, DcmDspDataInfoRef=DataInfo_AME_Ethernet_IP_Ping_Function_FD6E_IPAddress_Byte2  # Diagnostics Data Import
        DataInfo_AME_Ethernet_IP_Ping_Function_FD6E_IPAddress_Byte1 (DcmDspDataInfo): DcmDspDataFixedLength=true  # Diagnostics Data Import
        AME_Ethernet_IP_Ping_Function_FD6E_IPAddress_Byte1 (DcmDspData): DcmDspDataSize=8, DcmDspDataType=UINT8, DcmDspDataInfoRef=DataInfo_AME_Ethernet_IP_Ping_Function_FD6E_IPAddress_Byte1  # Diagnostics Data Import
        DataInfo_AME_Ethernet_IP_Ping_Function_FD6E_Ethernet_Channel (DcmDspDataInfo): DcmDspDataFixedLength=true  # Diagnostics Data Import
        AME_Ethernet_IP_Ping_Function_FD6E_Ethernet_Channel (DcmDspData): DcmDspDataSize=8, DcmDspDataType=UINT8, DcmDspDataInfoRef=DataInfo_AME_Ethernet_IP_Ping_Function_FD6E_Ethernet_Channel  # Diagnostics Data Import
        DataInfo_AME_Mirror_Link_connection_FD6D_Mirror_Link_connection (DcmDspDataInfo): DcmDspDataFixedLength=true  # Diagnostics Data Import
        AME_Mirror_Link_connection_FD6D_Mirror_Link_connection (DcmDspData): DcmDspDataSize=8, DcmDspDataType=UINT8, DcmDspDataInfoRef=DataInfo_AME_Mirror_Link_connection_FD6D_Mirror_Link_connection  # Diagnostics Data Import
        DataInfo_AME_BT_Handfree_Loopback_Test_FD6B_Reserved_Byte (DcmDspDataInfo): DcmDspDataFixedLength=true  # Diagnostics Data Import
        AME_BT_Handfree_Loopback_Test_FD6B_Reserved_Byte (DcmDspData): DcmDspDataSize=8, DcmDspDataType=UINT8, DcmDspDataInfoRef=DataInfo_AME_BT_Handfree_Loopback_Test_FD6B_Reserved_Byte  # Diagnostics Data Import
        DataInfo_AME_Set_WIFI_Mode_FD67_WiFi_Mode (DcmDspDataInfo): DcmDspDataFixedLength=true  # Diagnostics Data Import
        AME_Set_WIFI_Mode_FD67_WiFi_Mode (DcmDspData): DcmDspDataSize=8, DcmDspDataType=UINT8, DcmDspDataInfoRef=DataInfo_AME_Set_WIFI_Mode_FD67_WiFi_Mode  # Diagnostics Data Import
        DataInfo_AME_Play_BT_Audio_Control_FD64_Reserved_Byte (DcmDspDataInfo): DcmDspDataFixedLength=true  # Diagnostics Data Import
        AME_Play_BT_Audio_Control_FD64_Reserved_Byte (DcmDspData): DcmDspDataSize=8, DcmDspDataType=UINT8, DcmDspDataInfoRef=DataInfo_AME_Play_BT_Audio_Control_FD64_Reserved_Byte  # Diagnostics Data Import
        DataInfo_AME_BT_Auto_Pairing_FD63_BT_MAC_Address (DcmDspDataInfo): DcmDspDataFixedLength=true  # Diagnostics Data Import
        AME_BT_Auto_Pairing_FD63_BT_MAC_Address (DcmDspData): DcmDspDataSize=48, DcmDspDataType=UINT8_N, DcmDspDataInfoRef=DataInfo_AME_BT_Auto_Pairing_FD63_BT_MAC_Address  # Diagnostics Data Import
        DataInfo_AME_BT_Auto_Pairing_FD63_BT_Chip (DcmDspDataInfo): DcmDspDataFixedLength=true  # Diagnostics Data Import
        AME_BT_Auto_Pairing_FD63_BT_Chip (DcmDspData): DcmDspDataSize=8, DcmDspDataType=UINT8, DcmDspDataInfoRef=DataInfo_AME_BT_Auto_Pairing_FD63_BT_Chip  # Diagnostics Data Import
        DataInfo_AME_Connectivy_OnOff_Control_FD62_ON_OFF (DcmDspDataInfo): DcmDspDataFixedLength=true  # Diagnostics Data Import
        AME_Connectivy_OnOff_Control_FD62_ON_OFF (DcmDspData): DcmDspDataSize=8, DcmDspDataType=UINT8, DcmDspDataInfoRef=DataInfo_AME_Connectivy_OnOff_Control_FD62_ON_OFF  # Diagnostics Data Import
        DataInfo_AME_Connectivy_OnOff_Control_FD62_BT_WiFi (DcmDspDataInfo): DcmDspDataFixedLength=true  # Diagnostics Data Import
        AME_Connectivy_OnOff_Control_FD62_BT_WiFi (DcmDspData): DcmDspDataSize=8, DcmDspDataType=UINT8, DcmDspDataInfoRef=DataInfo_AME_Connectivy_OnOff_Control_FD62_BT_WiFi  # Diagnostics Data Import
        DataInfo_AME_Write_MAC_Address_FD61_A5 (DcmDspDataInfo): DcmDspDataFixedLength=true  # Diagnostics Data Import
        AME_Write_MAC_Address_FD61_A5 (DcmDspData): DcmDspDataSize=8, DcmDspDataType=UINT8, DcmDspDataInfoRef=DataInfo_AME_Write_MAC_Address_FD61_A5  # Diagnostics Data Import
        DataInfo_AME_Write_MAC_Address_FD61_A4 (DcmDspDataInfo): DcmDspDataFixedLength=true  # Diagnostics Data Import
        AME_Write_MAC_Address_FD61_A4 (DcmDspData): DcmDspDataSize=8, DcmDspDataType=UINT8, DcmDspDataInfoRef=DataInfo_AME_Write_MAC_Address_FD61_A4  # Diagnostics Data Import
        DataInfo_AME_Write_MAC_Address_FD61_A3 (DcmDspDataInfo): DcmDspDataFixedLength=true  # Diagnostics Data Import
        AME_Write_MAC_Address_FD61_A3 (DcmDspData): DcmDspDataSize=8, DcmDspDataType=UINT8, DcmDspDataInfoRef=DataInfo_AME_Write_MAC_Address_FD61_A3  # Diagnostics Data Import
        DataInfo_AME_Write_MAC_Address_FD61_A2 (DcmDspDataInfo): DcmDspDataFixedLength=true  # Diagnostics Data Import
        AME_Write_MAC_Address_FD61_A2 (DcmDspData): DcmDspDataSize=8, DcmDspDataType=UINT8, DcmDspDataInfoRef=DataInfo_AME_Write_MAC_Address_FD61_A2  # Diagnostics Data Import
        DataInfo_AME_Write_MAC_Address_FD61_A1 (DcmDspDataInfo): DcmDspDataFixedLength=true  # Diagnostics Data Import
        AME_Write_MAC_Address_FD61_A1 (DcmDspData): DcmDspDataSize=8, DcmDspDataType=UINT8, DcmDspDataInfoRef=DataInfo_AME_Write_MAC_Address_FD61_A1  # Diagnostics Data Import
        DataInfo_AME_Write_MAC_Address_FD61_A0 (DcmDspDataInfo): DcmDspDataFixedLength=true  # Diagnostics Data Import
        AME_Write_MAC_Address_FD61_A0 (DcmDspData): DcmDspDataSize=8, DcmDspDataType=UINT8, DcmDspDataInfoRef=DataInfo_AME_Write_MAC_Address_FD61_A0  # Diagnostics Data Import
        DataInfo_AME_Write_MAC_Address_FD61_subID (DcmDspDataInfo): DcmDspDataFixedLength=true  # Diagnostics Data Import
        AME_Write_MAC_Address_FD61_subID (DcmDspData): DcmDspDataSize=8, DcmDspDataType=UINT8, DcmDspDataInfoRef=DataInfo_AME_Write_MAC_Address_FD61_subID  # Diagnostics Data Import
        DataInfo_AME_Read_MAC_Address_FD60_CombinedDataElement (DcmDspDataInfo): DcmDspDataFixedLength=false  # Diagnostics Data Import
        AME_Read_MAC_Address_FD60_CombinedDataElement (DcmDspData): DcmDspDataSize=48, DcmDspDataType=UINT8_N, DcmDspDataInfoRef=DataInfo_AME_Read_MAC_Address_FD60_CombinedDataElement  # Diagnostics Data Import
        DataInfo_AME_Set_AM_Frequency_FD52_AM_Frequency (DcmDspDataInfo): DcmDspDataFixedLength=true  # Diagnostics Data Import
        AME_Set_AM_Frequency_FD52_AM_Frequency (DcmDspData): DcmDspDataSize=16, DcmDspDataType=UINT16, DcmDspDataInfoRef=DataInfo_AME_Set_AM_Frequency_FD52_AM_Frequency  # Diagnostics Data Import
        DataInfo_AME_Set_FM_Frequency_FD50_FM_Frequency (DcmDspDataInfo): DcmDspDataFixedLength=true  # Diagnostics Data Import
        AME_Set_FM_Frequency_FD50_FM_Frequency (DcmDspData): DcmDspDataSize=24, DcmDspDataType=UINT8_N, DcmDspDataInfoRef=DataInfo_AME_Set_FM_Frequency_FD50_FM_Frequency  # Diagnostics Data Import
        DataInfo_AME_TrackMedia_Audio_Source_Play_FD41_TrackMedia_AudioSourcePlay (DcmDspDataInfo): DcmDspDataFixedLength=true  # Diagnostics Data Import
        AME_TrackMedia_Audio_Source_Play_FD41_TrackMedia_AudioSourcePlay (DcmDspData): DcmDspDataSize=8, DcmDspDataType=UINT8, DcmDspDataInfoRef=DataInfo_AME_TrackMedia_Audio_Source_Play_FD41_TrackMedia_AudioSourcePlay  # Diagnostics Data Import
        DataInfo_AME_Switch_Source_FD40_SelectAudioBufferChannelOutput (DcmDspDataInfo): DcmDspDataFixedLength=true  # Diagnostics Data Import
        AME_Switch_Source_FD40_SelectAudioBufferChannelOutput (DcmDspData): DcmDspDataSize=8, DcmDspDataType=UINT8, DcmDspDataInfoRef=DataInfo_AME_Switch_Source_FD40_SelectAudioBufferChannelOutput  # Diagnostics Data Import
        DataInfo_AME_Select_Audio_Buffer_Channel_Output_FD39_SelectAudioBufferChannelOutput (DcmDspDataInfo): DcmDspDataFixedLength=true  # Diagnostics Data Import
        AME_Select_Audio_Buffer_Channel_Output_FD39_SelectAudioBufferChannelOutput (DcmDspData): DcmDspDataSize=8, DcmDspDataType=UINT8, DcmDspDataInfoRef=DataInfo_AME_Select_Audio_Buffer_Channel_Output_FD39_SelectAudioBufferChannelOutput  # Diagnostics Data Import
        DataInfo_AME_Display_Color_Bar_Control_FD38_Display_Color_Bar_Control (DcmDspDataInfo): DcmDspDataFixedLength=true  # Diagnostics Data Import
        AME_Display_Color_Bar_Control_FD38_Display_Color_Bar_Control (DcmDspData): DcmDspDataSize=8, DcmDspDataType=UINT8, DcmDspDataInfoRef=DataInfo_AME_Display_Color_Bar_Control_FD38_Display_Color_Bar_Control  # Diagnostics Data Import
        DataInfo_AME_Route_Video_To_HMI_FD37_Route_Vedio_To_HMI (DcmDspDataInfo): DcmDspDataFixedLength=true  # Diagnostics Data Import
        AME_Route_Video_To_HMI_FD37_Route_Vedio_To_HMI (DcmDspData): DcmDspDataSize=8, DcmDspDataType=UINT8, DcmDspDataInfoRef=DataInfo_AME_Route_Video_To_HMI_FD37_Route_Vedio_To_HMI  # Diagnostics Data Import
        DataInfo_AME_Route_MIC_To_Internal_Speaker_FD36_Control (DcmDspDataInfo): DcmDspDataFixedLength=true  # Diagnostics Data Import
        AME_Route_MIC_To_Internal_Speaker_FD36_Control (DcmDspData): DcmDspDataSize=8, DcmDspDataType=UINT8, DcmDspDataInfoRef=DataInfo_AME_Route_MIC_To_Internal_Speaker_FD36_Control  # Diagnostics Data Import
        DataInfo_AME_Route_MIC_To_Internal_Speaker_FD36_Mic (DcmDspDataInfo): DcmDspDataFixedLength=true  # Diagnostics Data Import
        AME_Route_MIC_To_Internal_Speaker_FD36_Mic (DcmDspData): DcmDspDataSize=8, DcmDspDataType=UINT8, DcmDspDataInfoRef=DataInfo_AME_Route_MIC_To_Internal_Speaker_FD36_Mic  # Diagnostics Data Import
        DataInfo_Select_Speaker_Test_Tone_FD34_Select_tone (DcmDspDataInfo): DcmDspDataFixedLength=true  # Diagnostics Data Import
        Select_Speaker_Test_Tone_FD34_Select_tone (DcmDspData): DcmDspDataSize=8, DcmDspDataType=UINT8, DcmDspDataInfoRef=DataInfo_Select_Speaker_Test_Tone_FD34_Select_tone  # Diagnostics Data Import
        DataInfo_AME_Select_Speaker_Zone_FD33_Select_Speaker_Zone (DcmDspDataInfo): DcmDspDataFixedLength=true  # Diagnostics Data Import
        AME_Select_Speaker_Zone_FD33_Select_Speaker_Zone (DcmDspData): DcmDspDataSize=8, DcmDspDataType=UINT8, DcmDspDataInfoRef=DataInfo_AME_Select_Speaker_Zone_FD33_Select_Speaker_Zone  # Diagnostics Data Import
        DataInfo_AME_Set_Mute_Control_FD31_Set_Mute_Control (DcmDspDataInfo): DcmDspDataFixedLength=true  # Diagnostics Data Import
        AME_Set_Mute_Control_FD31_Set_Mute_Control (DcmDspData): DcmDspDataSize=8, DcmDspDataType=UINT8, DcmDspDataInfoRef=DataInfo_AME_Set_Mute_Control_FD31_Set_Mute_Control  # Diagnostics Data Import
        DataInfo_AME_Set_Volume_FD30_Set_Volume (DcmDspDataInfo): DcmDspDataFixedLength=true  # Diagnostics Data Import
        AME_Set_Volume_FD30_Set_Volume (DcmDspData): DcmDspDataSize=8, DcmDspDataType=UINT8, DcmDspDataInfoRef=DataInfo_AME_Set_Volume_FD30_Set_Volume  # Diagnostics Data Import
        DataInfo_AME_Set_HMI_Language_FD21_Set_HMI_Language (DcmDspDataInfo): DcmDspDataFixedLength=true  # Diagnostics Data Import
        AME_Set_HMI_Language_FD21_Set_HMI_Language (DcmDspData): DcmDspDataSize=8, DcmDspDataType=UINT8, DcmDspDataInfoRef=DataInfo_AME_Set_HMI_Language_FD21_Set_HMI_Language  # Diagnostics Data Import
        DataInfo_AME_Skip_welcome_confirm_FD20_Reserved_Byte (DcmDspDataInfo): DcmDspDataFixedLength=true  # Diagnostics Data Import
        AME_Skip_welcome_confirm_FD20_Reserved_Byte (DcmDspData): DcmDspDataSize=8, DcmDspDataType=UINT8, DcmDspDataInfoRef=DataInfo_AME_Skip_welcome_confirm_FD20_Reserved_Byte  # Diagnostics Data Import
        DataInfo_AME_Input_Output_OnOff_control_FD18_OnOffValue (DcmDspDataInfo): DcmDspDataFixedLength=true  # Diagnostics Data Import
        AME_Input_Output_OnOff_control_FD18_OnOffValue (DcmDspData): DcmDspDataSize=8, DcmDspDataType=UINT8, DcmDspDataInfoRef=DataInfo_AME_Input_Output_OnOff_control_FD18_OnOffValue  # Diagnostics Data Import
        DataInfo_AME_Input_Output_OnOff_control_FD18_OnOffModule (DcmDspDataInfo): DcmDspDataFixedLength=true  # Diagnostics Data Import
        AME_Input_Output_OnOff_control_FD18_OnOffModule (DcmDspData): DcmDspDataSize=8, DcmDspDataType=UINT8, DcmDspDataInfoRef=DataInfo_AME_Input_Output_OnOff_control_FD18_OnOffModule  # Diagnostics Data Import
        DataInfo_AME_Read_system_voltage_FD14_CombinedDataElement (DcmDspDataInfo): DcmDspDataFixedLength=true  # Diagnostics Data Import
        AME_Read_system_voltage_FD14_CombinedDataElement (DcmDspData): DcmDspDataSize=16, DcmDspDataType=UINT8_N, DcmDspDataInfoRef=DataInfo_AME_Read_system_voltage_FD14_CombinedDataElement  # Diagnostics Data Import
        DataInfo_AME_Read_system_temperature_FD13_CombinedDataElement (DcmDspDataInfo): DcmDspDataFixedLength=true  # Diagnostics Data Import
        AME_Read_system_temperature_FD13_CombinedDataElement (DcmDspData): DcmDspDataSize=16, DcmDspDataType=UINT8_N, DcmDspDataInfoRef=DataInfo_AME_Read_system_temperature_FD13_CombinedDataElement  # Diagnostics Data Import
        DataInfo_AME_Set_FAN_speed_FD12_FAN_Speed (DcmDspDataInfo): DcmDspDataFixedLength=true  # Diagnostics Data Import
        AME_Set_FAN_speed_FD12_FAN_Speed (DcmDspData): DcmDspDataSize=8, DcmDspDataType=UINT8, DcmDspDataInfoRef=DataInfo_AME_Set_FAN_speed_FD12_FAN_Speed  # Diagnostics Data Import
        DataInfo_AME_Read_FAN_speed_FD11_FAN_Speed (DcmDspDataInfo): DcmDspDataFixedLength=true  # Diagnostics Data Import
        AME_Read_FAN_speed_FD11_FAN_Speed (DcmDspData): DcmDspDataSize=8, DcmDspDataType=UINT8, DcmDspDataInfoRef=DataInfo_AME_Read_FAN_speed_FD11_FAN_Speed  # Diagnostics Data Import
        DataInfo_AME_Read_AME_diagnostic_version_FD08_CombinedDataElement (DcmDspDataInfo): DcmDspDataFixedLength=false  # Diagnostics Data Import
        AME_Read_AME_diagnostic_version_FD08_CombinedDataElement (DcmDspData): DcmDspDataSize=136, DcmDspDataType=UINT8_N, DcmDspDataInfoRef=DataInfo_AME_Read_AME_diagnostic_version_FD08_CombinedDataElement  # Diagnostics Data Import
        DataInfo_AME_Write_harman_manufactory_part_number_FD07_Harman_Manufactory_Part_Number (DcmDspDataInfo): DcmDspDataFixedLength=true  # Diagnostics Data Import
        AME_Write_harman_manufactory_part_number_FD07_Harman_Manufactory_Part_Number (DcmDspData):  # Diagnostics Data Import
          DcmDspDataSize = 224
          DcmDspDataType = UINT8_N
          DcmDspDataInfoRef = DataInfo_AME_Write_harman_manufactory_part_number_FD07_Harman_Manufactory_Part_Number
        DataInfo_AME_Read_harman_manufactory_part_number_FD06_Harman_Manufactory_Part_Number (DcmDspDataInfo): DcmDspDataFixedLength=true  # Diagnostics Data Import
        AME_Read_harman_manufactory_part_number_FD06_Harman_Manufactory_Part_Number (DcmDspData):  # Diagnostics Data Import
          DcmDspDataSize = 224
          DcmDspDataType = UINT8_N
          DcmDspDataInfoRef = DataInfo_AME_Read_harman_manufactory_part_number_FD06_Harman_Manufactory_Part_Number
        DataInfo_AME_Reset_Factory_Mode_FD05_Reset_Factory_Mode (DcmDspDataInfo): DcmDspDataFixedLength=true  # Diagnostics Data Import
        INVALID_SHORTNAME_AME_Reset_Factory_Mode_FD05_Reset_Factory_Mode (DcmDspData): DcmDspDataSize=8, DcmDspDataType=UINT8, DcmDspDataInfoRef=DataInfo_AME_Reset_Factory_Mode_FD05_Reset_Factory_Mode  # Diagnostics Data Import
        DataInfo_AME_Read_SW_and_HW_Version_FD04_CombinedDataElement (DcmDspDataInfo): DcmDspDataFixedLength=false  # Diagnostics Data Import
        AME_Read_SW_and_HW_Version_FD04_CombinedDataElement (DcmDspData): DcmDspDataSize=400, DcmDspDataType=UINT8_N, DcmDspDataInfoRef=DataInfo_AME_Read_SW_and_HW_Version_FD04_CombinedDataElement  # Diagnostics Data Import
        DataInfo_AME_Switch_BIOS_Mode_FD02_Switch_BIOS (DcmDspDataInfo): DcmDspDataFixedLength=true  # Diagnostics Data Import
        AME_Switch_BIOS_Mode_FD02_Switch_BIOS (DcmDspData): DcmDspDataSize=8, DcmDspDataType=UINT8, DcmDspDataInfoRef=DataInfo_AME_Switch_BIOS_Mode_FD02_Switch_BIOS  # Diagnostics Data Import
        DataInfo_AME_Power_Control_FD01_Power_Control (DcmDspDataInfo): DcmDspDataFixedLength=true  # Diagnostics Data Import
        AME_Power_Control_FD01_Power_Control (DcmDspData): DcmDspDataSize=8, DcmDspDataType=UINT8, DcmDspDataInfoRef=DataInfo_AME_Power_Control_FD01_Power_Control  # Diagnostics Data Import
        DataInfo_C_matrix_Version_of_the_ECU_product_F1A2_C_matrix_Version (DcmDspDataInfo): DcmDspDataFixedLength=true  # Diagnostics Data Import
        C_matrix_Version_of_the_ECU_product_F1A2_C_matrix_Version (DcmDspData): DcmDspDataSize=80, DcmDspDataType=UINT8_N, DcmDspDataInfoRef=DataInfo_C_matrix_Version_of_the_ECU_product_F1A2_C_matrix_Version  # Diagnostics Data Import
        DataInfo_VehicleNetworkConfiguration_F1A1_VehicleNetworkConfiguration (DcmDspDataInfo): DcmDspDataFixedLength=true  # Diagnostics Data Import
        VehicleNetworkConfiguration_F1A1_VehicleNetworkConfiguration (DcmDspData): DcmDspDataSize=136, DcmDspDataType=UINT8_N, DcmDspDataInfoRef=DataInfo_VehicleNetworkConfiguration_F1A1_VehicleNetworkConfiguration  # Diagnostics Data Import
        DataInfo_System_Supplier_ECU_Software_Version_Number_F195_Software_Version_Number (DcmDspDataInfo): DcmDspDataFixedLength=true  # Diagnostics Data Import
        System_Supplier_ECU_Software_Version_Number_F195_Software_Version_Number (DcmDspData): DcmDspDataSize=128, DcmDspDataType=UINT8_N, DcmDspDataInfoRef=DataInfo_System_Supplier_ECU_Software_Version_Number_F195_Software_Version_Number  # Diagnostics Data Import
        DataInfo_System_Supplier_ECU_Hardware_Version_Number_F193_Hardware_Version_Number (DcmDspDataInfo): DcmDspDataFixedLength=true  # Diagnostics Data Import
        System_Supplier_ECU_Hardware_Version_Number_F193_Hardware_Version_Number (DcmDspData): DcmDspDataSize=128, DcmDspDataType=UINT8_N, DcmDspDataInfoRef=DataInfo_System_Supplier_ECU_Hardware_Version_Number_F193_Hardware_Version_Number  # Diagnostics Data Import
        DataInfo_Vehicle_Identification_Number_F190_VIN (DcmDspDataInfo): DcmDspDataFixedLength=true  # Diagnostics Data Import
        Vehicle_Identification_Number_F190_VIN (DcmDspData): DcmDspDataSize=136, DcmDspDataType=UINT8_N, DcmDspDataInfoRef=DataInfo_Vehicle_Identification_Number_F190_VIN  # Diagnostics Data Import
        DataInfo_ECU_Serial_Number_F18C_ECU_Serial_Number (DcmDspDataInfo): DcmDspDataFixedLength=true  # Diagnostics Data Import
        ECU_Serial_Number_F18C_ECU_Serial_Number (DcmDspData): DcmDspDataSize=128, DcmDspDataType=UINT8_N, DcmDspDataInfoRef=DataInfo_ECU_Serial_Number_F18C_ECU_Serial_Number  # Diagnostics Data Import
        DataInfo_System_Supplier_Identifier_F18A_System_Supplier_Identifier (DcmDspDataInfo): DcmDspDataFixedLength=true  # Diagnostics Data Import
        System_Supplier_Identifier_F18A_System_Supplier_Identifier (DcmDspData): DcmDspDataSize=80, DcmDspDataType=UINT8_N, DcmDspDataInfoRef=DataInfo_System_Supplier_Identifier_F18A_System_Supplier_Identifier  # Diagnostics Data Import
        DataInfo_Vehicle_Manufacture_Spare_Part_Number_F187_Vehicle_Manufacture_Spare_Part_Number (DcmDspDataInfo): DcmDspDataFixedLength=true  # Diagnostics Data Import
        Vehicle_Manufacture_Spare_Part_Number_F187_Vehicle_Manufacture_Spare_Part_Number (DcmDspData):  # Diagnostics Data Import
          DcmDspDataSize = 120
          DcmDspDataType = UINT8_N
          DcmDspDataInfoRef = DataInfo_Vehicle_Manufacture_Spare_Part_Number_F187_Vehicle_Manufacture_Spare_Part_Number
        DataInfo_Number_of_installed_speakers_E01C_Number_of_installed_speakers (DcmDspDataInfo): DcmDspDataFixedLength=true  # Diagnostics Data Import
        Number_of_installed_speakers_E01C_Number_of_installed_speakers (DcmDspData): DcmDspDataSize=8, DcmDspDataType=UINT8, DcmDspDataInfoRef=DataInfo_Number_of_installed_speakers_E01C_Number_of_installed_speakers  # Diagnostics Data Import
        DataInfo_Telematics_Module_Status_E01A_Telematics_Module_Status (DcmDspDataInfo): DcmDspDataFixedLength=true  # Diagnostics Data Import
        Telematics_Module_Status_E01A_Telematics_Module_Status (DcmDspData): DcmDspDataSize=8, DcmDspDataType=UINT8, DcmDspDataInfoRef=DataInfo_Telematics_Module_Status_E01A_Telematics_Module_Status  # Diagnostics Data Import
        DataInfo_Tbox_geographical_coordinates_when_connection_lost_E019_Tbox_geographical_coordinates_when_connection_lost (DcmDspDataInfo): DcmDspDataFixedLength=true  # Diagnostics Data Import
        Tbox_geographical_coordinates_when_connection_lost_E019_Tbox_geographical_coordinates_when_connection_lost (DcmDspData):  # Diagnostics Data Import
          DcmDspDataSize = 128
          DcmDspDataType = UINT8_N
          DcmDspDataInfoRef = DataInfo_Tbox_geographical_coordinates_when_connection_lost_E019_Tbox_geographical_coordinates_when_connection_lost
        DataInfo_Tbox_Last_connection_lost_time_stamp_E018_Tbox_Last_connection_lost_time_stamp (DcmDspDataInfo): DcmDspDataFixedLength=true  # Diagnostics Data Import
        Tbox_Last_connection_lost_time_stamp_E018_Tbox_Last_connection_lost_time_stamp (DcmDspData):  # Diagnostics Data Import
          DcmDspDataSize = 128
          DcmDspDataType = UINT8_N
          DcmDspDataInfoRef = DataInfo_Tbox_Last_connection_lost_time_stamp_E018_Tbox_Last_connection_lost_time_stamp
        DataInfo_Tbox_Gateway_sub_mask_E017_Tbox_Gateway_sub_mask (DcmDspDataInfo): DcmDspDataFixedLength=true  # Diagnostics Data Import
        Tbox_Gateway_sub_mask_E017_Tbox_Gateway_sub_mask (DcmDspData): DcmDspDataSize=128, DcmDspDataType=UINT8_N, DcmDspDataInfoRef=DataInfo_Tbox_Gateway_sub_mask_E017_Tbox_Gateway_sub_mask  # Diagnostics Data Import
        DataInfo_Tbox_IP_Address_E016_Tbox_IP_Address (DcmDspDataInfo): DcmDspDataFixedLength=true  # Diagnostics Data Import
        Tbox_IP_Address_E016_Tbox_IP_Address (DcmDspData): DcmDspDataSize=128, DcmDspDataType=UINT8_N, DcmDspDataInfoRef=DataInfo_Tbox_IP_Address_E016_Tbox_IP_Address  # Diagnostics Data Import
        DataInfo_Wi_Fi_Module_Hardware_Part_Number_E015_Wi_Fi_Module_Hardware_Part_Number (DcmDspDataInfo): DcmDspDataFixedLength=true  # Diagnostics Data Import
        Wi_Fi_Module_Hardware_Part_Number_E015_Wi_Fi_Module_Hardware_Part_Number (DcmDspData): DcmDspDataSize=128, DcmDspDataType=UINT8_N, DcmDspDataInfoRef=DataInfo_Wi_Fi_Module_Hardware_Part_Number_E015_Wi_Fi_Module_Hardware_Part_Number  # Diagnostics Data Import
        DataInfo_Wi_Fi_Module_Firmware_Version_E014_Wi_Fi_Module_Firmware_Version (DcmDspDataInfo): DcmDspDataFixedLength=true  # Diagnostics Data Import
        Wi_Fi_Module_Firmware_Version_E014_Wi_Fi_Module_Firmware_Version (DcmDspData): DcmDspDataSize=128, DcmDspDataType=UINT8_N, DcmDspDataInfoRef=DataInfo_Wi_Fi_Module_Firmware_Version_E014_Wi_Fi_Module_Firmware_Version  # Diagnostics Data Import
        DataInfo_Wi_Fi_Module_Status_E013_Wi_Fi_Module_Status (DcmDspDataInfo): DcmDspDataFixedLength=true  # Diagnostics Data Import
        Wi_Fi_Module_Status_E013_Wi_Fi_Module_Status (DcmDspData): DcmDspDataSize=8, DcmDspDataType=UINT8, DcmDspDataInfoRef=DataInfo_Wi_Fi_Module_Status_E013_Wi_Fi_Module_Status  # Diagnostics Data Import
        DataInfo_FM_signal_Strength_E012_FM_signal_Strength (DcmDspDataInfo): DcmDspDataFixedLength=true  # Diagnostics Data Import
        FM_signal_Strength_E012_FM_signal_Strength (DcmDspData): DcmDspDataSize=8, DcmDspDataType=UINT8, DcmDspDataInfoRef=DataInfo_FM_signal_Strength_E012_FM_signal_Strength  # Diagnostics Data Import
        DataInfo_AM_signal_Strength_E011_AM_signal_Strength (DcmDspDataInfo): DcmDspDataFixedLength=true  # Diagnostics Data Import
        AM_signal_Strength_E011_AM_signal_Strength (DcmDspData): DcmDspDataSize=8, DcmDspDataType=UINT8, DcmDspDataInfoRef=DataInfo_AM_signal_Strength_E011_AM_signal_Strength  # Diagnostics Data Import
        DataInfo_Support_FM_frequency_Max_E010_Support_FM_frequency_Max (DcmDspDataInfo): DcmDspDataFixedLength=true  # Diagnostics Data Import
        Support_FM_frequency_Max_E010_Support_FM_frequency_Max (DcmDspData): DcmDspDataSize=32, DcmDspDataType=UINT32, DcmDspDataInfoRef=DataInfo_Support_FM_frequency_Max_E010_Support_FM_frequency_Max  # Diagnostics Data Import
        DataInfo_Support_FM_frequency_Min_E00F_Support_FM_frequency_Min (DcmDspDataInfo): DcmDspDataFixedLength=true  # Diagnostics Data Import
        Support_FM_frequency_Min_E00F_Support_FM_frequency_Min (DcmDspData): DcmDspDataSize=32, DcmDspDataType=UINT32, DcmDspDataInfoRef=DataInfo_Support_FM_frequency_Min_E00F_Support_FM_frequency_Min  # Diagnostics Data Import
        DataInfo_Support_AM_frequency_Max_E00E_Support_AM_frequency_Max (DcmDspDataInfo): DcmDspDataFixedLength=true  # Diagnostics Data Import
        Support_AM_frequency_Max_E00E_Support_AM_frequency_Max (DcmDspData): DcmDspDataSize=32, DcmDspDataType=UINT32, DcmDspDataInfoRef=DataInfo_Support_AM_frequency_Max_E00E_Support_AM_frequency_Max  # Diagnostics Data Import
        DataInfo_Support_AM_frequency_Min_E00D_Support_AM_frequency_Min (DcmDspDataInfo): DcmDspDataFixedLength=true  # Diagnostics Data Import
        Support_AM_frequency_Min_E00D_Support_AM_frequency_Min (DcmDspData): DcmDspDataSize=32, DcmDspDataType=UINT32, DcmDspDataInfoRef=DataInfo_Support_AM_frequency_Min_E00D_Support_AM_frequency_Min  # Diagnostics Data Import
        DataInfo_Currently_connected_USB_Type_E00C_Currently_connected_USB_Type (DcmDspDataInfo): DcmDspDataFixedLength=true  # Diagnostics Data Import
        Currently_connected_USB_Type_E00C_Currently_connected_USB_Type (DcmDspData): DcmDspDataSize=8, DcmDspDataType=UINT8, DcmDspDataInfoRef=DataInfo_Currently_connected_USB_Type_E00C_Currently_connected_USB_Type  # Diagnostics Data Import
        DataInfo_Number_of_external_USB_devices_plugged_E00B_Number_of_external_USB_devices_plugged (DcmDspDataInfo): DcmDspDataFixedLength=true  # Diagnostics Data Import
        Number_of_external_USB_devices_plugged_E00B_Number_of_external_USB_devices_plugged (DcmDspData):  # Diagnostics Data Import
          DcmDspDataSize = 8
          DcmDspDataType = UINT8
          DcmDspDataInfoRef = DataInfo_Number_of_external_USB_devices_plugged_E00B_Number_of_external_USB_devices_plugged
        DataInfo_Audio_jack_status_E00A_Audio_jack_status (DcmDspDataInfo): DcmDspDataFixedLength=true  # Diagnostics Data Import
        Audio_jack_status_E00A_Audio_jack_status (DcmDspData): DcmDspDataSize=8, DcmDspDataType=UINT8, DcmDspDataInfoRef=DataInfo_Audio_jack_status_E00A_Audio_jack_status  # Diagnostics Data Import
        DataInfo_BT_firmware_version_E009_BT_firmware_version (DcmDspDataInfo): DcmDspDataFixedLength=true  # Diagnostics Data Import
        BT_firmware_version_E009_BT_firmware_version (DcmDspData): DcmDspDataSize=128, DcmDspDataType=UINT8_N, DcmDspDataInfoRef=DataInfo_BT_firmware_version_E009_BT_firmware_version  # Diagnostics Data Import
        DataInfo_BT_active_profile_list_E008_BT_active_profile_list (DcmDspDataInfo): DcmDspDataFixedLength=true  # Diagnostics Data Import
        BT_active_profile_list_E008_BT_active_profile_list (DcmDspData): DcmDspDataSize=8, DcmDspDataType=UINT8, DcmDspDataInfoRef=DataInfo_BT_active_profile_list_E008_BT_active_profile_list  # Diagnostics Data Import
        DataInfo_BT_Power_Class_E007_BT_Power_Class (DcmDspDataInfo): DcmDspDataFixedLength=true  # Diagnostics Data Import
        BT_Power_Class_E007_BT_Power_Class (DcmDspData): DcmDspDataSize=8, DcmDspDataType=UINT8, DcmDspDataInfoRef=DataInfo_BT_Power_Class_E007_BT_Power_Class  # Diagnostics Data Import
        DataInfo_Bluetooth_Status_E006_Bluetooth_Status (DcmDspDataInfo): DcmDspDataFixedLength=true  # Diagnostics Data Import
        Bluetooth_Status_E006_Bluetooth_Status (DcmDspData): DcmDspDataSize=8, DcmDspDataType=UINT8, DcmDspDataInfoRef=DataInfo_Bluetooth_Status_E006_Bluetooth_Status  # Diagnostics Data Import
        DataInfo_Bluetooth_Current_Discoverability_modes_E005_Bluetooth_Current_Discoverability_modes (DcmDspDataInfo): DcmDspDataFixedLength=true  # Diagnostics Data Import
        Bluetooth_Current_Discoverability_modes_E005_Bluetooth_Current_Discoverability_modes (DcmDspData):  # Diagnostics Data Import
          DcmDspDataSize = 8
          DcmDspDataType = UINT8
          DcmDspDataInfoRef = DataInfo_Bluetooth_Current_Discoverability_modes_E005_Bluetooth_Current_Discoverability_modes
        DataInfo_Present_GPS_coordinates_shift_data_E003_GPS_coordinates (DcmDspDataInfo): DcmDspDataFixedLength=true  # Diagnostics Data Import
        Present_GPS_coordinates_shift_data_E003_GPS_coordinates (DcmDspData): DcmDspDataSize=32, DcmDspDataType=UINT32, DcmDspDataInfoRef=DataInfo_Present_GPS_coordinates_shift_data_E003_GPS_coordinates  # Diagnostics Data Import
        DataInfo_Screen_resolution_E002_Height (DcmDspDataInfo): DcmDspDataFixedLength=true  # Diagnostics Data Import
        Screen_resolution_E002_Height (DcmDspData): DcmDspDataSize=16, DcmDspDataType=UINT16, DcmDspDataInfoRef=DataInfo_Screen_resolution_E002_Height  # Diagnostics Data Import
        DataInfo_Screen_resolution_E002_Width (DcmDspDataInfo): DcmDspDataFixedLength=true  # Diagnostics Data Import
        Screen_resolution_E002_Width (DcmDspData): DcmDspDataSize=16, DcmDspDataType=UINT16, DcmDspDataInfoRef=DataInfo_Screen_resolution_E002_Width  # Diagnostics Data Import
        DataInfo_Number_of_installed_cameras_E001_Number_of_installed_cameras (DcmDspDataInfo): DcmDspDataFixedLength=true  # Diagnostics Data Import
        Number_of_installed_cameras_E001_Number_of_installed_cameras (DcmDspData): DcmDspDataSize=8, DcmDspDataType=UINT8, DcmDspDataInfoRef=DataInfo_Number_of_installed_cameras_E001_Number_of_installed_cameras  # Diagnostics Data Import
        DataInfo_DTC_Occurrence_Timer_D005_Occure_Time_Inforamation (DcmDspDataInfo): DcmDspDataFixedLength=true  # Diagnostics Data Import
        DTC_Occurrence_Timer_D005_Occure_Time_Inforamation (DcmDspData): DcmDspDataSize=32, DcmDspDataType=UINT32, DcmDspDataInfoRef=DataInfo_DTC_Occurrence_Timer_D005_Occure_Time_Inforamation  # Diagnostics Data Import
        DataInfo_Odometer_D004_Odometer (DcmDspDataInfo): DcmDspDataFixedLength=true  # Diagnostics Data Import
        Odometer_D004_Odometer (DcmDspData): DcmDspDataSize=24, DcmDspDataType=UINT8_N, DcmDspDataInfoRef=DataInfo_Odometer_D004_Odometer  # Diagnostics Data Import
        DataInfo_Operating_Voltage_Value_D003_Operating_Voltage_Value (DcmDspDataInfo): DcmDspDataFixedLength=true  # Diagnostics Data Import
        Operating_Voltage_Value_D003_Operating_Voltage_Value (DcmDspData): DcmDspDataSize=8, DcmDspDataType=UINT8, DcmDspDataInfoRef=DataInfo_Operating_Voltage_Value_D003_Operating_Voltage_Value  # Diagnostics Data Import
        DataInfo_Engine_Speed_D002_Engine_Speed (DcmDspDataInfo): DcmDspDataFixedLength=true  # Diagnostics Data Import
        Engine_Speed_D002_Engine_Speed (DcmDspData): DcmDspDataSize=16, DcmDspDataType=UINT16, DcmDspDataInfoRef=DataInfo_Engine_Speed_D002_Engine_Speed  # Diagnostics Data Import
        DataInfo_Vehicle_Speed_D001_Vehicle_Speed (DcmDspDataInfo): DcmDspDataFixedLength=true  # Diagnostics Data Import
        Vehicle_Speed_D001_Vehicle_Speed (DcmDspData): DcmDspDataSize=16, DcmDspDataType=UINT16, DcmDspDataInfoRef=DataInfo_Vehicle_Speed_D001_Vehicle_Speed  # Diagnostics Data Import
      DcmDsd  # Diagnostics Data Import
        DcmDsdServiceTable  # Diagnostics Data Import
          13 x DcmDsdService:
            ControlDtcSetting: DcmDsdSidTabServiceId=133, DcmDsdSidTabSubfuncAvail=true, DcmDsdSidTabSessionLevelRef=DcmDspSession/Extended  # Diagnostics Data Import
              Disable (DcmDsdSubService): DcmDsdSubServiceId=2, DcmDsdSubServiceSessionLevelRef=DcmDspSession/Extended  # Diagnostics Data Import
              Enable (DcmDsdSubService): DcmDsdSubServiceId=1, DcmDsdSubServiceSessionLevelRef=DcmDspSession/Extended  # Diagnostics Data Import
            TesterPresent: DcmDsdSidTabServiceId=62, DcmDsdSidTabSubfuncAvail=true  # Diagnostics Data Import
              TesterPresent (DcmDsdSubService): DcmDsdSubServiceId=0  # Diagnostics Data Import
            WriteMemoryByAddress: DcmDsdSidTabServiceId=61, DcmDsdSidTabSubfuncAvail=false  # Diagnostics Data Import
            RoutineControl: DcmDsdSidTabServiceId=49, DcmDsdSidTabSubfuncAvail=true, DcmDsdSidTabSessionLevelRef=DcmDspSession/Extended, DcmDsdSidTabSecurityLevelRef=UnlockedL1  # Diagnostics Data Import
            WriteDataById: DcmDsdSidTabServiceId=46, DcmDsdSidTabSubfuncAvail=false  # Diagnostics Data Import
            CommunicationControl: DcmDsdSidTabServiceId=40, DcmDsdSidTabSubfuncAvail=true, DcmDsdSidTabSessionLevelRef=DcmDspSession/Extended  # Diagnostics Data Import
              DisableRxAndTx (DcmDsdSubService): DcmDsdSubServiceId=3, DcmDsdSubServiceSessionLevelRef=DcmDspSession/Extended  # Diagnostics Data Import
              EnableRxAndTx (DcmDsdSubService): DcmDsdSubServiceId=0, DcmDsdSubServiceSessionLevelRef=DcmDspSession/Extended  # Diagnostics Data Import
            SecurityAccess: DcmDsdSidTabServiceId=39, DcmDsdSidTabSubfuncAvail=true, DcmDsdSidTabSessionLevelRef=DcmDspSession/Extended  # Diagnostics Data Import
              KeyLevel1_Send (DcmDsdSubService): DcmDsdSubServiceId=2, DcmDsdSubServiceSessionLevelRef=DcmDspSession/Extended  # Diagnostics Data Import
              SeedLevel1_Request (DcmDsdSubService): DcmDsdSubServiceId=1, DcmDsdSubServiceSessionLevelRef=DcmDspSession/Extended  # Diagnostics Data Import
            ReadMemoryByAddress: DcmDsdSidTabServiceId=35, DcmDsdSidTabSubfuncAvail=false  # Diagnostics Data Import
            ReadDataById: DcmDsdSidTabServiceId=34, DcmDsdSidTabSubfuncAvail=false  # Diagnostics Data Import
            ReadDtcInfo: DcmDsdSidTabServiceId=25, DcmDsdSidTabSubfuncAvail=true  # Diagnostics Data Import
              5 x DcmDsdSubService:
                RSUPDTC: DcmDsdSubServiceId=10  # Diagnostics Data Import
                RDTCEDRBDN: DcmDsdSubServiceId=6  # Diagnostics Data Import
                RDTCSSBDTC: DcmDsdSubServiceId=4  # Diagnostics Data Import
                RNODTCBSM: DcmDsdSubServiceId=1  # Diagnostics Data Import
                RDTCBSM: DcmDsdSubServiceId=2  # Diagnostics Data Import
            ClearDiagInfo: DcmDsdSidTabServiceId=20, DcmDsdSidTabSubfuncAvail=false  # Diagnostics Data Import
            EcuReset: DcmDsdSidTabServiceId=17, DcmDsdSidTabSubfuncAvail=true  # Diagnostics Data Import
              Soft (DcmDsdSubService): DcmDsdSubServiceId=3  # Diagnostics Data Import
              Hard (DcmDsdSubService): DcmDsdSubServiceId=1  # Diagnostics Data Import
            DiagSessionControl: DcmDsdSidTabServiceId=16, DcmDsdSidTabSubfuncAvail=true  # Diagnostics Data Import
              Extended (DcmDsdSubService): DcmDsdSubServiceId=3  # Diagnostics Data Import
              Default (DcmDsdSubService): DcmDsdSubServiceId=1  # Diagnostics Data Import
  module config Dem
    DemGeneral:  # Diagnostics Data Import
      DemAgingCycleCounterProcessing = DEM_PROCESS_AGINGCTR_INTERN
      DemDebounceCounterBasedSupport = true
      DemDtcStatusAvailabilityMask = 255
      DemEnableConditionSupport = true
      DemMaxNumberEventEntryMirror = 0
      DemPTOSupport = false
      DemTypeOfFreezeFrameRecordNumeration = DEM_FF_RECNUM_CALCULATED
      OccurrenceCounter_Occurrence_Counter (DemDataClass): DemDataElementDataSize=1, DemDataElementInternalData=DEM_OCCCTR, DemDataElementUsePort=USE_DATA_INTERNAL  # Diagnostics Data Import
      PID_0x14_DID_Data (DemDataClass):  # Diagnostics Data Import
        DemDataElementDataSize = 2
        DemDataElementDataType = UINT16
        DemDataElementEndianness = BIG_ENDIAN
        DemDataElementUsePort = USE_DATA_CLIENT_SERVER_PORT
        DemDataElementStoreNonVolatile = true
      IgnitionCycle (DemOperationCycle): DemOperationCycleType=DEM_OPCYC_IGNITION  # Diagnostics Data Import
      PowerCycle (DemOperationCycle): DemOperationCycleType=DEM_OPCYC_POWER  # Diagnostics Data Import
      FreezeFrameClass_fb82c988 (DemFreezeFrameClass): DemDidClassRef=DID_0xf414  # Diagnostics Data Import
      OccurrenceCounter (DemExtendedDataRecordClass): DemExtendedDataRecordNumber=1, DemDataClassRef=OccurrenceCounter_Occurrence_Counter  # Diagnostics Data Import
      6 x DemEnableConditionGroup, all with DemEnableConditionRef=STATE_NORMAL, DemEnableConditionRef=Start, DemEnableConditionRef=completed, DemEnableConditionRef=in, DemEnableConditionRef=sequence, DemEnableConditionRef=up:
        EnableConditionGroup_f70a9d46: DemEnableConditionRef=HUT, DemEnableConditionRef=HUT, DemEnableConditionRef=IP, DemEnableConditionRef=is, DemEnableConditionRef=is, DemEnableConditionRef=is, DemEnableConditionRef=online  # Diagnostics Data Import
        EnableConditionGroup_ce4d85f8: DemEnableConditionRef=HUT, DemEnableConditionRef=HUT, DemEnableConditionRef=No, DemEnableConditionRef=diagnostic, DemEnableConditionRef=fault, DemEnableConditionRef=is, DemEnableConditionRef=is, DemEnableConditionRef=voltage  # Diagnostics Data Import
        EnableConditionGroup_b30aa5c2: DemEnableConditionRef=HUT, DemEnableConditionRef=HUT, DemEnableConditionRef=is, DemEnableConditionRef=is  # Diagnostics Data Import
        EnableConditionGroup_5fbd712e: DemEnableConditionRef=China, DemEnableConditionRef=H9, DemEnableConditionRef=HUT, DemEnableConditionRef=HUT, DemEnableConditionRef=V51, DemEnableConditionRef=Vechile, DemEnableConditionRef=is, DemEnableConditionRef=is, DemEnableConditionRef=or, DemEnableConditionRef=variant  # Diagnostics Data Import
        EnableConditionGroup_3e8e3f33: DemEnableConditionRef=HUT, DemEnableConditionRef=HUT, DemEnableConditionRef=No, DemEnableConditionRef=display, DemEnableConditionRef=fault, DemEnableConditionRef=is, DemEnableConditionRef=is, DemEnableConditionRef=power, DemEnableConditionRef=supply  # Diagnostics Data Import
        EnableConditionGroup_2d4cad61: DemEnableConditionRef=HUT, DemEnableConditionRef=HUT, DemEnableConditionRef=No, DemEnableConditionRef=camer, DemEnableConditionRef=fault, DemEnableConditionRef=is, DemEnableConditionRef=is, DemEnableConditionRef=power, DemEnableConditionRef=supply  # Diagnostics Data Import
      ExtendedDataClass_83dcefb7 (DemExtendedDataClass): DemExtendedDataRecordClassRef=OccurrenceCounter  # Diagnostics Data Import
      24 x DemEnableCondition:
        camer  # Diagnostics Data Import
        online  # Diagnostics Data Import
        IP  # Diagnostics Data Import
        voltage  # Diagnostics Data Import
        diagnostic  # Diagnostics Data Import
        China  # Diagnostics Data Import
        H9  # Diagnostics Data Import
        or  # Diagnostics Data Import
        V51  # Diagnostics Data Import
        variant  # Diagnostics Data Import
        Vechile  # Diagnostics Data Import
        fault  # Diagnostics Data Import
        supply  # Diagnostics Data Import
        power  # Diagnostics Data Import
        display  # Diagnostics Data Import
        No  # Diagnostics Data Import
        STATE_NORMAL  # Diagnostics Data Import
        in  # Diagnostics Data Import
        completed  # Diagnostics Data Import
        is  # Diagnostics Data Import
        sequence  # Diagnostics Data Import
        up  # Diagnostics Data Import
        Start  # Diagnostics Data Import
        HUT  # Diagnostics Data Import
      DID_0xf414 (DemDidClass): DemDidIdentifier=62484, DemDidDataClassRef=PID_0x14_DID_Data  # Diagnostics Data Import
    DemConfigSet  # Diagnostics Data Import
      DTC_0XD10116 (DemEventParameter):  # Diagnostics Data Import
        DemEventKind = DEM_EVENT_KIND_SWC
        DemMaxNumberFreezeFrameRecords = 1
        DemDTCClassRef = DTCClass_DTC_0XD10116
        DemExtendedDataClassRef = ExtendedDataClass_83dcefb7
        DemFreezeFrameClassRef = FreezeFrameClass_fb82c988
        DemEventClass:  # Diagnostics Data Import
          DemAgingAllowed = true
          DemAgingCycleCounterThreshold = 80
          DemEventDestination = DEM_DTC_ORIGIN_PRIMARY_MEMORY
          DemEventPriority = 0
          DemEventFailureCycleCounterThreshold = 0
          DemAgingCycleRef = PowerCycle
          DemEnableConditionGroupRef = EnableConditionGroup_b30aa5c2
          DemOperationCycleRef = PowerCycle
          DemDebounceAlgorithmClass  # Diagnostics Data Import
            DemDebounceCounterBased: DemDebounceCounterDecrementStepSize=1, DemDebounceCounterIncrementStepSize=1, DemDebounceCounterJumpDown=false, DemDebounceCounterJumpUp=false  # Diagnostics Data Import
      DTCClass_DTC_0XD10116 (DemDTCClass): DemDTCSeverity=DEM_DTC_SEV_IMMEDIATELY, DemUdsDTC=13697302  # Diagnostics Data Import
      DTC_0XD10017 (DemEventParameter):  # Diagnostics Data Import
        DemEventKind = DEM_EVENT_KIND_SWC
        DemMaxNumberFreezeFrameRecords = 1
        DemDTCClassRef = DTCClass_DTC_0XD10017
        DemExtendedDataClassRef = ExtendedDataClass_83dcefb7
        DemFreezeFrameClassRef = FreezeFrameClass_fb82c988
        DemEventClass:  # Diagnostics Data Import
          DemAgingAllowed = true
          DemAgingCycleCounterThreshold = 80
          DemEventDestination = DEM_DTC_ORIGIN_PRIMARY_MEMORY
          DemEventPriority = 0
          DemEventFailureCycleCounterThreshold = 0
          DemAgingCycleRef = PowerCycle
          DemEnableConditionGroupRef = EnableConditionGroup_b30aa5c2
          DemOperationCycleRef = PowerCycle
          DemDebounceAlgorithmClass  # Diagnostics Data Import
            DemDebounceCounterBased: DemDebounceCounterDecrementStepSize=1, DemDebounceCounterIncrementStepSize=1, DemDebounceCounterJumpDown=false, DemDebounceCounterJumpUp=false  # Diagnostics Data Import
      DTCClass_DTC_0XD10017 (DemDTCClass): DemDTCSeverity=DEM_DTC_SEV_IMMEDIATELY, DemUdsDTC=13697047  # Diagnostics Data Import
      DTC_0XC26402 (DemEventParameter):  # Diagnostics Data Import
        DemEventKind = DEM_EVENT_KIND_SWC
        DemMaxNumberFreezeFrameRecords = 1
        DemDTCClassRef = DTCClass_DTC_0XC26402
        DemExtendedDataClassRef = ExtendedDataClass_83dcefb7
        DemFreezeFrameClassRef = FreezeFrameClass_fb82c988
        DemEventClass:  # Diagnostics Data Import
          DemAgingAllowed = true
          DemAgingCycleCounterThreshold = 80
          DemEventDestination = DEM_DTC_ORIGIN_PRIMARY_MEMORY
          DemEventPriority = 0
          DemEventFailureCycleCounterThreshold = 0
          DemAgingCycleRef = PowerCycle
          DemEnableConditionGroupRef = EnableConditionGroup_2d4cad61
          DemOperationCycleRef = PowerCycle
          DemDebounceAlgorithmClass  # Diagnostics Data Import
            DemDebounceCounterBased: DemDebounceCounterDecrementStepSize=1, DemDebounceCounterIncrementStepSize=1, DemDebounceCounterJumpDown=false, DemDebounceCounterJumpUp=false  # Diagnostics Data Import
      DTCClass_DTC_0XC26402 (DemDTCClass): DemDTCSeverity=DEM_DTC_SEV_CHECK_AT_NEXT_HALT, DemUdsDTC=12739586  # Diagnostics Data Import
      DTC_0XC19988 (DemEventParameter):  # Diagnostics Data Import
        DemEventKind = DEM_EVENT_KIND_SWC
        DemMaxNumberFreezeFrameRecords = 1
        DemDTCClassRef = DTCClass_DTC_0XC19988
        DemExtendedDataClassRef = ExtendedDataClass_83dcefb7
        DemFreezeFrameClassRef = FreezeFrameClass_fb82c988
        DemEventClass:  # Diagnostics Data Import
          DemAgingAllowed = true
          DemAgingCycleCounterThreshold = 80
          DemEventDestination = DEM_DTC_ORIGIN_PRIMARY_MEMORY
          DemEventPriority = 0
          DemEventFailureCycleCounterThreshold = 0
          DemAgingCycleRef = PowerCycle
          DemEnableConditionGroupRef = EnableConditionGroup_ce4d85f8
          DemOperationCycleRef = PowerCycle
          DemDebounceAlgorithmClass  # Diagnostics Data Import
            DemDebounceCounterBased: DemDebounceCounterDecrementStepSize=1, DemDebounceCounterIncrementStepSize=1, DemDebounceCounterJumpDown=false, DemDebounceCounterJumpUp=false  # Diagnostics Data Import
      DTCClass_DTC_0XC19988 (DemDTCClass): DemDTCSeverity=DEM_DTC_SEV_MAINTENANCE_ONLY, DemUdsDTC=12687752  # Diagnostics Data Import
      DTC_0XC19887 (DemEventParameter):  # Diagnostics Data Import
        DemEventKind = DEM_EVENT_KIND_SWC
        DemMaxNumberFreezeFrameRecords = 1
        DemDTCClassRef = DTCClass_DTC_0XC19887
        DemExtendedDataClassRef = ExtendedDataClass_83dcefb7
        DemFreezeFrameClassRef = FreezeFrameClass_fb82c988
        DemEventClass:  # Diagnostics Data Import
          DemAgingAllowed = true
          DemAgingCycleCounterThreshold = 80
          DemEventDestination = DEM_DTC_ORIGIN_PRIMARY_MEMORY
          DemEventPriority = 0
          DemEventFailureCycleCounterThreshold = 0
          DemAgingCycleRef = PowerCycle
          DemEnableConditionGroupRef = EnableConditionGroup_ce4d85f8
          DemOperationCycleRef = PowerCycle
          DemDebounceAlgorithmClass  # Diagnostics Data Import
            DemDebounceCounterBased: DemDebounceCounterDecrementStepSize=1, DemDebounceCounterIncrementStepSize=1, DemDebounceCounterJumpDown=false, DemDebounceCounterJumpUp=false  # Diagnostics Data Import
      DTCClass_DTC_0XC19887 (DemDTCClass): DemDTCSeverity=DEM_DTC_SEV_IMMEDIATELY, DemUdsDTC=12687495  # Diagnostics Data Import
      DTC_0XC15582 (DemEventParameter):  # Diagnostics Data Import
        DemEventKind = DEM_EVENT_KIND_SWC
        DemMaxNumberFreezeFrameRecords = 1
        DemDTCClassRef = DTCClass_DTC_0XC15582
        DemExtendedDataClassRef = ExtendedDataClass_83dcefb7
        DemFreezeFrameClassRef = FreezeFrameClass_fb82c988
        DemEventClass:  # Diagnostics Data Import
          DemAgingAllowed = true
          DemAgingCycleCounterThreshold = 80
          DemEventDestination = DEM_DTC_ORIGIN_PRIMARY_MEMORY
          DemEventPriority = 0
          DemEventFailureCycleCounterThreshold = 0
          DemAgingCycleRef = PowerCycle
          DemEnableConditionGroupRef = EnableConditionGroup_b30aa5c2
          DemOperationCycleRef = PowerCycle
          DemDebounceAlgorithmClass  # Diagnostics Data Import
            DemDebounceCounterBased: DemDebounceCounterDecrementStepSize=1, DemDebounceCounterIncrementStepSize=1, DemDebounceCounterJumpDown=false, DemDebounceCounterJumpUp=false  # Diagnostics Data Import
      DTCClass_DTC_0XC15582 (DemDTCClass): DemDTCSeverity=DEM_DTC_SEV_IMMEDIATELY, DemUdsDTC=12670338  # Diagnostics Data Import
      DTC_0XC15502 (DemEventParameter):  # Diagnostics Data Import
        DemEventKind = DEM_EVENT_KIND_SWC
        DemMaxNumberFreezeFrameRecords = 1
        DemDTCClassRef = DTCClass_DTC_0XC15502
        DemExtendedDataClassRef = ExtendedDataClass_83dcefb7
        DemFreezeFrameClassRef = FreezeFrameClass_fb82c988
        DemEventClass:  # Diagnostics Data Import
          DemAgingAllowed = true
          DemAgingCycleCounterThreshold = 80
          DemEventDestination = DEM_DTC_ORIGIN_PRIMARY_MEMORY
          DemEventPriority = 0
          DemEventFailureCycleCounterThreshold = 0
          DemAgingCycleRef = PowerCycle
          DemEnableConditionGroupRef = EnableConditionGroup_f70a9d46
          DemOperationCycleRef = PowerCycle
          DemDebounceAlgorithmClass  # Diagnostics Data Import
            DemDebounceCounterBased: DemDebounceCounterDecrementStepSize=1, DemDebounceCounterIncrementStepSize=1, DemDebounceCounterJumpDown=false, DemDebounceCounterJumpUp=false  # Diagnostics Data Import
      DTCClass_DTC_0XC15502 (DemDTCClass): DemDTCSeverity=DEM_DTC_SEV_CHECK_AT_NEXT_HALT, DemUdsDTC=12670210  # Diagnostics Data Import
      DTC_0XC14687 (DemEventParameter):  # Diagnostics Data Import
        DemEventKind = DEM_EVENT_KIND_SWC
        DemMaxNumberFreezeFrameRecords = 1
        DemDTCClassRef = DTCClass_DTC_0XC14687
        DemExtendedDataClassRef = ExtendedDataClass_83dcefb7
        DemFreezeFrameClassRef = FreezeFrameClass_fb82c988
        DemEventClass:  # Diagnostics Data Import
          DemAgingAllowed = true
          DemAgingCycleCounterThreshold = 80
          DemEventDestination = DEM_DTC_ORIGIN_PRIMARY_MEMORY
          DemEventPriority = 0
          DemEventFailureCycleCounterThreshold = 0
          DemAgingCycleRef = PowerCycle
          DemEnableConditionGroupRef = EnableConditionGroup_ce4d85f8
          DemOperationCycleRef = PowerCycle
          DemDebounceAlgorithmClass  # Diagnostics Data Import
            DemDebounceCounterBased: DemDebounceCounterDecrementStepSize=1, DemDebounceCounterIncrementStepSize=1, DemDebounceCounterJumpDown=false, DemDebounceCounterJumpUp=false  # Diagnostics Data Import
      DTCClass_DTC_0XC14687 (DemDTCClass): DemDTCSeverity=DEM_DTC_SEV_IMMEDIATELY, DemUdsDTC=12666503  # Diagnostics Data Import
      DTC_0XC01988 (DemEventParameter):  # Diagnostics Data Import
        DemEventKind = DEM_EVENT_KIND_SWC
        DemMaxNumberFreezeFrameRecords = 1
        DemDTCClassRef = DTCClass_DTC_0XC01988
        DemExtendedDataClassRef = ExtendedDataClass_83dcefb7
        DemFreezeFrameClassRef = FreezeFrameClass_fb82c988
        DemEventClass:  # Diagnostics Data Import
          DemAgingAllowed = true
          DemAgingCycleCounterThreshold = 80
          DemEventDestination = DEM_DTC_ORIGIN_PRIMARY_MEMORY
          DemEventPriority = 0
          DemEventFailureCycleCounterThreshold = 0
          DemAgingCycleRef = PowerCycle
          DemEnableConditionGroupRef = EnableConditionGroup_ce4d85f8
          DemOperationCycleRef = PowerCycle
          DemDebounceAlgorithmClass  # Diagnostics Data Import
            DemDebounceCounterBased: DemDebounceCounterDecrementStepSize=1, DemDebounceCounterIncrementStepSize=1, DemDebounceCounterJumpDown=false, DemDebounceCounterJumpUp=false  # Diagnostics Data Import
      DTCClass_DTC_0XC01988 (DemDTCClass): DemDTCSeverity=DEM_DTC_SEV_MAINTENANCE_ONLY, DemUdsDTC=12589448  # Diagnostics Data Import
      DTC_0XA11204 (DemEventParameter):  # Diagnostics Data Import
        DemEventKind = DEM_EVENT_KIND_SWC
        DemMaxNumberFreezeFrameRecords = 1
        DemDTCClassRef = DTCClass_DTC_0XA11204
        DemExtendedDataClassRef = ExtendedDataClass_83dcefb7
        DemFreezeFrameClassRef = FreezeFrameClass_fb82c988
        DemEventClass:  # Diagnostics Data Import
          DemAgingAllowed = true
          DemAgingCycleCounterThreshold = 80
          DemEventDestination = DEM_DTC_ORIGIN_PRIMARY_MEMORY
          DemEventPriority = 0
          DemEventFailureCycleCounterThreshold = 0
          DemAgingCycleRef = PowerCycle
          DemEnableConditionGroupRef = EnableConditionGroup_ce4d85f8
          DemOperationCycleRef = PowerCycle
          DemDebounceAlgorithmClass  # Diagnostics Data Import
            DemDebounceCounterBased: DemDebounceCounterDecrementStepSize=1, DemDebounceCounterIncrementStepSize=1, DemDebounceCounterJumpDown=false, DemDebounceCounterJumpUp=false  # Diagnostics Data Import
      DTCClass_DTC_0XA11204 (DemDTCClass): DemDTCSeverity=DEM_DTC_SEV_MAINTENANCE_ONLY, DemUdsDTC=10555908  # Diagnostics Data Import
      DTC_0XA10604 (DemEventParameter):  # Diagnostics Data Import
        DemEventKind = DEM_EVENT_KIND_SWC
        DemMaxNumberFreezeFrameRecords = 1
        DemDTCClassRef = DTCClass_DTC_0XA10604
        DemExtendedDataClassRef = ExtendedDataClass_83dcefb7
        DemFreezeFrameClassRef = FreezeFrameClass_fb82c988
        DemEventClass:  # Diagnostics Data Import
          DemAgingAllowed = true
          DemAgingCycleCounterThreshold = 80
          DemEventDestination = DEM_DTC_ORIGIN_PRIMARY_MEMORY
          DemEventPriority = 0
          DemEventFailureCycleCounterThreshold = 0
          DemAgingCycleRef = PowerCycle
          DemEnableConditionGroupRef = EnableConditionGroup_b30aa5c2
          DemOperationCycleRef = PowerCycle
          DemDebounceAlgorithmClass  # Diagnostics Data Import
            DemDebounceCounterBased: DemDebounceCounterDecrementStepSize=1, DemDebounceCounterIncrementStepSize=1, DemDebounceCounterJumpDown=false, DemDebounceCounterJumpUp=false  # Diagnostics Data Import
      DTCClass_DTC_0XA10604 (DemDTCClass): DemDTCSeverity=DEM_DTC_SEV_MAINTENANCE_ONLY, DemUdsDTC=10552836  # Diagnostics Data Import
      DTC_0XA10602 (DemEventParameter):  # Diagnostics Data Import
        DemEventKind = DEM_EVENT_KIND_SWC
        DemMaxNumberFreezeFrameRecords = 1
        DemDTCClassRef = DTCClass_DTC_0XA10602
        DemExtendedDataClassRef = ExtendedDataClass_83dcefb7
        DemFreezeFrameClassRef = FreezeFrameClass_fb82c988
        DemEventClass:  # Diagnostics Data Import
          DemAgingAllowed = true
          DemAgingCycleCounterThreshold = 80
          DemEventDestination = DEM_DTC_ORIGIN_PRIMARY_MEMORY
          DemEventPriority = 0
          DemEventFailureCycleCounterThreshold = 0
          DemAgingCycleRef = PowerCycle
          DemEnableConditionGroupRef = EnableConditionGroup_b30aa5c2
          DemOperationCycleRef = PowerCycle
          DemDebounceAlgorithmClass  # Diagnostics Data Import
            DemDebounceCounterBased: DemDebounceCounterDecrementStepSize=1, DemDebounceCounterIncrementStepSize=1, DemDebounceCounterJumpDown=false, DemDebounceCounterJumpUp=false  # Diagnostics Data Import
      DTCClass_DTC_0XA10602 (DemDTCClass): DemDTCSeverity=DEM_DTC_SEV_MAINTENANCE_ONLY, DemUdsDTC=10552834  # Diagnostics Data Import
      DTC_0X9A0425 (DemEventParameter):  # Diagnostics Data Import
        DemEventKind = DEM_EVENT_KIND_SWC
        DemMaxNumberFreezeFrameRecords = 1
        DemDTCClassRef = DTCClass_DTC_0X9A0425
        DemExtendedDataClassRef = ExtendedDataClass_83dcefb7
        DemFreezeFrameClassRef = FreezeFrameClass_fb82c988
        DemEventClass:  # Diagnostics Data Import
          DemAgingAllowed = true
          DemAgingCycleCounterThreshold = 80
          DemEventDestination = DEM_DTC_ORIGIN_PRIMARY_MEMORY
          DemEventPriority = 0
          DemEventFailureCycleCounterThreshold = 0
          DemAgingCycleRef = PowerCycle
          DemEnableConditionGroupRef = EnableConditionGroup_b30aa5c2
          DemOperationCycleRef = PowerCycle
          DemDebounceAlgorithmClass  # Diagnostics Data Import
            DemDebounceCounterBased: DemDebounceCounterDecrementStepSize=1, DemDebounceCounterIncrementStepSize=1, DemDebounceCounterJumpDown=false, DemDebounceCounterJumpUp=false  # Diagnostics Data Import
      DTCClass_DTC_0X9A0425 (DemDTCClass): DemDTCSeverity=DEM_DTC_SEV_MAINTENANCE_ONLY, DemUdsDTC=10093605  # Diagnostics Data Import
      DTC_0X9A041E (DemEventParameter):  # Diagnostics Data Import
        DemEventKind = DEM_EVENT_KIND_SWC
        DemMaxNumberFreezeFrameRecords = 1
        DemDTCClassRef = DTCClass_DTC_0X9A041E
        DemExtendedDataClassRef = ExtendedDataClass_83dcefb7
        DemFreezeFrameClassRef = FreezeFrameClass_fb82c988
        DemEventClass:  # Diagnostics Data Import
          DemAgingAllowed = true
          DemAgingCycleCounterThreshold = 80
          DemEventDestination = DEM_DTC_ORIGIN_PRIMARY_MEMORY
          DemEventPriority = 0
          DemEventFailureCycleCounterThreshold = 0
          DemAgingCycleRef = PowerCycle
          DemEnableConditionGroupRef = EnableConditionGroup_b30aa5c2
          DemOperationCycleRef = PowerCycle
          DemDebounceAlgorithmClass  # Diagnostics Data Import
            DemDebounceCounterBased: DemDebounceCounterDecrementStepSize=1, DemDebounceCounterIncrementStepSize=1, DemDebounceCounterJumpDown=false, DemDebounceCounterJumpUp=false  # Diagnostics Data Import
      DTCClass_DTC_0X9A041E (DemDTCClass): DemDTCSeverity=DEM_DTC_SEV_MAINTENANCE_ONLY, DemUdsDTC=10093598  # Diagnostics Data Import
      DTC_0X9A0413 (DemEventParameter):  # Diagnostics Data Import
        DemEventKind = DEM_EVENT_KIND_SWC
        DemMaxNumberFreezeFrameRecords = 1
        DemDTCClassRef = DTCClass_DTC_0X9A0413
        DemExtendedDataClassRef = ExtendedDataClass_83dcefb7
        DemFreezeFrameClassRef = FreezeFrameClass_fb82c988
        DemEventClass:  # Diagnostics Data Import
          DemAgingAllowed = true
          DemAgingCycleCounterThreshold = 80
          DemEventDestination = DEM_DTC_ORIGIN_PRIMARY_MEMORY
          DemEventPriority = 0
          DemEventFailureCycleCounterThreshold = 0
          DemAgingCycleRef = PowerCycle
          DemEnableConditionGroupRef = EnableConditionGroup_b30aa5c2
          DemOperationCycleRef = PowerCycle
          DemDebounceAlgorithmClass  # Diagnostics Data Import
            DemDebounceCounterBased: DemDebounceCounterDecrementStepSize=1, DemDebounceCounterIncrementStepSize=1, DemDebounceCounterJumpDown=false, DemDebounceCounterJumpUp=false  # Diagnostics Data Import
      DTCClass_DTC_0X9A0413 (DemDTCClass): DemDTCSeverity=DEM_DTC_SEV_MAINTENANCE_ONLY, DemUdsDTC=10093587  # Diagnostics Data Import
      DTC_0X9A0412 (DemEventParameter):  # Diagnostics Data Import
        DemEventKind = DEM_EVENT_KIND_SWC
        DemMaxNumberFreezeFrameRecords = 1
        DemDTCClassRef = DTCClass_DTC_0X9A0412
        DemExtendedDataClassRef = ExtendedDataClass_83dcefb7
        DemFreezeFrameClassRef = FreezeFrameClass_fb82c988
        DemEventClass:  # Diagnostics Data Import
          DemAgingAllowed = true
          DemAgingCycleCounterThreshold = 80
          DemEventDestination = DEM_DTC_ORIGIN_PRIMARY_MEMORY
          DemEventPriority = 0
          DemEventFailureCycleCounterThreshold = 0
          DemAgingCycleRef = PowerCycle
          DemEnableConditionGroupRef = EnableConditionGroup_b30aa5c2
          DemOperationCycleRef = PowerCycle
          DemDebounceAlgorithmClass  # Diagnostics Data Import
            DemDebounceCounterBased: DemDebounceCounterDecrementStepSize=1, DemDebounceCounterIncrementStepSize=1, DemDebounceCounterJumpDown=false, DemDebounceCounterJumpUp=false  # Diagnostics Data Import
      DTCClass_DTC_0X9A0412 (DemDTCClass): DemDTCSeverity=DEM_DTC_SEV_MAINTENANCE_ONLY, DemUdsDTC=10093586  # Diagnostics Data Import
      DTC_0X9A0411 (DemEventParameter):  # Diagnostics Data Import
        DemEventKind = DEM_EVENT_KIND_SWC
        DemMaxNumberFreezeFrameRecords = 1
        DemDTCClassRef = DTCClass_DTC_0X9A0411
        DemExtendedDataClassRef = ExtendedDataClass_83dcefb7
        DemFreezeFrameClassRef = FreezeFrameClass_fb82c988
        DemEventClass:  # Diagnostics Data Import
          DemAgingAllowed = true
          DemAgingCycleCounterThreshold = 80
          DemEventDestination = DEM_DTC_ORIGIN_PRIMARY_MEMORY
          DemEventPriority = 0
          DemEventFailureCycleCounterThreshold = 0
          DemAgingCycleRef = PowerCycle
          DemEnableConditionGroupRef = EnableConditionGroup_b30aa5c2
          DemOperationCycleRef = PowerCycle
          DemDebounceAlgorithmClass  # Diagnostics Data Import
            DemDebounceCounterBased: DemDebounceCounterDecrementStepSize=1, DemDebounceCounterIncrementStepSize=1, DemDebounceCounterJumpDown=false, DemDebounceCounterJumpUp=false  # Diagnostics Data Import
      DTCClass_DTC_0X9A0411 (DemDTCClass): DemDTCSeverity=DEM_DTC_SEV_MAINTENANCE_ONLY, DemUdsDTC=10093585  # Diagnostics Data Import
      DTC_0X9A0401 (DemEventParameter):  # Diagnostics Data Import
        DemEventKind = DEM_EVENT_KIND_SWC
        DemMaxNumberFreezeFrameRecords = 1
        DemDTCClassRef = DTCClass_DTC_0X9A0401
        DemExtendedDataClassRef = ExtendedDataClass_83dcefb7
        DemFreezeFrameClassRef = FreezeFrameClass_fb82c988
        DemEventClass:  # Diagnostics Data Import
          DemAgingAllowed = true
          DemAgingCycleCounterThreshold = 80
          DemEventDestination = DEM_DTC_ORIGIN_PRIMARY_MEMORY
          DemEventPriority = 0
          DemEventFailureCycleCounterThreshold = 0
          DemAgingCycleRef = PowerCycle
          DemEnableConditionGroupRef = EnableConditionGroup_b30aa5c2
          DemOperationCycleRef = PowerCycle
          DemDebounceAlgorithmClass  # Diagnostics Data Import
            DemDebounceCounterBased: DemDebounceCounterDecrementStepSize=1, DemDebounceCounterIncrementStepSize=1, DemDebounceCounterJumpDown=false, DemDebounceCounterJumpUp=false  # Diagnostics Data Import
      DTCClass_DTC_0X9A0401 (DemDTCClass): DemDTCSeverity=DEM_DTC_SEV_MAINTENANCE_ONLY, DemUdsDTC=10093569  # Diagnostics Data Import
      DTC_0X9A0325 (DemEventParameter):  # Diagnostics Data Import
        DemEventKind = DEM_EVENT_KIND_SWC
        DemMaxNumberFreezeFrameRecords = 1
        DemDTCClassRef = DTCClass_DTC_0X9A0325
        DemExtendedDataClassRef = ExtendedDataClass_83dcefb7
        DemFreezeFrameClassRef = FreezeFrameClass_fb82c988
        DemEventClass:  # Diagnostics Data Import
          DemAgingAllowed = true
          DemAgingCycleCounterThreshold = 80
          DemEventDestination = DEM_DTC_ORIGIN_PRIMARY_MEMORY
          DemEventPriority = 0
          DemEventFailureCycleCounterThreshold = 0
          DemAgingCycleRef = PowerCycle
          DemEnableConditionGroupRef = EnableConditionGroup_b30aa5c2
          DemOperationCycleRef = PowerCycle
          DemDebounceAlgorithmClass  # Diagnostics Data Import
            DemDebounceCounterBased: DemDebounceCounterDecrementStepSize=1, DemDebounceCounterIncrementStepSize=1, DemDebounceCounterJumpDown=false, DemDebounceCounterJumpUp=false  # Diagnostics Data Import
      DTCClass_DTC_0X9A0325 (DemDTCClass): DemDTCSeverity=DEM_DTC_SEV_MAINTENANCE_ONLY, DemUdsDTC=10093349  # Diagnostics Data Import
      DTC_0X9A031E (DemEventParameter):  # Diagnostics Data Import
        DemEventKind = DEM_EVENT_KIND_SWC
        DemMaxNumberFreezeFrameRecords = 1
        DemDTCClassRef = DTCClass_DTC_0X9A031E
        DemExtendedDataClassRef = ExtendedDataClass_83dcefb7
        DemFreezeFrameClassRef = FreezeFrameClass_fb82c988
        DemEventClass:  # Diagnostics Data Import
          DemAgingAllowed = true
          DemAgingCycleCounterThreshold = 80
          DemEventDestination = DEM_DTC_ORIGIN_PRIMARY_MEMORY
          DemEventPriority = 0
          DemEventFailureCycleCounterThreshold = 0
          DemAgingCycleRef = PowerCycle
          DemEnableConditionGroupRef = EnableConditionGroup_b30aa5c2
          DemOperationCycleRef = PowerCycle
          DemDebounceAlgorithmClass  # Diagnostics Data Import
            DemDebounceCounterBased: DemDebounceCounterDecrementStepSize=1, DemDebounceCounterIncrementStepSize=1, DemDebounceCounterJumpDown=false, DemDebounceCounterJumpUp=false  # Diagnostics Data Import
      DTCClass_DTC_0X9A031E (DemDTCClass): DemDTCSeverity=DEM_DTC_SEV_MAINTENANCE_ONLY, DemUdsDTC=10093342  # Diagnostics Data Import
      DTC_0X9A0313 (DemEventParameter):  # Diagnostics Data Import
        DemEventKind = DEM_EVENT_KIND_SWC
        DemMaxNumberFreezeFrameRecords = 1
        DemDTCClassRef = DTCClass_DTC_0X9A0313
        DemExtendedDataClassRef = ExtendedDataClass_83dcefb7
        DemFreezeFrameClassRef = FreezeFrameClass_fb82c988
        DemEventClass:  # Diagnostics Data Import
          DemAgingAllowed = true
          DemAgingCycleCounterThreshold = 80
          DemEventDestination = DEM_DTC_ORIGIN_PRIMARY_MEMORY
          DemEventPriority = 0
          DemEventFailureCycleCounterThreshold = 0
          DemAgingCycleRef = PowerCycle
          DemEnableConditionGroupRef = EnableConditionGroup_b30aa5c2
          DemOperationCycleRef = PowerCycle
          DemDebounceAlgorithmClass  # Diagnostics Data Import
            DemDebounceCounterBased: DemDebounceCounterDecrementStepSize=1, DemDebounceCounterIncrementStepSize=1, DemDebounceCounterJumpDown=false, DemDebounceCounterJumpUp=false  # Diagnostics Data Import
      DTCClass_DTC_0X9A0313 (DemDTCClass): DemDTCSeverity=DEM_DTC_SEV_MAINTENANCE_ONLY, DemUdsDTC=10093331  # Diagnostics Data Import
      DTC_0X9A0312 (DemEventParameter):  # Diagnostics Data Import
        DemEventKind = DEM_EVENT_KIND_SWC
        DemMaxNumberFreezeFrameRecords = 1
        DemDTCClassRef = DTCClass_DTC_0X9A0312
        DemExtendedDataClassRef = ExtendedDataClass_83dcefb7
        DemFreezeFrameClassRef = FreezeFrameClass_fb82c988
        DemEventClass:  # Diagnostics Data Import
          DemAgingAllowed = true
          DemAgingCycleCounterThreshold = 80
          DemEventDestination = DEM_DTC_ORIGIN_PRIMARY_MEMORY
          DemEventPriority = 0
          DemEventFailureCycleCounterThreshold = 0
          DemAgingCycleRef = PowerCycle
          DemEnableConditionGroupRef = EnableConditionGroup_b30aa5c2
          DemOperationCycleRef = PowerCycle
          DemDebounceAlgorithmClass  # Diagnostics Data Import
            DemDebounceCounterBased: DemDebounceCounterDecrementStepSize=1, DemDebounceCounterIncrementStepSize=1, DemDebounceCounterJumpDown=false, DemDebounceCounterJumpUp=false  # Diagnostics Data Import
      DTCClass_DTC_0X9A0312 (DemDTCClass): DemDTCSeverity=DEM_DTC_SEV_MAINTENANCE_ONLY, DemUdsDTC=10093330  # Diagnostics Data Import
      DTC_0X9A0311 (DemEventParameter):  # Diagnostics Data Import
        DemEventKind = DEM_EVENT_KIND_SWC
        DemMaxNumberFreezeFrameRecords = 1
        DemDTCClassRef = DTCClass_DTC_0X9A0311
        DemExtendedDataClassRef = ExtendedDataClass_83dcefb7
        DemFreezeFrameClassRef = FreezeFrameClass_fb82c988
        DemEventClass:  # Diagnostics Data Import
          DemAgingAllowed = true
          DemAgingCycleCounterThreshold = 80
          DemEventDestination = DEM_DTC_ORIGIN_PRIMARY_MEMORY
          DemEventPriority = 0
          DemEventFailureCycleCounterThreshold = 0
          DemAgingCycleRef = PowerCycle
          DemEnableConditionGroupRef = EnableConditionGroup_b30aa5c2
          DemOperationCycleRef = PowerCycle
          DemDebounceAlgorithmClass  # Diagnostics Data Import
            DemDebounceCounterBased: DemDebounceCounterDecrementStepSize=1, DemDebounceCounterIncrementStepSize=1, DemDebounceCounterJumpDown=false, DemDebounceCounterJumpUp=false  # Diagnostics Data Import
      DTCClass_DTC_0X9A0311 (DemDTCClass): DemDTCSeverity=DEM_DTC_SEV_MAINTENANCE_ONLY, DemUdsDTC=10093329  # Diagnostics Data Import
      DTC_0X9A0301 (DemEventParameter):  # Diagnostics Data Import
        DemEventKind = DEM_EVENT_KIND_SWC
        DemMaxNumberFreezeFrameRecords = 1
        DemDTCClassRef = DTCClass_DTC_0X9A0301
        DemExtendedDataClassRef = ExtendedDataClass_83dcefb7
        DemFreezeFrameClassRef = FreezeFrameClass_fb82c988
        DemEventClass:  # Diagnostics Data Import
          DemAgingAllowed = true
          DemAgingCycleCounterThreshold = 80
          DemEventDestination = DEM_DTC_ORIGIN_PRIMARY_MEMORY
          DemEventPriority = 0
          DemEventFailureCycleCounterThreshold = 0
          DemAgingCycleRef = PowerCycle
          DemEnableConditionGroupRef = EnableConditionGroup_b30aa5c2
          DemOperationCycleRef = PowerCycle
          DemDebounceAlgorithmClass  # Diagnostics Data Import
            DemDebounceCounterBased: DemDebounceCounterDecrementStepSize=1, DemDebounceCounterIncrementStepSize=1, DemDebounceCounterJumpDown=false, DemDebounceCounterJumpUp=false  # Diagnostics Data Import
      DTCClass_DTC_0X9A0301 (DemDTCClass): DemDTCSeverity=DEM_DTC_SEV_MAINTENANCE_ONLY, DemUdsDTC=10093313  # Diagnostics Data Import
      DTC_0X9A0225 (DemEventParameter):  # Diagnostics Data Import
        DemEventKind = DEM_EVENT_KIND_SWC
        DemMaxNumberFreezeFrameRecords = 1
        DemDTCClassRef = DTCClass_DTC_0X9A0225
        DemExtendedDataClassRef = ExtendedDataClass_83dcefb7
        DemFreezeFrameClassRef = FreezeFrameClass_fb82c988
        DemEventClass:  # Diagnostics Data Import
          DemAgingAllowed = true
          DemAgingCycleCounterThreshold = 80
          DemEventDestination = DEM_DTC_ORIGIN_PRIMARY_MEMORY
          DemEventPriority = 0
          DemEventFailureCycleCounterThreshold = 0
          DemAgingCycleRef = PowerCycle
          DemEnableConditionGroupRef = EnableConditionGroup_b30aa5c2
          DemOperationCycleRef = PowerCycle
          DemDebounceAlgorithmClass  # Diagnostics Data Import
            DemDebounceCounterBased: DemDebounceCounterDecrementStepSize=1, DemDebounceCounterIncrementStepSize=1, DemDebounceCounterJumpDown=false, DemDebounceCounterJumpUp=false  # Diagnostics Data Import
      DTCClass_DTC_0X9A0225 (DemDTCClass): DemDTCSeverity=DEM_DTC_SEV_MAINTENANCE_ONLY, DemUdsDTC=10093093  # Diagnostics Data Import
      DTC_0X9A021E (DemEventParameter):  # Diagnostics Data Import
        DemEventKind = DEM_EVENT_KIND_SWC
        DemMaxNumberFreezeFrameRecords = 1
        DemDTCClassRef = DTCClass_DTC_0X9A021E
        DemExtendedDataClassRef = ExtendedDataClass_83dcefb7
        DemFreezeFrameClassRef = FreezeFrameClass_fb82c988
        DemEventClass:  # Diagnostics Data Import
          DemAgingAllowed = true
          DemAgingCycleCounterThreshold = 80
          DemEventDestination = DEM_DTC_ORIGIN_PRIMARY_MEMORY
          DemEventPriority = 0
          DemEventFailureCycleCounterThreshold = 0
          DemAgingCycleRef = PowerCycle
          DemEnableConditionGroupRef = EnableConditionGroup_b30aa5c2
          DemOperationCycleRef = PowerCycle
          DemDebounceAlgorithmClass  # Diagnostics Data Import
            DemDebounceCounterBased: DemDebounceCounterDecrementStepSize=1, DemDebounceCounterIncrementStepSize=1, DemDebounceCounterJumpDown=false, DemDebounceCounterJumpUp=false  # Diagnostics Data Import
      DTCClass_DTC_0X9A021E (DemDTCClass): DemDTCSeverity=DEM_DTC_SEV_MAINTENANCE_ONLY, DemUdsDTC=10093086  # Diagnostics Data Import
      DTC_0X9A0213 (DemEventParameter):  # Diagnostics Data Import
        DemEventKind = DEM_EVENT_KIND_SWC
        DemMaxNumberFreezeFrameRecords = 1
        DemDTCClassRef = DTCClass_DTC_0X9A0213
        DemExtendedDataClassRef = ExtendedDataClass_83dcefb7
        DemFreezeFrameClassRef = FreezeFrameClass_fb82c988
        DemEventClass:  # Diagnostics Data Import
          DemAgingAllowed = true
          DemAgingCycleCounterThreshold = 80
          DemEventDestination = DEM_DTC_ORIGIN_PRIMARY_MEMORY
          DemEventPriority = 0
          DemEventFailureCycleCounterThreshold = 0
          DemAgingCycleRef = PowerCycle
          DemEnableConditionGroupRef = EnableConditionGroup_b30aa5c2
          DemOperationCycleRef = PowerCycle
          DemDebounceAlgorithmClass  # Diagnostics Data Import
            DemDebounceCounterBased: DemDebounceCounterDecrementStepSize=1, DemDebounceCounterIncrementStepSize=1, DemDebounceCounterJumpDown=false, DemDebounceCounterJumpUp=false  # Diagnostics Data Import
      DTCClass_DTC_0X9A0213 (DemDTCClass): DemDTCSeverity=DEM_DTC_SEV_MAINTENANCE_ONLY, DemUdsDTC=10093075  # Diagnostics Data Import
      DTC_0X9A0212 (DemEventParameter):  # Diagnostics Data Import
        DemEventKind = DEM_EVENT_KIND_SWC
        DemMaxNumberFreezeFrameRecords = 1
        DemDTCClassRef = DTCClass_DTC_0X9A0212
        DemExtendedDataClassRef = ExtendedDataClass_83dcefb7
        DemFreezeFrameClassRef = FreezeFrameClass_fb82c988
        DemEventClass:  # Diagnostics Data Import
          DemAgingAllowed = true
          DemAgingCycleCounterThreshold = 80
          DemEventDestination = DEM_DTC_ORIGIN_PRIMARY_MEMORY
          DemEventPriority = 0
          DemEventFailureCycleCounterThreshold = 0
          DemAgingCycleRef = PowerCycle
          DemEnableConditionGroupRef = EnableConditionGroup_b30aa5c2
          DemOperationCycleRef = PowerCycle
          DemDebounceAlgorithmClass  # Diagnostics Data Import
            DemDebounceCounterBased: DemDebounceCounterDecrementStepSize=1, DemDebounceCounterIncrementStepSize=1, DemDebounceCounterJumpDown=false, DemDebounceCounterJumpUp=false  # Diagnostics Data Import
      DTCClass_DTC_0X9A0212 (DemDTCClass): DemDTCSeverity=DEM_DTC_SEV_MAINTENANCE_ONLY, DemUdsDTC=10093074  # Diagnostics Data Import
      DTC_0X9A0211 (DemEventParameter):  # Diagnostics Data Import
        DemEventKind = DEM_EVENT_KIND_SWC
        DemMaxNumberFreezeFrameRecords = 1
        DemDTCClassRef = DTCClass_DTC_0X9A0211
        DemExtendedDataClassRef = ExtendedDataClass_83dcefb7
        DemFreezeFrameClassRef = FreezeFrameClass_fb82c988
        DemEventClass:  # Diagnostics Data Import
          DemAgingAllowed = true
          DemAgingCycleCounterThreshold = 80
          DemEventDestination = DEM_DTC_ORIGIN_PRIMARY_MEMORY
          DemEventPriority = 0
          DemEventFailureCycleCounterThreshold = 0
          DemAgingCycleRef = PowerCycle
          DemEnableConditionGroupRef = EnableConditionGroup_b30aa5c2
          DemOperationCycleRef = PowerCycle
          DemDebounceAlgorithmClass  # Diagnostics Data Import
            DemDebounceCounterBased: DemDebounceCounterDecrementStepSize=1, DemDebounceCounterIncrementStepSize=1, DemDebounceCounterJumpDown=false, DemDebounceCounterJumpUp=false  # Diagnostics Data Import
      DTCClass_DTC_0X9A0211 (DemDTCClass): DemDTCSeverity=DEM_DTC_SEV_MAINTENANCE_ONLY, DemUdsDTC=10093073  # Diagnostics Data Import
      DTC_0X9A0201 (DemEventParameter):  # Diagnostics Data Import
        DemEventKind = DEM_EVENT_KIND_SWC
        DemMaxNumberFreezeFrameRecords = 1
        DemDTCClassRef = DTCClass_DTC_0X9A0201
        DemExtendedDataClassRef = ExtendedDataClass_83dcefb7
        DemFreezeFrameClassRef = FreezeFrameClass_fb82c988
        DemEventClass:  # Diagnostics Data Import
          DemAgingAllowed = true
          DemAgingCycleCounterThreshold = 80
          DemEventDestination = DEM_DTC_ORIGIN_PRIMARY_MEMORY
          DemEventPriority = 0
          DemEventFailureCycleCounterThreshold = 0
          DemAgingCycleRef = PowerCycle
          DemEnableConditionGroupRef = EnableConditionGroup_b30aa5c2
          DemOperationCycleRef = PowerCycle
          DemDebounceAlgorithmClass  # Diagnostics Data Import
            DemDebounceCounterBased: DemDebounceCounterDecrementStepSize=1, DemDebounceCounterIncrementStepSize=1, DemDebounceCounterJumpDown=false, DemDebounceCounterJumpUp=false  # Diagnostics Data Import
      DTCClass_DTC_0X9A0201 (DemDTCClass): DemDTCSeverity=DEM_DTC_SEV_MAINTENANCE_ONLY, DemUdsDTC=10093057  # Diagnostics Data Import
      DTC_0X9A0125 (DemEventParameter):  # Diagnostics Data Import
        DemEventKind = DEM_EVENT_KIND_SWC
        DemMaxNumberFreezeFrameRecords = 1
        DemDTCClassRef = DTCClass_DTC_0X9A0125
        DemExtendedDataClassRef = ExtendedDataClass_83dcefb7
        DemFreezeFrameClassRef = FreezeFrameClass_fb82c988
        DemEventClass:  # Diagnostics Data Import
          DemAgingAllowed = true
          DemAgingCycleCounterThreshold = 80
          DemEventDestination = DEM_DTC_ORIGIN_PRIMARY_MEMORY
          DemEventPriority = 0
          DemEventFailureCycleCounterThreshold = 0
          DemAgingCycleRef = PowerCycle
          DemEnableConditionGroupRef = EnableConditionGroup_b30aa5c2
          DemOperationCycleRef = PowerCycle
          DemDebounceAlgorithmClass  # Diagnostics Data Import
            DemDebounceCounterBased: DemDebounceCounterDecrementStepSize=1, DemDebounceCounterIncrementStepSize=1, DemDebounceCounterJumpDown=false, DemDebounceCounterJumpUp=false  # Diagnostics Data Import
      DTCClass_DTC_0X9A0125 (DemDTCClass): DemDTCSeverity=DEM_DTC_SEV_MAINTENANCE_ONLY, DemUdsDTC=10092837  # Diagnostics Data Import
      DTC_0X9A011E (DemEventParameter):  # Diagnostics Data Import
        DemEventKind = DEM_EVENT_KIND_SWC
        DemMaxNumberFreezeFrameRecords = 1
        DemDTCClassRef = DTCClass_DTC_0X9A011E
        DemExtendedDataClassRef = ExtendedDataClass_83dcefb7
        DemFreezeFrameClassRef = FreezeFrameClass_fb82c988
        DemEventClass:  # Diagnostics Data Import
          DemAgingAllowed = true
          DemAgingCycleCounterThreshold = 80
          DemEventDestination = DEM_DTC_ORIGIN_PRIMARY_MEMORY
          DemEventPriority = 0
          DemEventFailureCycleCounterThreshold = 0
          DemAgingCycleRef = PowerCycle
          DemEnableConditionGroupRef = EnableConditionGroup_b30aa5c2
          DemOperationCycleRef = PowerCycle
          DemDebounceAlgorithmClass  # Diagnostics Data Import
            DemDebounceCounterBased: DemDebounceCounterDecrementStepSize=1, DemDebounceCounterIncrementStepSize=1, DemDebounceCounterJumpDown=false, DemDebounceCounterJumpUp=false  # Diagnostics Data Import
      DTCClass_DTC_0X9A011E (DemDTCClass): DemDTCSeverity=DEM_DTC_SEV_MAINTENANCE_ONLY, DemUdsDTC=10092830  # Diagnostics Data Import
      DTC_0X9A0113 (DemEventParameter):  # Diagnostics Data Import
        DemEventKind = DEM_EVENT_KIND_SWC
        DemMaxNumberFreezeFrameRecords = 1
        DemDTCClassRef = DTCClass_DTC_0X9A0113
        DemExtendedDataClassRef = ExtendedDataClass_83dcefb7
        DemFreezeFrameClassRef = FreezeFrameClass_fb82c988
        DemEventClass:  # Diagnostics Data Import
          DemAgingAllowed = true
          DemAgingCycleCounterThreshold = 80
          DemEventDestination = DEM_DTC_ORIGIN_PRIMARY_MEMORY
          DemEventPriority = 0
          DemEventFailureCycleCounterThreshold = 0
          DemAgingCycleRef = PowerCycle
          DemEnableConditionGroupRef = EnableConditionGroup_b30aa5c2
          DemOperationCycleRef = PowerCycle
          DemDebounceAlgorithmClass  # Diagnostics Data Import
            DemDebounceCounterBased: DemDebounceCounterDecrementStepSize=1, DemDebounceCounterIncrementStepSize=1, DemDebounceCounterJumpDown=false, DemDebounceCounterJumpUp=false  # Diagnostics Data Import
      DTCClass_DTC_0X9A0113 (DemDTCClass): DemDTCSeverity=DEM_DTC_SEV_MAINTENANCE_ONLY, DemUdsDTC=10092819  # Diagnostics Data Import
      DTC_0X9A0112 (DemEventParameter):  # Diagnostics Data Import
        DemEventKind = DEM_EVENT_KIND_SWC
        DemMaxNumberFreezeFrameRecords = 1
        DemDTCClassRef = DTCClass_DTC_0X9A0112
        DemExtendedDataClassRef = ExtendedDataClass_83dcefb7
        DemFreezeFrameClassRef = FreezeFrameClass_fb82c988
        DemEventClass:  # Diagnostics Data Import
          DemAgingAllowed = true
          DemAgingCycleCounterThreshold = 80
          DemEventDestination = DEM_DTC_ORIGIN_PRIMARY_MEMORY
          DemEventPriority = 0
          DemEventFailureCycleCounterThreshold = 0
          DemAgingCycleRef = PowerCycle
          DemEnableConditionGroupRef = EnableConditionGroup_b30aa5c2
          DemOperationCycleRef = PowerCycle
          DemDebounceAlgorithmClass  # Diagnostics Data Import
            DemDebounceCounterBased: DemDebounceCounterDecrementStepSize=1, DemDebounceCounterIncrementStepSize=1, DemDebounceCounterJumpDown=false, DemDebounceCounterJumpUp=false  # Diagnostics Data Import
      DTCClass_DTC_0X9A0112 (DemDTCClass): DemDTCSeverity=DEM_DTC_SEV_MAINTENANCE_ONLY, DemUdsDTC=10092818  # Diagnostics Data Import
      DTC_0X9A0111 (DemEventParameter):  # Diagnostics Data Import
        DemEventKind = DEM_EVENT_KIND_SWC
        DemMaxNumberFreezeFrameRecords = 1
        DemDTCClassRef = DTCClass_DTC_0X9A0111
        DemExtendedDataClassRef = ExtendedDataClass_83dcefb7
        DemFreezeFrameClassRef = FreezeFrameClass_fb82c988
        DemEventClass:  # Diagnostics Data Import
          DemAgingAllowed = true
          DemAgingCycleCounterThreshold = 80
          DemEventDestination = DEM_DTC_ORIGIN_PRIMARY_MEMORY
          DemEventPriority = 0
          DemEventFailureCycleCounterThreshold = 0
          DemAgingCycleRef = PowerCycle
          DemEnableConditionGroupRef = EnableConditionGroup_b30aa5c2
          DemOperationCycleRef = PowerCycle
          DemDebounceAlgorithmClass  # Diagnostics Data Import
            DemDebounceCounterBased: DemDebounceCounterDecrementStepSize=1, DemDebounceCounterIncrementStepSize=1, DemDebounceCounterJumpDown=false, DemDebounceCounterJumpUp=false  # Diagnostics Data Import
      DTCClass_DTC_0X9A0111 (DemDTCClass): DemDTCSeverity=DEM_DTC_SEV_MAINTENANCE_ONLY, DemUdsDTC=10092817  # Diagnostics Data Import
      DTC_0X9A0101 (DemEventParameter):  # Diagnostics Data Import
        DemEventKind = DEM_EVENT_KIND_SWC
        DemMaxNumberFreezeFrameRecords = 1
        DemDTCClassRef = DTCClass_DTC_0X9A0101
        DemExtendedDataClassRef = ExtendedDataClass_83dcefb7
        DemFreezeFrameClassRef = FreezeFrameClass_fb82c988
        DemEventClass:  # Diagnostics Data Import
          DemAgingAllowed = true
          DemAgingCycleCounterThreshold = 80
          DemEventDestination = DEM_DTC_ORIGIN_PRIMARY_MEMORY
          DemEventPriority = 0
          DemEventFailureCycleCounterThreshold = 0
          DemAgingCycleRef = PowerCycle
          DemEnableConditionGroupRef = EnableConditionGroup_b30aa5c2
          DemOperationCycleRef = PowerCycle
          DemDebounceAlgorithmClass  # Diagnostics Data Import
            DemDebounceCounterBased: DemDebounceCounterDecrementStepSize=1, DemDebounceCounterIncrementStepSize=1, DemDebounceCounterJumpDown=false, DemDebounceCounterJumpUp=false  # Diagnostics Data Import
      DTCClass_DTC_0X9A0101 (DemDTCClass): DemDTCSeverity=DEM_DTC_SEV_MAINTENANCE_ONLY, DemUdsDTC=10092801  # Diagnostics Data Import
      DTC_0X93F613 (DemEventParameter):  # Diagnostics Data Import
        DemEventKind = DEM_EVENT_KIND_SWC
        DemMaxNumberFreezeFrameRecords = 1
        DemDTCClassRef = DTCClass_DTC_0X93F613
        DemExtendedDataClassRef = ExtendedDataClass_83dcefb7
        DemFreezeFrameClassRef = FreezeFrameClass_fb82c988
        DemEventClass:  # Diagnostics Data Import
          DemAgingAllowed = true
          DemAgingCycleCounterThreshold = 80
          DemEventDestination = DEM_DTC_ORIGIN_PRIMARY_MEMORY
          DemEventPriority = 0
          DemEventFailureCycleCounterThreshold = 0
          DemAgingCycleRef = PowerCycle
          DemEnableConditionGroupRef = EnableConditionGroup_b30aa5c2
          DemOperationCycleRef = PowerCycle
          DemDebounceAlgorithmClass  # Diagnostics Data Import
            DemDebounceCounterBased: DemDebounceCounterDecrementStepSize=1, DemDebounceCounterIncrementStepSize=1, DemDebounceCounterJumpDown=false, DemDebounceCounterJumpUp=false  # Diagnostics Data Import
      DTCClass_DTC_0X93F613 (DemDTCClass): DemDTCSeverity=DEM_DTC_SEV_CHECK_AT_NEXT_HALT, DemUdsDTC=9696787  # Diagnostics Data Import
      DTC_0X93F612 (DemEventParameter):  # Diagnostics Data Import
        DemEventKind = DEM_EVENT_KIND_SWC
        DemMaxNumberFreezeFrameRecords = 1
        DemDTCClassRef = DTCClass_DTC_0X93F612
        DemExtendedDataClassRef = ExtendedDataClass_83dcefb7
        DemFreezeFrameClassRef = FreezeFrameClass_fb82c988
        DemEventClass:  # Diagnostics Data Import
          DemAgingAllowed = true
          DemAgingCycleCounterThreshold = 80
          DemEventDestination = DEM_DTC_ORIGIN_PRIMARY_MEMORY
          DemEventPriority = 0
          DemEventFailureCycleCounterThreshold = 0
          DemAgingCycleRef = PowerCycle
          DemEnableConditionGroupRef = EnableConditionGroup_b30aa5c2
          DemOperationCycleRef = PowerCycle
          DemDebounceAlgorithmClass  # Diagnostics Data Import
            DemDebounceCounterBased: DemDebounceCounterDecrementStepSize=1, DemDebounceCounterIncrementStepSize=1, DemDebounceCounterJumpDown=false, DemDebounceCounterJumpUp=false  # Diagnostics Data Import
      DTCClass_DTC_0X93F612 (DemDTCClass): DemDTCSeverity=DEM_DTC_SEV_CHECK_AT_NEXT_HALT, DemUdsDTC=9696786  # Diagnostics Data Import
      DTC_0X93F611 (DemEventParameter):  # Diagnostics Data Import
        DemEventKind = DEM_EVENT_KIND_SWC
        DemMaxNumberFreezeFrameRecords = 1
        DemDTCClassRef = DTCClass_DTC_0X93F611
        DemExtendedDataClassRef = ExtendedDataClass_83dcefb7
        DemFreezeFrameClassRef = FreezeFrameClass_fb82c988
        DemEventClass:  # Diagnostics Data Import
          DemAgingAllowed = true
          DemAgingCycleCounterThreshold = 80
          DemEventDestination = DEM_DTC_ORIGIN_PRIMARY_MEMORY
          DemEventPriority = 0
          DemEventFailureCycleCounterThreshold = 0
          DemAgingCycleRef = PowerCycle
          DemEnableConditionGroupRef = EnableConditionGroup_b30aa5c2
          DemOperationCycleRef = PowerCycle
          DemDebounceAlgorithmClass  # Diagnostics Data Import
            DemDebounceCounterBased: DemDebounceCounterDecrementStepSize=1, DemDebounceCounterIncrementStepSize=1, DemDebounceCounterJumpDown=false, DemDebounceCounterJumpUp=false  # Diagnostics Data Import
      DTCClass_DTC_0X93F611 (DemDTCClass): DemDTCSeverity=DEM_DTC_SEV_CHECK_AT_NEXT_HALT, DemUdsDTC=9696785  # Diagnostics Data Import
      DTC_0X93F513 (DemEventParameter):  # Diagnostics Data Import
        DemEventKind = DEM_EVENT_KIND_SWC
        DemMaxNumberFreezeFrameRecords = 1
        DemDTCClassRef = DTCClass_DTC_0X93F513
        DemExtendedDataClassRef = ExtendedDataClass_83dcefb7
        DemFreezeFrameClassRef = FreezeFrameClass_fb82c988
        DemEventClass:  # Diagnostics Data Import
          DemAgingAllowed = true
          DemAgingCycleCounterThreshold = 80
          DemEventDestination = DEM_DTC_ORIGIN_PRIMARY_MEMORY
          DemEventPriority = 0
          DemEventFailureCycleCounterThreshold = 0
          DemAgingCycleRef = PowerCycle
          DemEnableConditionGroupRef = EnableConditionGroup_b30aa5c2
          DemOperationCycleRef = PowerCycle
          DemDebounceAlgorithmClass  # Diagnostics Data Import
            DemDebounceCounterBased: DemDebounceCounterDecrementStepSize=1, DemDebounceCounterIncrementStepSize=1, DemDebounceCounterJumpDown=false, DemDebounceCounterJumpUp=false  # Diagnostics Data Import
      DTCClass_DTC_0X93F513 (DemDTCClass): DemDTCSeverity=DEM_DTC_SEV_CHECK_AT_NEXT_HALT, DemUdsDTC=9696531  # Diagnostics Data Import
      DTC_0X93F512 (DemEventParameter):  # Diagnostics Data Import
        DemEventKind = DEM_EVENT_KIND_SWC
        DemMaxNumberFreezeFrameRecords = 1
        DemDTCClassRef = DTCClass_DTC_0X93F512
        DemExtendedDataClassRef = ExtendedDataClass_83dcefb7
        DemFreezeFrameClassRef = FreezeFrameClass_fb82c988
        DemEventClass:  # Diagnostics Data Import
          DemAgingAllowed = true
          DemAgingCycleCounterThreshold = 80
          DemEventDestination = DEM_DTC_ORIGIN_PRIMARY_MEMORY
          DemEventPriority = 0
          DemEventFailureCycleCounterThreshold = 0
          DemAgingCycleRef = PowerCycle
          DemEnableConditionGroupRef = EnableConditionGroup_b30aa5c2
          DemOperationCycleRef = PowerCycle
          DemDebounceAlgorithmClass  # Diagnostics Data Import
            DemDebounceCounterBased: DemDebounceCounterDecrementStepSize=1, DemDebounceCounterIncrementStepSize=1, DemDebounceCounterJumpDown=false, DemDebounceCounterJumpUp=false  # Diagnostics Data Import
      DTCClass_DTC_0X93F512 (DemDTCClass): DemDTCSeverity=DEM_DTC_SEV_CHECK_AT_NEXT_HALT, DemUdsDTC=9696530  # Diagnostics Data Import
      DTC_0X93F511 (DemEventParameter):  # Diagnostics Data Import
        DemEventKind = DEM_EVENT_KIND_SWC
        DemMaxNumberFreezeFrameRecords = 1
        DemDTCClassRef = DTCClass_DTC_0X93F511
        DemExtendedDataClassRef = ExtendedDataClass_83dcefb7
        DemFreezeFrameClassRef = FreezeFrameClass_fb82c988
        DemEventClass:  # Diagnostics Data Import
          DemAgingAllowed = true
          DemAgingCycleCounterThreshold = 80
          DemEventDestination = DEM_DTC_ORIGIN_PRIMARY_MEMORY
          DemEventPriority = 0
          DemEventFailureCycleCounterThreshold = 0
          DemAgingCycleRef = PowerCycle
          DemEnableConditionGroupRef = EnableConditionGroup_b30aa5c2
          DemOperationCycleRef = PowerCycle
          DemDebounceAlgorithmClass  # Diagnostics Data Import
            DemDebounceCounterBased: DemDebounceCounterDecrementStepSize=1, DemDebounceCounterIncrementStepSize=1, DemDebounceCounterJumpDown=false, DemDebounceCounterJumpUp=false  # Diagnostics Data Import
      DTCClass_DTC_0X93F511 (DemDTCClass): DemDTCSeverity=DEM_DTC_SEV_CHECK_AT_NEXT_HALT, DemUdsDTC=9696529  # Diagnostics Data Import
      DTC_0X925411 (DemEventParameter):  # Diagnostics Data Import
        DemEventKind = DEM_EVENT_KIND_SWC
        DemMaxNumberFreezeFrameRecords = 1
        DemDTCClassRef = DTCClass_DTC_0X925411
        DemExtendedDataClassRef = ExtendedDataClass_83dcefb7
        DemFreezeFrameClassRef = FreezeFrameClass_fb82c988
        DemEventClass:  # Diagnostics Data Import
          DemAgingAllowed = true
          DemAgingCycleCounterThreshold = 80
          DemEventDestination = DEM_DTC_ORIGIN_PRIMARY_MEMORY
          DemEventPriority = 0
          DemEventFailureCycleCounterThreshold = 0
          DemAgingCycleRef = PowerCycle
          DemEnableConditionGroupRef = EnableConditionGroup_b30aa5c2
          DemOperationCycleRef = PowerCycle
          DemDebounceAlgorithmClass  # Diagnostics Data Import
            DemDebounceCounterBased: DemDebounceCounterDecrementStepSize=1, DemDebounceCounterIncrementStepSize=1, DemDebounceCounterJumpDown=false, DemDebounceCounterJumpUp=false  # Diagnostics Data Import
      DTCClass_DTC_0X925411 (DemDTCClass): DemDTCSeverity=DEM_DTC_SEV_MAINTENANCE_ONLY, DemUdsDTC=9589762  # Diagnostics Data Import
      DTC_0X925311 (DemEventParameter):  # Diagnostics Data Import
        DemEventKind = DEM_EVENT_KIND_SWC
        DemMaxNumberFreezeFrameRecords = 1
        DemDTCClassRef = DTCClass_DTC_0X925311
        DemExtendedDataClassRef = ExtendedDataClass_83dcefb7
        DemFreezeFrameClassRef = FreezeFrameClass_fb82c988
        DemEventClass:  # Diagnostics Data Import
          DemAgingAllowed = true
          DemAgingCycleCounterThreshold = 80
          DemEventDestination = DEM_DTC_ORIGIN_PRIMARY_MEMORY
          DemEventPriority = 0
          DemEventFailureCycleCounterThreshold = 0
          DemAgingCycleRef = PowerCycle
          DemEnableConditionGroupRef = EnableConditionGroup_b30aa5c2
          DemOperationCycleRef = PowerCycle
          DemDebounceAlgorithmClass  # Diagnostics Data Import
            DemDebounceCounterBased: DemDebounceCounterDecrementStepSize=1, DemDebounceCounterIncrementStepSize=1, DemDebounceCounterJumpDown=false, DemDebounceCounterJumpUp=false  # Diagnostics Data Import
      DTCClass_DTC_0X925311 (DemDTCClass): DemDTCSeverity=DEM_DTC_SEV_MAINTENANCE_ONLY, DemUdsDTC=9589506  # Diagnostics Data Import
      DTC_0X925211 (DemEventParameter):  # Diagnostics Data Import
        DemEventKind = DEM_EVENT_KIND_SWC
        DemMaxNumberFreezeFrameRecords = 1
        DemDTCClassRef = DTCClass_DTC_0X925211
        DemExtendedDataClassRef = ExtendedDataClass_83dcefb7
        DemFreezeFrameClassRef = FreezeFrameClass_fb82c988
        DemEventClass:  # Diagnostics Data Import
          DemAgingAllowed = true
          DemAgingCycleCounterThreshold = 80
          DemEventDestination = DEM_DTC_ORIGIN_PRIMARY_MEMORY
          DemEventPriority = 0
          DemEventFailureCycleCounterThreshold = 0
          DemAgingCycleRef = PowerCycle
          DemEnableConditionGroupRef = EnableConditionGroup_b30aa5c2
          DemOperationCycleRef = PowerCycle
          DemDebounceAlgorithmClass  # Diagnostics Data Import
            DemDebounceCounterBased: DemDebounceCounterDecrementStepSize=1, DemDebounceCounterIncrementStepSize=1, DemDebounceCounterJumpDown=false, DemDebounceCounterJumpUp=false  # Diagnostics Data Import
      DTCClass_DTC_0X925211 (DemDTCClass): DemDTCSeverity=DEM_DTC_SEV_MAINTENANCE_ONLY, DemUdsDTC=9589250  # Diagnostics Data Import
      DTC_0X923817 (DemEventParameter):  # Diagnostics Data Import
        DemEventKind = DEM_EVENT_KIND_SWC
        DemMaxNumberFreezeFrameRecords = 1
        DemDTCClassRef = DTCClass_DTC_0X923817
        DemExtendedDataClassRef = ExtendedDataClass_83dcefb7
        DemFreezeFrameClassRef = FreezeFrameClass_fb82c988
        DemEventClass:  # Diagnostics Data Import
          DemAgingAllowed = true
          DemAgingCycleCounterThreshold = 80
          DemEventDestination = DEM_DTC_ORIGIN_PRIMARY_MEMORY
          DemEventPriority = 0
          DemEventFailureCycleCounterThreshold = 0
          DemAgingCycleRef = PowerCycle
          DemEnableConditionGroupRef = EnableConditionGroup_b30aa5c2
          DemOperationCycleRef = PowerCycle
          DemDebounceAlgorithmClass  # Diagnostics Data Import
            DemDebounceCounterBased: DemDebounceCounterDecrementStepSize=1, DemDebounceCounterIncrementStepSize=1, DemDebounceCounterJumpDown=false, DemDebounceCounterJumpUp=false  # Diagnostics Data Import
      DTCClass_DTC_0X923817 (DemDTCClass): DemDTCSeverity=DEM_DTC_SEV_MAINTENANCE_ONLY, DemUdsDTC=9582615  # Diagnostics Data Import
      DTC_0X923816 (DemEventParameter):  # Diagnostics Data Import
        DemEventKind = DEM_EVENT_KIND_SWC
        DemMaxNumberFreezeFrameRecords = 1
        DemDTCClassRef = DTCClass_DTC_0X923816
        DemExtendedDataClassRef = ExtendedDataClass_83dcefb7
        DemFreezeFrameClassRef = FreezeFrameClass_fb82c988
        DemEventClass:  # Diagnostics Data Import
          DemAgingAllowed = true
          DemAgingCycleCounterThreshold = 80
          DemEventDestination = DEM_DTC_ORIGIN_PRIMARY_MEMORY
          DemEventPriority = 0
          DemEventFailureCycleCounterThreshold = 0
          DemAgingCycleRef = PowerCycle
          DemEnableConditionGroupRef = EnableConditionGroup_b30aa5c2
          DemOperationCycleRef = PowerCycle
          DemDebounceAlgorithmClass  # Diagnostics Data Import
            DemDebounceCounterBased: DemDebounceCounterDecrementStepSize=1, DemDebounceCounterIncrementStepSize=1, DemDebounceCounterJumpDown=false, DemDebounceCounterJumpUp=false  # Diagnostics Data Import
      DTCClass_DTC_0X923816 (DemDTCClass): DemDTCSeverity=DEM_DTC_SEV_MAINTENANCE_ONLY, DemUdsDTC=9582614  # Diagnostics Data Import
      DTC_0X91BA63 (DemEventParameter):  # Diagnostics Data Import
        DemEventKind = DEM_EVENT_KIND_SWC
        DemMaxNumberFreezeFrameRecords = 1
        DemDTCClassRef = DTCClass_DTC_0X91BA63
        DemExtendedDataClassRef = ExtendedDataClass_83dcefb7
        DemFreezeFrameClassRef = FreezeFrameClass_fb82c988
        DemEventClass:  # Diagnostics Data Import
          DemAgingAllowed = true
          DemAgingCycleCounterThreshold = 80
          DemEventDestination = DEM_DTC_ORIGIN_PRIMARY_MEMORY
          DemEventPriority = 0
          DemEventFailureCycleCounterThreshold = 0
          DemAgingCycleRef = PowerCycle
          DemEnableConditionGroupRef = EnableConditionGroup_5fbd712e
          DemOperationCycleRef = PowerCycle
          DemDebounceAlgorithmClass  # Diagnostics Data Import
            DemDebounceCounterBased: DemDebounceCounterDecrementStepSize=1, DemDebounceCounterIncrementStepSize=1, DemDebounceCounterJumpDown=false, DemDebounceCounterJumpUp=false  # Diagnostics Data Import
      DTCClass_DTC_0X91BA63 (DemDTCClass): DemDTCSeverity=DEM_DTC_SEV_CHECK_AT_NEXT_HALT, DemUdsDTC=9550435  # Diagnostics Data Import
      DTC_0X919F13 (DemEventParameter):  # Diagnostics Data Import
        DemEventKind = DEM_EVENT_KIND_SWC
        DemMaxNumberFreezeFrameRecords = 1
        DemDTCClassRef = DTCClass_DTC_0X919F13
        DemExtendedDataClassRef = ExtendedDataClass_83dcefb7
        DemFreezeFrameClassRef = FreezeFrameClass_fb82c988
        DemEventClass:  # Diagnostics Data Import
          DemAgingAllowed = true
          DemAgingCycleCounterThreshold = 80
          DemEventDestination = DEM_DTC_ORIGIN_PRIMARY_MEMORY
          DemEventPriority = 0
          DemEventFailureCycleCounterThreshold = 0
          DemAgingCycleRef = PowerCycle
          DemEnableConditionGroupRef = EnableConditionGroup_b30aa5c2
          DemOperationCycleRef = PowerCycle
          DemDebounceAlgorithmClass  # Diagnostics Data Import
            DemDebounceCounterBased: DemDebounceCounterDecrementStepSize=1, DemDebounceCounterIncrementStepSize=1, DemDebounceCounterJumpDown=false, DemDebounceCounterJumpUp=false  # Diagnostics Data Import
      DTCClass_DTC_0X919F13 (DemDTCClass): DemDTCSeverity=DEM_DTC_SEV_CHECK_AT_NEXT_HALT, DemUdsDTC=9543443  # Diagnostics Data Import
      DTC_0X919F12 (DemEventParameter):  # Diagnostics Data Import
        DemEventKind = DEM_EVENT_KIND_SWC
        DemMaxNumberFreezeFrameRecords = 1
        DemDTCClassRef = DTCClass_DTC_0X919F12
        DemExtendedDataClassRef = ExtendedDataClass_83dcefb7
        DemFreezeFrameClassRef = FreezeFrameClass_fb82c988
        DemEventClass:  # Diagnostics Data Import
          DemAgingAllowed = true
          DemAgingCycleCounterThreshold = 80
          DemEventDestination = DEM_DTC_ORIGIN_PRIMARY_MEMORY
          DemEventPriority = 0
          DemEventFailureCycleCounterThreshold = 0
          DemAgingCycleRef = PowerCycle
          DemEnableConditionGroupRef = EnableConditionGroup_b30aa5c2
          DemOperationCycleRef = PowerCycle
          DemDebounceAlgorithmClass  # Diagnostics Data Import
            DemDebounceCounterBased: DemDebounceCounterDecrementStepSize=1, DemDebounceCounterIncrementStepSize=1, DemDebounceCounterJumpDown=false, DemDebounceCounterJumpUp=false  # Diagnostics Data Import
      DTCClass_DTC_0X919F12 (DemDTCClass): DemDTCSeverity=DEM_DTC_SEV_CHECK_AT_NEXT_HALT, DemUdsDTC=9543442  # Diagnostics Data Import
      DTC_0X919F11 (DemEventParameter):  # Diagnostics Data Import
        DemEventKind = DEM_EVENT_KIND_SWC
        DemMaxNumberFreezeFrameRecords = 1
        DemDTCClassRef = DTCClass_DTC_0X919F11
        DemExtendedDataClassRef = ExtendedDataClass_83dcefb7
        DemFreezeFrameClassRef = FreezeFrameClass_fb82c988
        DemEventClass:  # Diagnostics Data Import
          DemAgingAllowed = true
          DemAgingCycleCounterThreshold = 80
          DemEventDestination = DEM_DTC_ORIGIN_PRIMARY_MEMORY
          DemEventPriority = 0
          DemEventFailureCycleCounterThreshold = 0
          DemAgingCycleRef = PowerCycle
          DemEnableConditionGroupRef = EnableConditionGroup_b30aa5c2
          DemOperationCycleRef = PowerCycle
          DemDebounceAlgorithmClass  # Diagnostics Data Import
            DemDebounceCounterBased: DemDebounceCounterDecrementStepSize=1, DemDebounceCounterIncrementStepSize=1, DemDebounceCounterJumpDown=false, DemDebounceCounterJumpUp=false  # Diagnostics Data Import
      DTCClass_DTC_0X919F11 (DemDTCClass): DemDTCSeverity=DEM_DTC_SEV_CHECK_AT_NEXT_HALT, DemUdsDTC=9543441  # Diagnostics Data Import
      DTC_0X909602 (DemEventParameter):  # Diagnostics Data Import
        DemEventKind = DEM_EVENT_KIND_SWC
        DemMaxNumberFreezeFrameRecords = 1
        DemDTCClassRef = DTCClass_DTC_0X909602
        DemExtendedDataClassRef = ExtendedDataClass_83dcefb7
        DemFreezeFrameClassRef = FreezeFrameClass_fb82c988
        DemEventClass:  # Diagnostics Data Import
          DemAgingAllowed = true
          DemAgingCycleCounterThreshold = 80
          DemEventDestination = DEM_DTC_ORIGIN_PRIMARY_MEMORY
          DemEventPriority = 0
          DemEventFailureCycleCounterThreshold = 0
          DemAgingCycleRef = PowerCycle
          DemEnableConditionGroupRef = EnableConditionGroup_b30aa5c2
          DemOperationCycleRef = PowerCycle
          DemDebounceAlgorithmClass  # Diagnostics Data Import
            DemDebounceCounterBased: DemDebounceCounterDecrementStepSize=1, DemDebounceCounterIncrementStepSize=1, DemDebounceCounterJumpDown=false, DemDebounceCounterJumpUp=false  # Diagnostics Data Import
      DTCClass_DTC_0X909602 (DemDTCClass): DemDTCSeverity=DEM_DTC_SEV_MAINTENANCE_ONLY, DemUdsDTC=9475586  # Diagnostics Data Import
      DTC_0X909502 (DemEventParameter):  # Diagnostics Data Import
        DemEventKind = DEM_EVENT_KIND_SWC
        DemMaxNumberFreezeFrameRecords = 1
        DemDTCClassRef = DTCClass_DTC_0X909502
        DemExtendedDataClassRef = ExtendedDataClass_83dcefb7
        DemFreezeFrameClassRef = FreezeFrameClass_fb82c988
        DemEventClass:  # Diagnostics Data Import
          DemAgingAllowed = true
          DemAgingCycleCounterThreshold = 80
          DemEventDestination = DEM_DTC_ORIGIN_PRIMARY_MEMORY
          DemEventPriority = 0
          DemEventFailureCycleCounterThreshold = 0
          DemAgingCycleRef = PowerCycle
          DemEnableConditionGroupRef = EnableConditionGroup_b30aa5c2
          DemOperationCycleRef = PowerCycle
          DemDebounceAlgorithmClass  # Diagnostics Data Import
            DemDebounceCounterBased: DemDebounceCounterDecrementStepSize=1, DemDebounceCounterIncrementStepSize=1, DemDebounceCounterJumpDown=false, DemDebounceCounterJumpUp=false  # Diagnostics Data Import
      DTCClass_DTC_0X909502 (DemDTCClass): DemDTCSeverity=DEM_DTC_SEV_MAINTENANCE_ONLY, DemUdsDTC=9475330  # Diagnostics Data Import
      DTC_0X908E87 (DemEventParameter):  # Diagnostics Data Import
        DemEventKind = DEM_EVENT_KIND_SWC
        DemMaxNumberFreezeFrameRecords = 1
        DemDTCClassRef = DTCClass_DTC_0X908E87
        DemExtendedDataClassRef = ExtendedDataClass_83dcefb7
        DemFreezeFrameClassRef = FreezeFrameClass_fb82c988
        DemEventClass:  # Diagnostics Data Import
          DemAgingAllowed = true
          DemAgingCycleCounterThreshold = 80
          DemEventDestination = DEM_DTC_ORIGIN_PRIMARY_MEMORY
          DemEventPriority = 0
          DemEventFailureCycleCounterThreshold = 0
          DemAgingCycleRef = PowerCycle
          DemEnableConditionGroupRef = EnableConditionGroup_3e8e3f33
          DemOperationCycleRef = PowerCycle
          DemDebounceAlgorithmClass  # Diagnostics Data Import
            DemDebounceCounterBased: DemDebounceCounterDecrementStepSize=1, DemDebounceCounterIncrementStepSize=1, DemDebounceCounterJumpDown=false, DemDebounceCounterJumpUp=false  # Diagnostics Data Import
      DTCClass_DTC_0X908E87 (DemDTCClass): DemDTCSeverity=DEM_DTC_SEV_CHECK_AT_NEXT_HALT, DemUdsDTC=9473671  # Diagnostics Data Import
  module config EcuC
    EcucPduCollection: PduIdTypeEnum=UINT8, PduLengthTypeEnum=UINT8
      39 x Pdu:
        GlobalTimeMaster_oCAN_48f281bc_Rx: PduLength=8, SysTPduToFrameMappingRef=GlobalTimeMaster
        MyECU_dcffebb2_Rx: PduLength=8
        msg_RxCycle100_0_oCAN_1e247d16_Rx: PduLength=1
        msg_RxCycle100_0_oCAN_c71398f9_Rx: PduLength=1, SysTPduToFrameMappingRef=msg_RxCycle100_0
        msg_RxCycle500_20_oCAN_266969e8_Rx: PduLength=6, SysTPduToFrameMappingRef=msg_RxCycle500_20
        msg_RxCycle500_20_oCAN_a691adb3_Rx: PduLength=6
        msg_RxCycle_E2eProf1C_500_10_oCAN_23e9789c_Rx: PduLength=8, SysTPduToFrameMappingRef=msg_RxCycle_E2eProf1C_500_10
        msg_RxCycle_E2eProf1C_500_10_oCAN_e8110737_Rx: PduLength=8
        msg_RxEvent_20_oCAN_13517c6b_Rx: PduLength=4, SysTPduToFrameMappingRef=msg_RxEvent_20
        msg_RxEvent_20_oCAN_a1df81ad_Rx: PduLength=4
        msg_StartAppl_Rx_MyECU_oCAN_0da3c1e2_Rx: PduLength=8
        msg_StartAppl_Rx_MyECU_oCAN_fe93a56e_Rx: PduLength=8, SysTPduToFrameMappingRef=msg_StartAppl_Rx_MyECU
        msg_StartAppl_Tx_MyECU_oCAN_ad461e3f_Tx: PduLength=8
        msg_StartAppl_Tx_MyECU_oCAN_c14d78df_Tx: PduLength=8, SysTPduToFrameMappingRef=msg_StartAppl_Tx_MyECU
        msg_TxCycle1000_10_oCAN_6dd6f284_Tx: PduLength=2, SysTPduToFrameMappingRef=msg_TxCycle1000_10
        msg_TxCycle1000_10_oCAN_d74aed68_Tx: PduLength=2
        msg_TxCycle10_0_oCAN_2d7b6a87_Tx: PduLength=7, SysTPduToFrameMappingRef=msg_TxCycle10_0
        msg_TxCycle10_0_oCAN_85bf3e37_Tx: PduLength=7
        msg_TxCycle_E2eProf1C_500_30_oCAN_995018f6_Tx: PduLength=8, SysTPduToFrameMappingRef=msg_TxCycle_E2eProf1C_500_30
        msg_TxCycle_E2eProf1C_500_30_oCAN_eeefc687_Tx: PduLength=8
        msg_TxEvent_10_oCAN_b2cd4fc2_Tx: PduLength=7
        msg_TxEvent_10_oCAN_b9443fef_Tx: PduLength=7, SysTPduToFrameMappingRef=msg_TxEvent_10
        msg_XCP_Request_MyECU_oCAN_24ce420e_Rx: PduLength=8, SysTPduToFrameMappingRef=msg_XCP_Request_MyECU
        msg_XCP_Response_MyECU_oCAN_5d942f8b_Tx: PduLength=8, SysTPduToFrameMappingRef=msg_XCP_Response_MyECU
        msg_diag_RequestGlobal_Tp_oCAN_2ced7a67_Rx: PduLength=8, SysTPduToFrameMappingRef=msg_diag_RequestGlobal_Tp
        msg_diag_RequestGlobal_oCAN_2eba11fb_Rx: PduLength=7
        msg_diag_RequestGlobal_oCAN_e06c7e2d_Rx: PduLength=7
        msg_diag_Request_MyECU_Slave3_oCAN_87f08505_Rx: PduLength=8, SysTPduToFrameMappingRef=msg_diag_Request_MyECU_Slave3
        msg_diag_Request_MyECU_Tp_oCAN_44a1d668_Rx: PduLength=8, SysTPduToFrameMappingRef=msg_diag_Request_MyECU_Tp
        msg_diag_Request_MyECU_oCAN_ca029ee7_Rx: PduLength=8
        msg_diag_Request_MyECU_oCAN_cd2e72ff_Rx: PduLength=8
        msg_diag_Response_MyECU_Slave3_oCAN_659398e3_Tx: PduLength=8, SysTPduToFrameMappingRef=msg_diag_Response_MyECU_Slave3
        msg_diag_Response_MyECU_Tp_oCAN_eec7d8e8_Tx: PduLength=8, SysTPduToFrameMappingRef=msg_diag_Response_MyECU_Tp
        msg_diag_Response_MyECU_oCAN_06426912_Tx: PduLength=8
        msg_diag_Response_MyECU_oCAN_84acb98b_Tx: PduLength=8
        msg_diag_Uudt_Response_MyECU_oCAN_e0fa8c3a_Tx: PduLength=8, SysTPduToFrameMappingRef=msg_diag_Uudt_Response_MyECU
        msg_diag_Uudt_Response_MyECU_oCAN_f130d337_Tx: PduLength=8
        msg_nm_MyECU_oCAN_9090bd79_Tx: PduLength=8, SysTPduToFrameMappingRef=msg_nm_MyECU
        msg_nm_MyECU_oCAN_c97b60cc_Tx: PduLength=6
  module config EcuM
    EcuMConfiguration
      EcuMCommonConfiguration
        EcuMDriverInitListOne
        EcuMDriverRestartList
        CN_CAN_fe6ecc87 (EcuMWakeupSource): EcuMWakeupSourceId=5, EcuMComMChannelRef=ComMConfigSet/CN_CAN_fe6ecc87
      EcuMFlexConfiguration: EcuMFlexModuleConfigurationRef=CanConfigSet
  module config Nm
    CN_CAN_fe6ecc87 (NmChannelConfig): NmComMChannelRef=ComMConfigSet/CN_CAN_fe6ecc87
      CAN_5f8bc0cc (NmBusType)
        NmStandardBusNmConfig: NmStandardBusType=NM_BUSNM_CANNM  # CAN
    NmGlobalConfig
      NmGlobalFeatures: NmComUserDataSupport=true, NmNodeIdEnabled=true, NmUserDataEnabled=true
      NmGlobalProperties
  module config PduR
    PduRGeneral
    PduRRoutingTables
      PduRRoutingTable
        15 x PduRRoutingPath:
          msg_RxCycle100_0_oCAN_c71398f9_Rx
            msg_RxCycle100_0_oCAN_c71398f9_Rx_9e00b2d3_Rx (PduRDestPdu): PduRDestPduRef=EcucPduCollection/msg_RxCycle100_0_oCAN_1e247d16_Rx
            PduRSrcPdu_9e00b2d3 (PduRSrcPdu): PduRSrcPduRef=EcucPduCollection/msg_RxCycle100_0_oCAN_c71398f9_Rx
          msg_RxCycle500_20_oCAN_266969e8_Rx
            msg_RxCycle500_20_oCAN_266969e8_Rx_b1d1dd8a_Rx (PduRDestPdu): PduRDestPduRef=EcucPduCollection/msg_RxCycle500_20_oCAN_a691adb3_Rx
            PduRSrcPdu_b1d1dd8a (PduRSrcPdu): PduRSrcPduRef=EcucPduCollection/msg_RxCycle500_20_oCAN_266969e8_Rx
          msg_RxCycle_E2eProf1C_500_10_oCAN_23e9789c_Rx
            msg_RxCycle_E2eProf1C_500_10_oCAN_23e9789c_Rx_01c8980f_Rx (PduRDestPdu): PduRDestPduRef=EcucPduCollection/msg_RxCycle_E2eProf1C_500_10_oCAN_e8110737_Rx
            PduRSrcPdu_01c8980f (PduRSrcPdu): PduRSrcPduRef=EcucPduCollection/msg_RxCycle_E2eProf1C_500_10_oCAN_23e9789c_Rx
          msg_RxEvent_20_oCAN_13517c6b_Rx
            msg_RxEvent_20_oCAN_13517c6b_Rx_37e6280b_Rx (PduRDestPdu): PduRDestPduRef=EcucPduCollection/msg_RxEvent_20_oCAN_a1df81ad_Rx
            PduRSrcPdu_37e6280b (PduRSrcPdu): PduRSrcPduRef=EcucPduCollection/msg_RxEvent_20_oCAN_13517c6b_Rx
          msg_StartAppl_Rx_MyECU_oCAN_fe93a56e_Rx
            msg_StartAppl_Rx_MyECU_oCAN_fe93a56e_Rx_7a86d966_Rx (PduRDestPdu): PduRDestPduRef=EcucPduCollection/msg_StartAppl_Rx_MyECU_oCAN_0da3c1e2_Rx
            PduRSrcPdu_7a86d966 (PduRSrcPdu): PduRSrcPduRef=EcucPduCollection/msg_StartAppl_Rx_MyECU_oCAN_fe93a56e_Rx
          msg_StartAppl_Tx_MyECU_oCAN_ad461e3f_Tx
            msg_StartAppl_Tx_MyECU_oCAN_c14d78df_Tx (PduRDestPdu): PduRDestPduRef=EcucPduCollection/msg_StartAppl_Tx_MyECU_oCAN_c14d78df_Tx
            PduRSrcPdu_cd5f4416 (PduRSrcPdu): PduRSrcPduRef=EcucPduCollection/msg_StartAppl_Tx_MyECU_oCAN_ad461e3f_Tx
          msg_TxCycle1000_10_oCAN_d74aed68_Tx
            msg_TxCycle1000_10_oCAN_6dd6f284_Tx (PduRDestPdu): PduRDestPduRef=EcucPduCollection/msg_TxCycle1000_10_oCAN_6dd6f284_Tx
            PduRSrcPdu_704563f1 (PduRSrcPdu): PduRSrcPduRef=EcucPduCollection/msg_TxCycle1000_10_oCAN_d74aed68_Tx
          msg_TxCycle10_0_oCAN_85bf3e37_Tx
            msg_TxCycle10_0_oCAN_2d7b6a87_Tx (PduRDestPdu): PduRDestPduRef=EcucPduCollection/msg_TxCycle10_0_oCAN_2d7b6a87_Tx
            PduRSrcPdu_2e41d513 (PduRSrcPdu): PduRSrcPduRef=EcucPduCollection/msg_TxCycle10_0_oCAN_85bf3e37_Tx
          msg_TxCycle_E2eProf1C_500_30_oCAN_eeefc687_Tx
            msg_TxCycle_E2eProf1C_500_30_oCAN_995018f6_Tx (PduRDestPdu): PduRDestPduRef=EcucPduCollection/msg_TxCycle_E2eProf1C_500_30_oCAN_995018f6_Tx
            PduRSrcPdu_c3d2922e (PduRSrcPdu): PduRSrcPduRef=EcucPduCollection/msg_TxCycle_E2eProf1C_500_30_oCAN_eeefc687_Tx
          msg_TxEvent_10_oCAN_b2cd4fc2_Tx
            msg_TxEvent_10_oCAN_b9443fef_Tx (PduRDestPdu): PduRDestPduRef=EcucPduCollection/msg_TxEvent_10_oCAN_b9443fef_Tx
            PduRSrcPdu_36788591 (PduRSrcPdu): PduRSrcPduRef=EcucPduCollection/msg_TxEvent_10_oCAN_b2cd4fc2_Tx
          msg_diag_RequestGlobal_oCAN_e06c7e2d_Rx
            msg_diag_RequestGlobal_oCAN_e06c7e2d_Rx_c958f031_Rx (PduRDestPdu): PduRDestPduRef=msg_diag_RequestGlobal_oCAN_2eba11fb_Rx
            PduRSrcPdu_c958f031 (PduRSrcPdu): PduRSrcPduRef=EcucPduCollection/msg_diag_RequestGlobal_oCAN_e06c7e2d_Rx
          msg_diag_Request_MyECU_oCAN_ca029ee7_Rx
            msg_diag_Request_MyECU_oCAN_ca029ee7_Rx_9fd2cbe7_Rx (PduRDestPdu): PduRDestPduRef=msg_diag_Request_MyECU_oCAN_cd2e72ff_Rx
            PduRSrcPdu_9fd2cbe7 (PduRSrcPdu): PduRSrcPduRef=EcucPduCollection/msg_diag_Request_MyECU_oCAN_ca029ee7_Rx
          msg_diag_Response_MyECU_oCAN_06426912_Tx
            msg_diag_Response_MyECU_oCAN_84acb98b_Tx (PduRDestPdu): PduRDestPduRef=EcucPduCollection/msg_diag_Response_MyECU_oCAN_84acb98b_Tx
            PduRSrcPdu_f3446321 (PduRSrcPdu): PduRSrcPduRef=EcucPduCollection/msg_diag_Response_MyECU_oCAN_06426912_Tx
          msg_diag_Uudt_Response_MyECU_oCAN_f130d337_Tx
            msg_diag_Uudt_Response_MyECU_oCAN_e0fa8c3a_Tx (PduRDestPdu): PduRDestPduRef=EcucPduCollection/msg_diag_Uudt_Response_MyECU_oCAN_e0fa8c3a_Tx
            PduRSrcPdu_ec58e685 (PduRSrcPdu): PduRSrcPduRef=EcucPduCollection/msg_diag_Uudt_Response_MyECU_oCAN_f130d337_Tx
          msg_nm_MyECU_oCAN_c97b60cc_Tx
            msg_nm_MyECU_oCAN_c97b60cc_Tx_616fda32_Tx (PduRDestPdu): PduRDestPduRef=EcucPduCollection/msg_nm_MyECU_oCAN_c97b60cc_Tx
            PduRSrcPdu_616fda32 (PduRSrcPdu): PduRSrcPduRef=EcucPduCollection/msg_nm_MyECU_oCAN_c97b60cc_Tx
  module config Xcp
    XcpConfig
      msg_XCP_Request_MyECU_oCAN_24ce420e_Rx (XcpPdu)
        msg_XCP_Request_MyECU_oCAN_24ce420e_Rx (XcpRxPdu): XcpRxPduRef=EcucPduCollection/msg_XCP_Request_MyECU_oCAN_24ce420e_Rx
      msg_XCP_Response_MyECU_oCAN_5d942f8b_Tx (XcpPdu)
        msg_XCP_Response_MyECU_oCAN_5d942f8b_Tx (XcpTxPdu): XcpTxPduRef=EcucPduCollection/msg_XCP_Response_MyECU_oCAN_5d942f8b_Tx
    XcpGeneral
