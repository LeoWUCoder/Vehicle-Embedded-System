AUTOSAR XML (schema 4-2-1)
package /InitialEcuC
  ecuc value collection InitialEcuC: ecuc-values=[Dcm, Dem]
  module config Dcm: module-description=Dcm_Impl
    DcmConfigSet
      DcmDsd
        DcmDsdServiceTable
          13 x DcmDsdService:
            DiagSessionControl: DcmDsdSidTabServiceId=16, DcmDsdSidTabSubfuncAvail=true
              Default (DcmDsdSubService): DcmDsdSubServiceId=1
              Extended (DcmDsdSubService): DcmDsdSubServiceId=3
            EcuReset: DcmDsdSidTabServiceId=17, DcmDsdSidTabSubfuncAvail=true
              Hard (DcmDsdSubService): DcmDsdSubServiceId=1
              Soft (DcmDsdSubService): DcmDsdSubServiceId=3
            ClearDiagInfo: DcmDsdSidTabServiceId=20, DcmDsdSidTabSubfuncAvail=false
            ReadDtcInfo: DcmDsdSidTabServiceId=25, DcmDsdSidTabSubfuncAvail=true
              5 x DcmDsdSubService:
                RDTCBSM: DcmDsdSubServiceId=2
                RNODTCBSM: DcmDsdSubServiceId=1
                RDTCSSBDTC: DcmDsdSubServiceId=4
                RDTCEDRBDN: DcmDsdSubServiceId=6
                RSUPDTC: DcmDsdSubServiceId=10
            ReadDataById: DcmDsdSidTabServiceId=34, DcmDsdSidTabSubfuncAvail=false
            ReadMemoryByAddress: DcmDsdSidTabServiceId=35, DcmDsdSidTabSubfuncAvail=false
            SecurityAccess: DcmDsdSidTabServiceId=39, DcmDsdSidTabSubfuncAvail=true, DcmDsdSidTabSessionLevelRef=DcmDspSession/Extended
              SeedLevel1_Request (DcmDsdSubService): DcmDsdSubServiceId=1, DcmDsdSubServiceSessionLevelRef=DcmDspSession/Extended
              KeyLevel1_Send (DcmDsdSubService): DcmDsdSubServiceId=2, DcmDsdSubServiceSessionLevelRef=DcmDspSession/Extended
            CommunicationControl: DcmDsdSidTabServiceId=40, DcmDsdSidTabSubfuncAvail=true, DcmDsdSidTabSessionLevelRef=DcmDspSession/Extended
              EnableRxAndTx (DcmDsdSubService): DcmDsdSubServiceId=0, DcmDsdSubServiceSessionLevelRef=DcmDspSession/Extended
              DisableRxAndTx (DcmDsdSubService): DcmDsdSubServiceId=3, DcmDsdSubServiceSessionLevelRef=DcmDspSession/Extended
            WriteDataById: DcmDsdSidTabServiceId=46, DcmDsdSidTabSubfuncAvail=false
            RoutineControl: DcmDsdSidTabServiceId=49, DcmDsdSidTabSubfuncAvail=true, DcmDsdSidTabSessionLevelRef=DcmDspSession/Extended, DcmDsdSidTabSecurityLevelRef=UnlockedL1
            WriteMemoryByAddress: DcmDsdSidTabServiceId=61, DcmDsdSidTabSubfuncAvail=false
            TesterPresent: DcmDsdSidTabServiceId=62, DcmDsdSidTabSubfuncAvail=true
              TesterPresent (DcmDsdSubService): DcmDsdSubServiceId=0
            ControlDtcSetting: DcmDsdSidTabServiceId=133, DcmDsdSidTabSubfuncAvail=true, DcmDsdSidTabSessionLevelRef=DcmDspSession/Extended
              Enable (DcmDsdSubService): DcmDsdSubServiceId=1, DcmDsdSubServiceSessionLevelRef=DcmDspSession/Extended
              Disable (DcmDsdSubService): DcmDsdSubServiceId=2, DcmDsdSubServiceSessionLevelRef=DcmDspSession/Extended
      DcmDsp: DcmDspMaxDidToRead=5
        Vehicle_Speed_D001_Vehicle_Speed (DcmDspData): DcmDspDataSize=16, DcmDspDataType=UINT16, DcmDspDataInfoRef=DataInfo_Vehicle_Speed_D001_Vehicle_Speed
        DataInfo_Vehicle_Speed_D001_Vehicle_Speed (DcmDspDataInfo): DcmDspDataFixedLength=true
        Engine_Speed_D002_Engine_Speed (DcmDspData): DcmDspDataSize=16, DcmDspDataType=UINT16, DcmDspDataInfoRef=DataInfo_Engine_Speed_D002_Engine_Speed
        DataInfo_Engine_Speed_D002_Engine_Speed (DcmDspDataInfo): DcmDspDataFixedLength=true
        Operating_Voltage_Value_D003_Operating_Voltage_Value (DcmDspData): DcmDspDataSize=8, DcmDspDataType=UINT8, DcmDspDataInfoRef=DataInfo_Operating_Voltage_Value_D003_Operating_Voltage_Value
        DataInfo_Operating_Voltage_Value_D003_Operating_Voltage_Value (DcmDspDataInfo): DcmDspDataFixedLength=true
        Odometer_D004_Odometer (DcmDspData): DcmDspDataSize=24, DcmDspDataType=UINT8_N, DcmDspDataInfoRef=DataInfo_Odometer_D004_Odometer
        DataInfo_Odometer_D004_Odometer (DcmDspDataInfo): DcmDspDataFixedLength=true
        DTC_Occurrence_Timer_D005_Occure_Time_Inforamation (DcmDspData): DcmDspDataSize=32, DcmDspDataType=UINT32, DcmDspDataInfoRef=DataInfo_DTC_Occurrence_Timer_D005_Occure_Time_Inforamation
        DataInfo_DTC_Occurrence_Timer_D005_Occure_Time_Inforamation (DcmDspDataInfo): DcmDspDataFixedLength=true
        Number_of_installed_cameras_E001_Number_of_installed_cameras (DcmDspData): DcmDspDataSize=8, DcmDspDataType=UINT8, DcmDspDataInfoRef=DataInfo_Number_of_installed_cameras_E001_Number_of_installed_cameras
        DataInfo_Number_of_installed_cameras_E001_Number_of_installed_cameras (DcmDspDataInfo): DcmDspDataFixedLength=true
        Screen_resolution_E002_Width (DcmDspData): DcmDspDataSize=16, DcmDspDataType=UINT16, DcmDspDataInfoRef=DataInfo_Screen_resolution_E002_Width
        DataInfo_Screen_resolution_E002_Width (DcmDspDataInfo): DcmDspDataFixedLength=true
        Screen_resolution_E002_Height (DcmDspData): DcmDspDataSize=16, DcmDspDataType=UINT16, DcmDspDataInfoRef=DataInfo_Screen_resolution_E002_Height
        DataInfo_Screen_resolution_E002_Height (DcmDspDataInfo): DcmDspDataFixedLength=true
        Present_GPS_coordinates_shift_data_E003_GPS_coordinates (DcmDspData): DcmDspDataSize=32, DcmDspDataType=UINT32, DcmDspDataInfoRef=DataInfo_Present_GPS_coordinates_shift_data_E003_GPS_coordinates
        DataInfo_Present_GPS_coordinates_shift_data_E003_GPS_coordinates (DcmDspDataInfo): DcmDspDataFixedLength=true
        Bluetooth_Current_Discoverability_modes_E005_Bluetooth_Current_Discoverability_modes (DcmDspData):
          DcmDspDataSize = 8
          DcmDspDataType = UINT8
          DcmDspDataInfoRef = DataInfo_Bluetooth_Current_Discoverability_modes_E005_Bluetooth_Current_Discoverability_modes
        DataInfo_Bluetooth_Current_Discoverability_modes_E005_Bluetooth_Current_Discoverability_modes (DcmDspDataInfo): DcmDspDataFixedLength=true
        Bluetooth_Status_E006_Bluetooth_Status (DcmDspData): DcmDspDataSize=8, DcmDspDataType=UINT8, DcmDspDataInfoRef=DataInfo_Bluetooth_Status_E006_Bluetooth_Status
        DataInfo_Bluetooth_Status_E006_Bluetooth_Status (DcmDspDataInfo): DcmDspDataFixedLength=true
        BT_Power_Class_E007_BT_Power_Class (DcmDspData): DcmDspDataSize=8, DcmDspDataType=UINT8, DcmDspDataInfoRef=DataInfo_BT_Power_Class_E007_BT_Power_Class
        DataInfo_BT_Power_Class_E007_BT_Power_Class (DcmDspDataInfo): DcmDspDataFixedLength=true
        BT_active_profile_list_E008_BT_active_profile_list (DcmDspData): DcmDspDataSize=8, DcmDspDataType=UINT8, DcmDspDataInfoRef=DataInfo_BT_active_profile_list_E008_BT_active_profile_list
        DataInfo_BT_active_profile_list_E008_BT_active_profile_list (DcmDspDataInfo): DcmDspDataFixedLength=true
        BT_firmware_version_E009_BT_firmware_version (DcmDspData): DcmDspDataSize=128, DcmDspDataType=UINT8_N, DcmDspDataInfoRef=DataInfo_BT_firmware_version_E009_BT_firmware_version
        DataInfo_BT_firmware_version_E009_BT_firmware_version (DcmDspDataInfo): DcmDspDataFixedLength=true
        Audio_jack_status_E00A_Audio_jack_status (DcmDspData): DcmDspDataSize=8, DcmDspDataType=UINT8, DcmDspDataInfoRef=DataInfo_Audio_jack_status_E00A_Audio_jack_status
        DataInfo_Audio_jack_status_E00A_Audio_jack_status (DcmDspDataInfo): DcmDspDataFixedLength=true
        Number_of_external_USB_devices_plugged_E00B_Number_of_external_USB_devices_plugged (DcmDspData):
          DcmDspDataSize = 8
          DcmDspDataType = UINT8
          DcmDspDataInfoRef = DataInfo_Number_of_external_USB_devices_plugged_E00B_Number_of_external_USB_devices_plugged
        DataInfo_Number_of_external_USB_devices_plugged_E00B_Number_of_external_USB_devices_plugged (DcmDspDataInfo): DcmDspDataFixedLength=true
        Currently_connected_USB_Type_E00C_Currently_connected_USB_Type (DcmDspData): DcmDspDataSize=8, DcmDspDataType=UINT8, DcmDspDataInfoRef=DataInfo_Currently_connected_USB_Type_E00C_Currently_connected_USB_Type
        DataInfo_Currently_connected_USB_Type_E00C_Currently_connected_USB_Type (DcmDspDataInfo): DcmDspDataFixedLength=true
        Support_AM_frequency_Min_E00D_Support_AM_frequency_Min (DcmDspData): DcmDspDataSize=32, DcmDspDataType=UINT32, DcmDspDataInfoRef=DataInfo_Support_AM_frequency_Min_E00D_Support_AM_frequency_Min
        DataInfo_Support_AM_frequency_Min_E00D_Support_AM_frequency_Min (DcmDspDataInfo): DcmDspDataFixedLength=true
        Support_AM_frequency_Max_E00E_Support_AM_frequency_Max (DcmDspData): DcmDspDataSize=32, DcmDspDataType=UINT32, DcmDspDataInfoRef=DataInfo_Support_AM_frequency_Max_E00E_Support_AM_frequency_Max
        DataInfo_Support_AM_frequency_Max_E00E_Support_AM_frequency_Max (DcmDspDataInfo): DcmDspDataFixedLength=true
        Support_FM_frequency_Min_E00F_Support_FM_frequency_Min (DcmDspData): DcmDspDataSize=32, DcmDspDataType=UINT32, DcmDspDataInfoRef=DataInfo_Support_FM_frequency_Min_E00F_Support_FM_frequency_Min
        DataInfo_Support_FM_frequency_Min_E00F_Support_FM_frequency_Min (DcmDspDataInfo): DcmDspDataFixedLength=true
        Support_FM_frequency_Max_E010_Support_FM_frequency_Max (DcmDspData): DcmDspDataSize=32, DcmDspDataType=UINT32, DcmDspDataInfoRef=DataInfo_Support_FM_frequency_Max_E010_Support_FM_frequency_Max
        DataInfo_Support_FM_frequency_Max_E010_Support_FM_frequency_Max (DcmDspDataInfo): DcmDspDataFixedLength=true
        AM_signal_Strength_E011_AM_signal_Strength (DcmDspData): DcmDspDataSize=8, DcmDspDataType=UINT8, DcmDspDataInfoRef=DataInfo_AM_signal_Strength_E011_AM_signal_Strength
        DataInfo_AM_signal_Strength_E011_AM_signal_Strength (DcmDspDataInfo): DcmDspDataFixedLength=true
        FM_signal_Strength_E012_FM_signal_Strength (DcmDspData): DcmDspDataSize=8, DcmDspDataType=UINT8, DcmDspDataInfoRef=DataInfo_FM_signal_Strength_E012_FM_signal_Strength
        DataInfo_FM_signal_Strength_E012_FM_signal_Strength (DcmDspDataInfo): DcmDspDataFixedLength=true
        Wi_Fi_Module_Status_E013_Wi_Fi_Module_Status (DcmDspData): DcmDspDataSize=8, DcmDspDataType=UINT8, DcmDspDataInfoRef=DataInfo_Wi_Fi_Module_Status_E013_Wi_Fi_Module_Status
        DataInfo_Wi_Fi_Module_Status_E013_Wi_Fi_Module_Status (DcmDspDataInfo): DcmDspDataFixedLength=true
        Wi_Fi_Module_Firmware_Version_E014_Wi_Fi_Module_Firmware_Version (DcmDspData): DcmDspDataSize=128, DcmDspDataType=UINT8_N, DcmDspDataInfoRef=DataInfo_Wi_Fi_Module_Firmware_Version_E014_Wi_Fi_Module_Firmware_Version
        DataInfo_Wi_Fi_Module_Firmware_Version_E014_Wi_Fi_Module_Firmware_Version (DcmDspDataInfo): DcmDspDataFixedLength=true
        Wi_Fi_Module_Hardware_Part_Number_E015_Wi_Fi_Module_Hardware_Part_Number (DcmDspData): DcmDspDataSize=128, DcmDspDataType=UINT8_N, DcmDspDataInfoRef=DataInfo_Wi_Fi_Module_Hardware_Part_Number_E015_Wi_Fi_Module_Hardware_Part_Number
        DataInfo_Wi_Fi_Module_Hardware_Part_Number_E015_Wi_Fi_Module_Hardware_Part_Number (DcmDspDataInfo): DcmDspDataFixedLength=true
        Tbox_IP_Address_E016_Tbox_IP_Address (DcmDspData): DcmDspDataSize=128, DcmDspDataType=UINT8_N, DcmDspDataInfoRef=DataInfo_Tbox_IP_Address_E016_Tbox_IP_Address
        DataInfo_Tbox_IP_Address_E016_Tbox_IP_Address (DcmDspDataInfo): DcmDspDataFixedLength=true
        Tbox_Gateway_sub_mask_E017_Tbox_Gateway_sub_mask (DcmDspData): DcmDspDataSize=128, DcmDspDataType=UINT8_N, DcmDspDataInfoRef=DataInfo_Tbox_Gateway_sub_mask_E017_Tbox_Gateway_sub_mask
        DataInfo_Tbox_Gateway_sub_mask_E017_Tbox_Gateway_sub_mask (DcmDspDataInfo): DcmDspDataFixedLength=true
        Tbox_Last_connection_lost_time_stamp_E018_Tbox_Last_connection_lost_time_stamp (DcmDspData):
          DcmDspDataSize = 128
          DcmDspDataType = UINT8_N
          DcmDspDataInfoRef = DataInfo_Tbox_Last_connection_lost_time_stamp_E018_Tbox_Last_connection_lost_time_stamp
        DataInfo_Tbox_Last_connection_lost_time_stamp_E018_Tbox_Last_connection_lost_time_stamp (DcmDspDataInfo): DcmDspDataFixedLength=true
        Tbox_geographical_coordinates_when_connection_lost_E019_Tbox_geographical_coordinates_when_connection_lost (DcmDspData):
          DcmDspDataSize = 128
          DcmDspDataType = UINT8_N
          DcmDspDataInfoRef = DataInfo_Tbox_geographical_coordinates_when_connection_lost_E019_Tbox_geographical_coordinates_when_connection_lost
        DataInfo_Tbox_geographical_coordinates_when_connection_lost_E019_Tbox_geographical_coordinates_when_connection_lost (DcmDspDataInfo): DcmDspDataFixedLength=true
        Telematics_Module_Status_E01A_Telematics_Module_Status (DcmDspData): DcmDspDataSize=8, DcmDspDataType=UINT8, DcmDspDataInfoRef=DataInfo_Telematics_Module_Status_E01A_Telematics_Module_Status
        DataInfo_Telematics_Module_Status_E01A_Telematics_Module_Status (DcmDspDataInfo): DcmDspDataFixedLength=true
        Number_of_installed_speakers_E01C_Number_of_installed_speakers (DcmDspData): DcmDspDataSize=8, DcmDspDataType=UINT8, DcmDspDataInfoRef=DataInfo_Number_of_installed_speakers_E01C_Number_of_installed_speakers
        DataInfo_Number_of_installed_speakers_E01C_Number_of_installed_speakers (DcmDspDataInfo): DcmDspDataFixedLength=true
        Vehicle_Manufacture_Spare_Part_Number_F187_Vehicle_Manufacture_Spare_Part_Number (DcmDspData):
          DcmDspDataSize = 120
          DcmDspDataType = UINT8_N
          DcmDspDataInfoRef = DataInfo_Vehicle_Manufacture_Spare_Part_Number_F187_Vehicle_Manufacture_Spare_Part_Number
        DataInfo_Vehicle_Manufacture_Spare_Part_Number_F187_Vehicle_Manufacture_Spare_Part_Number (DcmDspDataInfo): DcmDspDataFixedLength=true
        System_Supplier_Identifier_F18A_System_Supplier_Identifier (DcmDspData): DcmDspDataSize=80, DcmDspDataType=UINT8_N, DcmDspDataInfoRef=DataInfo_System_Supplier_Identifier_F18A_System_Supplier_Identifier
        DataInfo_System_Supplier_Identifier_F18A_System_Supplier_Identifier (DcmDspDataInfo): DcmDspDataFixedLength=true
        ECU_Serial_Number_F18C_ECU_Serial_Number (DcmDspData): DcmDspDataSize=128, DcmDspDataType=UINT8_N, DcmDspDataInfoRef=DataInfo_ECU_Serial_Number_F18C_ECU_Serial_Number
        DataInfo_ECU_Serial_Number_F18C_ECU_Serial_Number (DcmDspDataInfo): DcmDspDataFixedLength=true
        Vehicle_Identification_Number_F190_VIN (DcmDspData): DcmDspDataSize=136, DcmDspDataType=UINT8_N, DcmDspDataInfoRef=DataInfo_Vehicle_Identification_Number_F190_VIN
        DataInfo_Vehicle_Identification_Number_F190_VIN (DcmDspDataInfo): DcmDspDataFixedLength=true
        System_Supplier_ECU_Hardware_Version_Number_F193_Hardware_Version_Number (DcmDspData): DcmDspDataSize=128, DcmDspDataType=UINT8_N, DcmDspDataInfoRef=DataInfo_System_Supplier_ECU_Hardware_Version_Number_F193_Hardware_Version_Number
        DataInfo_System_Supplier_ECU_Hardware_Version_Number_F193_Hardware_Version_Number (DcmDspDataInfo): DcmDspDataFixedLength=true
        System_Supplier_ECU_Software_Version_Number_F195_Software_Version_Number (DcmDspData): DcmDspDataSize=128, DcmDspDataType=UINT8_N, DcmDspDataInfoRef=DataInfo_System_Supplier_ECU_Software_Version_Number_F195_Software_Version_Number
        DataInfo_System_Supplier_ECU_Software_Version_Number_F195_Software_Version_Number (DcmDspDataInfo): DcmDspDataFixedLength=true
        VehicleNetworkConfiguration_F1A1_VehicleNetworkConfiguration (DcmDspData): DcmDspDataSize=136, DcmDspDataType=UINT8_N, DcmDspDataInfoRef=DataInfo_VehicleNetworkConfiguration_F1A1_VehicleNetworkConfiguration
        DataInfo_VehicleNetworkConfiguration_F1A1_VehicleNetworkConfiguration (DcmDspDataInfo): DcmDspDataFixedLength=true
        C_matrix_Version_of_the_ECU_product_F1A2_C_matrix_Version (DcmDspData): DcmDspDataSize=80, DcmDspDataType=UINT8_N, DcmDspDataInfoRef=DataInfo_C_matrix_Version_of_the_ECU_product_F1A2_C_matrix_Version
        DataInfo_C_matrix_Version_of_the_ECU_product_F1A2_C_matrix_Version (DcmDspDataInfo): DcmDspDataFixedLength=true
        AME_Power_Control_FD01_Power_Control (DcmDspData): DcmDspDataSize=8, DcmDspDataType=UINT8, DcmDspDataInfoRef=DataInfo_AME_Power_Control_FD01_Power_Control
        DataInfo_AME_Power_Control_FD01_Power_Control (DcmDspDataInfo): DcmDspDataFixedLength=true
        AME_Switch_BIOS_Mode_FD02_Switch_BIOS (DcmDspData): DcmDspDataSize=8, DcmDspDataType=UINT8, DcmDspDataInfoRef=DataInfo_AME_Switch_BIOS_Mode_FD02_Switch_BIOS
        DataInfo_AME_Switch_BIOS_Mode_FD02_Switch_BIOS (DcmDspDataInfo): DcmDspDataFixedLength=true
        AME_Read_SW_and_HW_Version_FD04_CombinedDataElement (DcmDspData): DcmDspDataSize=400, DcmDspDataType=UINT8_N, DcmDspDataInfoRef=DataInfo_AME_Read_SW_and_HW_Version_FD04_CombinedDataElement
        DataInfo_AME_Read_SW_and_HW_Version_FD04_CombinedDataElement (DcmDspDataInfo): DcmDspDataFixedLength=false
        INVALID_SHORTNAME_AME_Reset_Factory_Mode_FD05_Reset_Factory_Mode (DcmDspData): DcmDspDataSize=8, DcmDspDataType=UINT8, DcmDspDataInfoRef=DataInfo_AME_Reset_Factory_Mode_FD05_Reset_Factory_Mode
        DataInfo_AME_Reset_Factory_Mode_FD05_Reset_Factory_Mode (DcmDspDataInfo): DcmDspDataFixedLength=true
        AME_Read_harman_manufactory_part_number_FD06_Harman_Manufactory_Part_Number (DcmDspData):
          DcmDspDataSize = 224
          DcmDspDataType = UINT8_N
          DcmDspDataInfoRef = DataInfo_AME_Read_harman_manufactory_part_number_FD06_Harman_Manufactory_Part_Number
        DataInfo_AME_Read_harman_manufactory_part_number_FD06_Harman_Manufactory_Part_Number (DcmDspDataInfo): DcmDspDataFixedLength=true
        AME_Write_harman_manufactory_part_number_FD07_Harman_Manufactory_Part_Number (DcmDspData):
          DcmDspDataSize = 224
          DcmDspDataType = UINT8_N
          DcmDspDataInfoRef = DataInfo_AME_Write_harman_manufactory_part_number_FD07_Harman_Manufactory_Part_Number
        DataInfo_AME_Write_harman_manufactory_part_number_FD07_Harman_Manufactory_Part_Number (DcmDspDataInfo): DcmDspDataFixedLength=true
        AME_Read_AME_diagnostic_version_FD08_CombinedDataElement (DcmDspData): DcmDspDataSize=136, DcmDspDataType=UINT8_N, DcmDspDataInfoRef=DataInfo_AME_Read_AME_diagnostic_version_FD08_CombinedDataElement
        DataInfo_AME_Read_AME_diagnostic_version_FD08_CombinedDataElement (DcmDspDataInfo): DcmDspDataFixedLength=false
        AME_Read_FAN_speed_FD11_FAN_Speed (DcmDspData): DcmDspDataSize=8, DcmDspDataType=UINT8, DcmDspDataInfoRef=DataInfo_AME_Read_FAN_speed_FD11_FAN_Speed
        DataInfo_AME_Read_FAN_speed_FD11_FAN_Speed (DcmDspDataInfo): DcmDspDataFixedLength=true
        AME_Set_FAN_speed_FD12_FAN_Speed (DcmDspData): DcmDspDataSize=8, DcmDspDataType=UINT8, DcmDspDataInfoRef=DataInfo_AME_Set_FAN_speed_FD12_FAN_Speed
        DataInfo_AME_Set_FAN_speed_FD12_FAN_Speed (DcmDspDataInfo): DcmDspDataFixedLength=true
        AME_Read_system_temperature_FD13_CombinedDataElement (DcmDspData): DcmDspDataSize=16, DcmDspDataType=UINT8_N, DcmDspDataInfoRef=DataInfo_AME_Read_system_temperature_FD13_CombinedDataElement
        DataInfo_AME_Read_system_temperature_FD13_CombinedDataElement (DcmDspDataInfo): DcmDspDataFixedLength=true
        AME_Read_system_voltage_FD14_CombinedDataElement (DcmDspData): DcmDspDataSize=16, DcmDspDataType=UINT8_N, DcmDspDataInfoRef=DataInfo_AME_Read_system_voltage_FD14_CombinedDataElement
        DataInfo_AME_Read_system_voltage_FD14_CombinedDataElement (DcmDspDataInfo): DcmDspDataFixedLength=true
        AME_Input_Output_OnOff_control_FD18_OnOffModule (DcmDspData): DcmDspDataSize=8, DcmDspDataType=UINT8, DcmDspDataInfoRef=DataInfo_AME_Input_Output_OnOff_control_FD18_OnOffModule
        DataInfo_AME_Input_Output_OnOff_control_FD18_OnOffModule (DcmDspDataInfo): DcmDspDataFixedLength=true
        AME_Input_Output_OnOff_control_FD18_OnOffValue (DcmDspData): DcmDspDataSize=8, DcmDspDataType=UINT8, DcmDspDataInfoRef=DataInfo_AME_Input_Output_OnOff_control_FD18_OnOffValue
        DataInfo_AME_Input_Output_OnOff_control_FD18_OnOffValue (DcmDspDataInfo): DcmDspDataFixedLength=true
        AME_Skip_welcome_confirm_FD20_Reserved_Byte (DcmDspData): DcmDspDataSize=8, DcmDspDataType=UINT8, DcmDspDataInfoRef=DataInfo_AME_Skip_welcome_confirm_FD20_Reserved_Byte
        DataInfo_AME_Skip_welcome_confirm_FD20_Reserved_Byte (DcmDspDataInfo): DcmDspDataFixedLength=true
        AME_Set_HMI_Language_FD21_Set_HMI_Language (DcmDspData): DcmDspDataSize=8, DcmDspDataType=UINT8, DcmDspDataInfoRef=DataInfo_AME_Set_HMI_Language_FD21_Set_HMI_Language
        DataInfo_AME_Set_HMI_Language_FD21_Set_HMI_Language (DcmDspDataInfo): DcmDspDataFixedLength=true
        AME_Set_Volume_FD30_Set_Volume (DcmDspData): DcmDspDataSize=8, DcmDspDataType=UINT8, DcmDspDataInfoRef=DataInfo_AME_Set_Volume_FD30_Set_Volume
        DataInfo_AME_Set_Volume_FD30_Set_Volume (DcmDspDataInfo): DcmDspDataFixedLength=true
        AME_Set_Mute_Control_FD31_Set_Mute_Control (DcmDspData): DcmDspDataSize=8, DcmDspDataType=UINT8, DcmDspDataInfoRef=DataInfo_AME_Set_Mute_Control_FD31_Set_Mute_Control
        DataInfo_AME_Set_Mute_Control_FD31_Set_Mute_Control (DcmDspDataInfo): DcmDspDataFixedLength=true
        AME_Select_Speaker_Zone_FD33_Select_Speaker_Zone (DcmDspData): DcmDspDataSize=8, DcmDspDataType=UINT8, DcmDspDataInfoRef=DataInfo_AME_Select_Speaker_Zone_FD33_Select_Speaker_Zone
        DataInfo_AME_Select_Speaker_Zone_FD33_Select_Speaker_Zone (DcmDspDataInfo): DcmDspDataFixedLength=true
        Select_Speaker_Test_Tone_FD34_Select_tone (DcmDspData): DcmDspDataSize=8, DcmDspDataType=UINT8, DcmDspDataInfoRef=DataInfo_Select_Speaker_Test_Tone_FD34_Select_tone
        DataInfo_Select_Speaker_Test_Tone_FD34_Select_tone (DcmDspDataInfo): DcmDspDataFixedLength=true
        AME_Route_MIC_To_Internal_Speaker_FD36_Mic (DcmDspData): DcmDspDataSize=8, DcmDspDataType=UINT8, DcmDspDataInfoRef=DataInfo_AME_Route_MIC_To_Internal_Speaker_FD36_Mic
        DataInfo_AME_Route_MIC_To_Internal_Speaker_FD36_Mic (DcmDspDataInfo): DcmDspDataFixedLength=true
        AME_Route_MIC_To_Internal_Speaker_FD36_Control (DcmDspData): DcmDspDataSize=8, DcmDspDataType=UINT8, DcmDspDataInfoRef=DataInfo_AME_Route_MIC_To_Internal_Speaker_FD36_Control
        DataInfo_AME_Route_MIC_To_Internal_Speaker_FD36_Control (DcmDspDataInfo): DcmDspDataFixedLength=true
        AME_Route_Video_To_HMI_FD37_Route_Vedio_To_HMI (DcmDspData): DcmDspDataSize=8, DcmDspDataType=UINT8, DcmDspDataInfoRef=DataInfo_AME_Route_Video_To_HMI_FD37_Route_Vedio_To_HMI
        DataInfo_AME_Route_Video_To_HMI_FD37_Route_Vedio_To_HMI (DcmDspDataInfo): DcmDspDataFixedLength=true
        AME_Display_Color_Bar_Control_FD38_Display_Color_Bar_Control (DcmDspData): DcmDspDataSize=8, DcmDspDataType=UINT8, DcmDspDataInfoRef=DataInfo_AME_Display_Color_Bar_Control_FD38_Display_Color_Bar_Control
        DataInfo_AME_Display_Color_Bar_Control_FD38_Display_Color_Bar_Control (DcmDspDataInfo): DcmDspDataFixedLength=true
        AME_Select_Audio_Buffer_Channel_Output_FD39_SelectAudioBufferChannelOutput (DcmDspData): DcmDspDataSize=8, DcmDspDataType=UINT8, DcmDspDataInfoRef=DataInfo_AME_Select_Audio_Buffer_Channel_Output_FD39_SelectAudioBufferChannelOutput
        DataInfo_AME_Select_Audio_Buffer_Channel_Output_FD39_SelectAudioBufferChannelOutput (DcmDspDataInfo): DcmDspDataFixedLength=true
        AME_Switch_Source_FD40_SelectAudioBufferChannelOutput (DcmDspData): DcmDspDataSize=8, DcmDspDataType=UINT8, DcmDspDataInfoRef=DataInfo_AME_Switch_Source_FD40_SelectAudioBufferChannelOutput
        DataInfo_AME_Switch_Source_FD40_SelectAudioBufferChannelOutput (DcmDspDataInfo): DcmDspDataFixedLength=true
        AME_TrackMedia_Audio_Source_Play_FD41_TrackMedia_AudioSourcePlay (DcmDspData): DcmDspDataSize=8, DcmDspDataType=UINT8, DcmDspDataInfoRef=DataInfo_AME_TrackMedia_Audio_Source_Play_FD41_TrackMedia_AudioSourcePlay
        DataInfo_AME_TrackMedia_Audio_Source_Play_FD41_TrackMedia_AudioSourcePlay (DcmDspDataInfo): DcmDspDataFixedLength=true
        AME_Set_FM_Frequency_FD50_FM_Frequency (DcmDspData): DcmDspDataSize=24, DcmDspDataType=UINT8_N, DcmDspDataInfoRef=DataInfo_AME_Set_FM_Frequency_FD50_FM_Frequency
        DataInfo_AME_Set_FM_Frequency_FD50_FM_Frequency (DcmDspDataInfo): DcmDspDataFixedLength=true
        AME_Set_AM_Frequency_FD52_AM_Frequency (DcmDspData): DcmDspDataSize=16, DcmDspDataType=UINT16, DcmDspDataInfoRef=DataInfo_AME_Set_AM_Frequency_FD52_AM_Frequency
        DataInfo_AME_Set_AM_Frequency_FD52_AM_Frequency (DcmDspDataInfo): DcmDspDataFixedLength=true
        AME_Read_MAC_Address_FD60_CombinedDataElement (DcmDspData): DcmDspDataSize=48, DcmDspDataType=UINT8_N, DcmDspDataInfoRef=DataInfo_AME_Read_MAC_Address_FD60_CombinedDataElement
        DataInfo_AME_Read_MAC_Address_FD60_CombinedDataElement (DcmDspDataInfo): DcmDspDataFixedLength=false
        AME_Write_MAC_Address_FD61_subID (DcmDspData): DcmDspDataSize=8, DcmDspDataType=UINT8, DcmDspDataInfoRef=DataInfo_AME_Write_MAC_Address_FD61_subID
        DataInfo_AME_Write_MAC_Address_FD61_subID (DcmDspDataInfo): DcmDspDataFixedLength=true
        AME_Write_MAC_Address_FD61_A0 (DcmDspData): DcmDspDataSize=8, DcmDspDataType=UINT8, DcmDspDataInfoRef=DataInfo_AME_Write_MAC_Address_FD61_A0
        DataInfo_AME_Write_MAC_Address_FD61_A0 (DcmDspDataInfo): DcmDspDataFixedLength=true
        AME_Write_MAC_Address_FD61_A1 (DcmDspData): DcmDspDataSize=8, DcmDspDataType=UINT8, DcmDspDataInfoRef=DataInfo_AME_Write_MAC_Address_FD61_A1
        DataInfo_AME_Write_MAC_Address_FD61_A1 (DcmDspDataInfo): DcmDspDataFixedLength=true
        AME_Write_MAC_Address_FD61_A2 (DcmDspData): DcmDspDataSize=8, DcmDspDataType=UINT8, DcmDspDataInfoRef=DataInfo_AME_Write_MAC_Address_FD61_A2
        DataInfo_AME_Write_MAC_Address_FD61_A2 (DcmDspDataInfo): DcmDspDataFixedLength=true
        AME_Write_MAC_Address_FD61_A3 (DcmDspData): DcmDspDataSize=8, DcmDspDataType=UINT8, DcmDspDataInfoRef=DataInfo_AME_Write_MAC_Address_FD61_A3
        DataInfo_AME_Write_MAC_Address_FD61_A3 (DcmDspDataInfo): DcmDspDataFixedLength=true
        AME_Write_MAC_Address_FD61_A4 (DcmDspData): DcmDspDataSize=8, DcmDspDataType=UINT8, DcmDspDataInfoRef=DataInfo_AME_Write_MAC_Address_FD61_A4
        DataInfo_AME_Write_MAC_Address_FD61_A4 (DcmDspDataInfo): DcmDspDataFixedLength=true
        AME_Write_MAC_Address_FD61_A5 (DcmDspData): DcmDspDataSize=8, DcmDspDataType=UINT8, DcmDspDataInfoRef=DataInfo_AME_Write_MAC_Address_FD61_A5
        DataInfo_AME_Write_MAC_Address_FD61_A5 (DcmDspDataInfo): DcmDspDataFixedLength=true
        AME_Connectivy_OnOff_Control_FD62_BT_WiFi (DcmDspData): DcmDspDataSize=8, DcmDspDataType=UINT8, DcmDspDataInfoRef=DataInfo_AME_Connectivy_OnOff_Control_FD62_BT_WiFi
        DataInfo_AME_Connectivy_OnOff_Control_FD62_BT_WiFi (DcmDspDataInfo): DcmDspDataFixedLength=true
        AME_Connectivy_OnOff_Control_FD62_ON_OFF (DcmDspData): DcmDspDataSize=8, DcmDspDataType=UINT8, DcmDspDataInfoRef=DataInfo_AME_Connectivy_OnOff_Control_FD62_ON_OFF
        DataInfo_AME_Connectivy_OnOff_Control_FD62_ON_OFF (DcmDspDataInfo): DcmDspDataFixedLength=true
        AME_BT_Auto_Pairing_FD63_BT_Chip (DcmDspData): DcmDspDataSize=8, DcmDspDataType=UINT8, DcmDspDataInfoRef=DataInfo_AME_BT_Auto_Pairing_FD63_BT_Chip
        DataInfo_AME_BT_Auto_Pairing_FD63_BT_Chip (DcmDspDataInfo): DcmDspDataFixedLength=true
        AME_BT_Auto_Pairing_FD63_BT_MAC_Address (DcmDspData): DcmDspDataSize=48, DcmDspDataType=UINT8_N, DcmDspDataInfoRef=DataInfo_AME_BT_Auto_Pairing_FD63_BT_MAC_Address
        DataInfo_AME_BT_Auto_Pairing_FD63_BT_MAC_Address (DcmDspDataInfo): DcmDspDataFixedLength=true
        AME_Play_BT_Audio_Control_FD64_Reserved_Byte (DcmDspData): DcmDspDataSize=8, DcmDspDataType=UINT8, DcmDspDataInfoRef=DataInfo_AME_Play_BT_Audio_Control_FD64_Reserved_Byte
        DataInfo_AME_Play_BT_Audio_Control_FD64_Reserved_Byte (DcmDspDataInfo): DcmDspDataFixedLength=true
        AME_Set_WIFI_Mode_FD67_WiFi_Mode (DcmDspData): DcmDspDataSize=8, DcmDspDataType=UINT8, DcmDspDataInfoRef=DataInfo_AME_Set_WIFI_Mode_FD67_WiFi_Mode
        DataInfo_AME_Set_WIFI_Mode_FD67_WiFi_Mode (DcmDspDataInfo): DcmDspDataFixedLength=true
        AME_BT_Handfree_Loopback_Test_FD6B_Reserved_Byte (DcmDspData): DcmDspDataSize=8, DcmDspDataType=UINT8, DcmDspDataInfoRef=DataInfo_AME_BT_Handfree_Loopback_Test_FD6B_Reserved_Byte
        DataInfo_AME_BT_Handfree_Loopback_Test_FD6B_Reserved_Byte (DcmDspDataInfo): DcmDspDataFixedLength=true
        AME_Mirror_Link_connection_FD6D_Mirror_Link_connection (DcmDspData): DcmDspDataSize=8, DcmDspDataType=UINT8, DcmDspDataInfoRef=DataInfo_AME_Mirror_Link_connection_FD6D_Mirror_Link_connection
        DataInfo_AME_Mirror_Link_connection_FD6D_Mirror_Link_connection (DcmDspDataInfo): DcmDspDataFixedLength=true
        AME_Ethernet_IP_Ping_Function_FD6E_Ethernet_Channel (DcmDspData): DcmDspDataSize=8, DcmDspDataType=UINT8, DcmDspDataInfoRef=DataInfo_AME_Ethernet_IP_Ping_Function_FD6E_Ethernet_Channel
        DataInfo_AME_Ethernet_IP_Ping_Function_FD6E_Ethernet_Channel (DcmDspDataInfo): DcmDspDataFixedLength=true
        AME_Ethernet_IP_Ping_Function_FD6E_IPAddress_Byte1 (DcmDspData): DcmDspDataSize=8, DcmDspDataType=UINT8, DcmDspDataInfoRef=DataInfo_AME_Ethernet_IP_Ping_Function_FD6E_IPAddress_Byte1
        DataInfo_AME_Ethernet_IP_Ping_Function_FD6E_IPAddress_Byte1 (DcmDspDataInfo): DcmDspDataFixedLength=true
        AME_Ethernet_IP_Ping_Function_FD6E_IPAddress_Byte2 (DcmDspData): DcmDspDataSize=8, DcmDspDataType=UINT8, DcmDspDataInfoRef=DataInfo_AME_Ethernet_IP_Ping_Function_FD6E_IPAddress_Byte2
        DataInfo_AME_Ethernet_IP_Ping_Function_FD6E_IPAddress_Byte2 (DcmDspDataInfo): DcmDspDataFixedLength=true
        AME_Ethernet_IP_Ping_Function_FD6E_IPAddress_Byte3 (DcmDspData): DcmDspDataSize=8, DcmDspDataType=UINT8, DcmDspDataInfoRef=DataInfo_AME_Ethernet_IP_Ping_Function_FD6E_IPAddress_Byte3
        DataInfo_AME_Ethernet_IP_Ping_Function_FD6E_IPAddress_Byte3 (DcmDspDataInfo): DcmDspDataFixedLength=true
        AME_Ethernet_IP_Ping_Function_FD6E_IPAddress_Byte4 (DcmDspData): DcmDspDataSize=8, DcmDspDataType=UINT8, DcmDspDataInfoRef=DataInfo_AME_Ethernet_IP_Ping_Function_FD6E_IPAddress_Byte4
        DataInfo_AME_Ethernet_IP_Ping_Function_FD6E_IPAddress_Byte4 (DcmDspDataInfo): DcmDspDataFixedLength=true
        AME_Enter_NAV_Demo_Mode_FD70_Demo_Mode (DcmDspData): DcmDspDataSize=8, DcmDspDataType=UINT8, DcmDspDataInfoRef=DataInfo_AME_Enter_NAV_Demo_Mode_FD70_Demo_Mode
        DataInfo_AME_Enter_NAV_Demo_Mode_FD70_Demo_Mode (DcmDspDataInfo): DcmDspDataFixedLength=true
        AME_Read_GYRO_Status_FD71_GYRO_Status (DcmDspData): DcmDspDataSize=8, DcmDspDataType=UINT8, DcmDspDataInfoRef=DataInfo_AME_Read_GYRO_Status_FD71_GYRO_Status
        DataInfo_AME_Read_GYRO_Status_FD71_GYRO_Status (DcmDspDataInfo): DcmDspDataFixedLength=true
        AME_Read_GPS_Info_FD72_Number_of_visible_staellite (DcmDspData): DcmDspDataSize=8, DcmDspDataType=UINT8, DcmDspDataInfoRef=DataInfo_AME_Read_GPS_Info_FD72_Number_of_visible_staellite
        DataInfo_AME_Read_GPS_Info_FD72_Number_of_visible_staellite (DcmDspDataInfo): DcmDspDataFixedLength=true
        AME_Read_GPS_Info_FD72_Number_of_fix (DcmDspData): DcmDspDataSize=8, DcmDspDataType=UINT8, DcmDspDataInfoRef=DataInfo_AME_Read_GPS_Info_FD72_Number_of_fix
        DataInfo_AME_Read_GPS_Info_FD72_Number_of_fix (DcmDspDataInfo): DcmDspDataFixedLength=true
        AME_Read_GPS_Info_FD72_Number_of_used_satellite (DcmDspData): DcmDspDataSize=8, DcmDspDataType=UINT8, DcmDspDataInfoRef=DataInfo_AME_Read_GPS_Info_FD72_Number_of_used_satellite
        DataInfo_AME_Read_GPS_Info_FD72_Number_of_used_satellite (DcmDspDataInfo): DcmDspDataFixedLength=true
        AME_ReadGPSSNR_FD73_GPSSNR (DcmDspData): DcmDspDataSize=8, DcmDspDataType=UINT8, DcmDspDataInfoRef=DataInfo_AME_ReadGPSSNR_FD73_GPSSNR
        DataInfo_AME_ReadGPSSNR_FD73_GPSSNR (DcmDspDataInfo): DcmDspDataFixedLength=true
        AME_TBOX_communication_status_check_FD80_TBOX_status (DcmDspData): DcmDspDataSize=8, DcmDspDataType=UINT8, DcmDspDataInfoRef=DataInfo_AME_TBOX_communication_status_check_FD80_TBOX_status
        DataInfo_AME_TBOX_communication_status_check_FD80_TBOX_status (DcmDspDataInfo): DcmDspDataFixedLength=true
        AME_Read_Head_Unit_Connector_Status_FD90_CombinedDataElement (DcmDspData): DcmDspDataSize=16, DcmDspDataType=UINT8_N, DcmDspDataInfoRef=DataInfo_AME_Read_Head_Unit_Connector_Status_FD90_CombinedDataElement
        DataInfo_AME_Read_Head_Unit_Connector_Status_FD90_CombinedDataElement (DcmDspDataInfo): DcmDspDataFixedLength=true
        AME_Read_Detection_Input_Info_FD92_CombinedDataElement (DcmDspData): DcmDspDataSize=16, DcmDspDataType=UINT8_N, DcmDspDataInfoRef=DataInfo_AME_Read_Detection_Input_Info_FD92_CombinedDataElement
        DataInfo_AME_Read_Detection_Input_Info_FD92_CombinedDataElement (DcmDspDataInfo): DcmDspDataFixedLength=true
        AME_Set_External_Output_Status_FD93_HW (DcmDspData): DcmDspDataSize=8, DcmDspDataType=UINT8, DcmDspDataInfoRef=DataInfo_AME_Set_External_Output_Status_FD93_HW
        DataInfo_AME_Set_External_Output_Status_FD93_HW (DcmDspDataInfo): DcmDspDataFixedLength=true
        AME_Set_External_Output_Status_FD93_Status (DcmDspData): DcmDspDataSize=8, DcmDspDataType=UINT8, DcmDspDataInfoRef=DataInfo_AME_Set_External_Output_Status_FD93_Status
        DataInfo_AME_Set_External_Output_Status_FD93_Status (DcmDspDataInfo): DcmDspDataFixedLength=true
        Set_debug_on_off_control_FDF0_CombinedDataElement (DcmDspData): DcmDspDataSize=16, DcmDspDataType=UINT8_N, DcmDspDataInfoRef=DataInfo_Set_debug_on_off_control_FDF0_CombinedDataElement
        DataInfo_Set_debug_on_off_control_FDF0_CombinedDataElement (DcmDspDataInfo): DcmDspDataFixedLength=false
        Switch_HU_boot_mode_FDF1_Boot_Mode (DcmDspData): DcmDspDataSize=8, DcmDspDataType=UINT8, DcmDspDataInfoRef=DataInfo_Switch_HU_boot_mode_FDF1_Boot_Mode
        DataInfo_Switch_HU_boot_mode_FDF1_Boot_Mode (DcmDspDataInfo): DcmDspDataFixedLength=true
        84 x DcmDspDid:
          Vehicle_Speed_D001: DcmDspDidIdentifier=53249, DcmDspDidInfoRef=DidInfo_Vehicle_Speed_D001
            Vehicle_Speed (DcmDspDidSignal): DcmDspDidDataPos=0, DcmDspDidDataRef=Vehicle_Speed_D001_Vehicle_Speed
          Engine_Speed_D002: DcmDspDidIdentifier=53250, DcmDspDidInfoRef=DidInfo_Engine_Speed_D002
            Engine_Speed (DcmDspDidSignal): DcmDspDidDataPos=0, DcmDspDidDataRef=Engine_Speed_D002_Engine_Speed
          Operating_Voltage_Value_D003: DcmDspDidIdentifier=53251, DcmDspDidInfoRef=DidInfo_Operating_Voltage_Value_D003
            Operating_Voltage_Value (DcmDspDidSignal): DcmDspDidDataPos=0, DcmDspDidDataRef=Operating_Voltage_Value_D003_Operating_Voltage_Value
          Odometer_D004: DcmDspDidIdentifier=53252, DcmDspDidInfoRef=DidInfo_Odometer_D004
            Odometer (DcmDspDidSignal): DcmDspDidDataPos=0, DcmDspDidDataRef=Odometer_D004_Odometer
          DTC_Occurrence_Timer_D005: DcmDspDidIdentifier=53253, DcmDspDidInfoRef=DidInfo_DTC_Occurrence_Timer_D005
            Occure_Time_Inforamation (DcmDspDidSignal): DcmDspDidDataPos=0, DcmDspDidDataRef=DTC_Occurrence_Timer_D005_Occure_Time_Inforamation
          Number_of_installed_cameras_E001: DcmDspDidIdentifier=57345, DcmDspDidInfoRef=DidInfo_Number_of_installed_cameras_E001
            Number_of_installed_cameras (DcmDspDidSignal): DcmDspDidDataPos=0, DcmDspDidDataRef=Number_of_installed_cameras_E001_Number_of_installed_cameras
          Screen_resolution_E002: DcmDspDidIdentifier=57346, DcmDspDidInfoRef=DidInfo_Screen_resolution_E002
            Width (DcmDspDidSignal): DcmDspDidDataPos=0, DcmDspDidDataRef=Screen_resolution_E002_Width
            Height (DcmDspDidSignal): DcmDspDidDataPos=16, DcmDspDidDataRef=Screen_resolution_E002_Height
          Present_GPS_coordinates_shift_data_E003: DcmDspDidIdentifier=57347, DcmDspDidInfoRef=DidInfo_Present_GPS_coordinates_shift_data_E003
            GPS_coordinates (DcmDspDidSignal): DcmDspDidDataPos=0, DcmDspDidDataRef=Present_GPS_coordinates_shift_data_E003_GPS_coordinates
          Bluetooth_Current_Discoverability_modes_E005: DcmDspDidIdentifier=57349, DcmDspDidInfoRef=DidInfo_Bluetooth_Current_Discoverability_modes_E005
            Bluetooth_Current_Discoverability_modes (DcmDspDidSignal): DcmDspDidDataPos=0, DcmDspDidDataRef=Bluetooth_Current_Discoverability_modes_E005_Bluetooth_Current_Discoverability_modes
          Bluetooth_Status_E006: DcmDspDidIdentifier=57350, DcmDspDidInfoRef=DidInfo_Bluetooth_Status_E006
            Bluetooth_Status (DcmDspDidSignal): DcmDspDidDataPos=0, DcmDspDidDataRef=Bluetooth_Status_E006_Bluetooth_Status
          BT_Power_Class_E007: DcmDspDidIdentifier=57351, DcmDspDidInfoRef=DidInfo_BT_Power_Class_E007
            BT_Power_Class (DcmDspDidSignal): DcmDspDidDataPos=0, DcmDspDidDataRef=BT_Power_Class_E007_BT_Power_Class
          BT_active_profile_list_E008: DcmDspDidIdentifier=57352, DcmDspDidInfoRef=DidInfo_BT_active_profile_list_E008
            BT_active_profile_list (DcmDspDidSignal): DcmDspDidDataPos=0, DcmDspDidDataRef=BT_active_profile_list_E008_BT_active_profile_list
          BT_firmware_version_E009: DcmDspDidIdentifier=57353, DcmDspDidInfoRef=DidInfo_BT_firmware_version_E009
            BT_firmware_version (DcmDspDidSignal): DcmDspDidDataPos=0, DcmDspDidDataRef=BT_firmware_version_E009_BT_firmware_version
          Audio_jack_status_E00A: DcmDspDidIdentifier=57354, DcmDspDidInfoRef=DidInfo_Audio_jack_status_E00A
            Audio_jack_status (DcmDspDidSignal): DcmDspDidDataPos=0, DcmDspDidDataRef=Audio_jack_status_E00A_Audio_jack_status
          Number_of_external_USB_devices_plugged_E00B: DcmDspDidIdentifier=57355, DcmDspDidInfoRef=DidInfo_Number_of_external_USB_devices_plugged_E00B
            Number_of_external_USB_devices_plugged (DcmDspDidSignal): DcmDspDidDataPos=0, DcmDspDidDataRef=Number_of_external_USB_devices_plugged_E00B_Number_of_external_USB_devices_plugged
          Currently_connected_USB_Type_E00C: DcmDspDidIdentifier=57356, DcmDspDidInfoRef=DidInfo_Currently_connected_USB_Type_E00C
            Currently_connected_USB_Type (DcmDspDidSignal): DcmDspDidDataPos=0, DcmDspDidDataRef=Currently_connected_USB_Type_E00C_Currently_connected_USB_Type
          Support_AM_frequency_Min_E00D: DcmDspDidIdentifier=57357, DcmDspDidInfoRef=DidInfo_Support_AM_frequency_Min_E00D
            Support_AM_frequency_Min (DcmDspDidSignal): DcmDspDidDataPos=0, DcmDspDidDataRef=Support_AM_frequency_Min_E00D_Support_AM_frequency_Min
          Support_AM_frequency_Max_E00E: DcmDspDidIdentifier=57358, DcmDspDidInfoRef=DidInfo_Support_AM_frequency_Max_E00E
            Support_AM_frequency_Max (DcmDspDidSignal): DcmDspDidDataPos=0, DcmDspDidDataRef=Support_AM_frequency_Max_E00E_Support_AM_frequency_Max
          Support_FM_frequency_Min_E00F: DcmDspDidIdentifier=57359, DcmDspDidInfoRef=DidInfo_Support_FM_frequency_Min_E00F
            Support_FM_frequency_Min (DcmDspDidSignal): DcmDspDidDataPos=0, DcmDspDidDataRef=Support_FM_frequency_Min_E00F_Support_FM_frequency_Min
          Support_FM_frequency_Max_E010: DcmDspDidIdentifier=57360, DcmDspDidInfoRef=DidInfo_Support_FM_frequency_Max_E010
            Support_FM_frequency_Max (DcmDspDidSignal): DcmDspDidDataPos=0, DcmDspDidDataRef=Support_FM_frequency_Max_E010_Support_FM_frequency_Max
          AM_signal_Strength_E011: DcmDspDidIdentifier=57361, DcmDspDidInfoRef=DidInfo_AM_signal_Strength_E011
            AM_signal_Strength (DcmDspDidSignal): DcmDspDidDataPos=0, DcmDspDidDataRef=AM_signal_Strength_E011_AM_signal_Strength
          FM_signal_Strength_E012: DcmDspDidIdentifier=57362, DcmDspDidInfoRef=DidInfo_FM_signal_Strength_E012
            FM_signal_Strength (DcmDspDidSignal): DcmDspDidDataPos=0, DcmDspDidDataRef=FM_signal_Strength_E012_FM_signal_Strength
          Wi_Fi_Module_Status_E013: DcmDspDidIdentifier=57363, DcmDspDidInfoRef=DidInfo_Wi_Fi_Module_Status_E013
            Wi_Fi_Module_Status (DcmDspDidSignal): DcmDspDidDataPos=0, DcmDspDidDataRef=Wi_Fi_Module_Status_E013_Wi_Fi_Module_Status
          Wi_Fi_Module_Firmware_Version_E014: DcmDspDidIdentifier=57364, DcmDspDidInfoRef=DidInfo_Wi_Fi_Module_Firmware_Version_E014
            Wi_Fi_Module_Firmware_Version (DcmDspDidSignal): DcmDspDidDataPos=0, DcmDspDidDataRef=Wi_Fi_Module_Firmware_Version_E014_Wi_Fi_Module_Firmware_Version
          Wi_Fi_Module_Hardware_Part_Number_E015: DcmDspDidIdentifier=57365, DcmDspDidInfoRef=DidInfo_Wi_Fi_Module_Hardware_Part_Number_E015
            Wi_Fi_Module_Hardware_Part_Number (DcmDspDidSignal): DcmDspDidDataPos=0, DcmDspDidDataRef=Wi_Fi_Module_Hardware_Part_Number_E015_Wi_Fi_Module_Hardware_Part_Number
          Tbox_IP_Address_E016: DcmDspDidIdentifier=57366, DcmDspDidInfoRef=DidInfo_Tbox_IP_Address_E016
            Tbox_IP_Address (DcmDspDidSignal): DcmDspDidDataPos=0, DcmDspDidDataRef=Tbox_IP_Address_E016_Tbox_IP_Address
          Tbox_Gateway_sub_mask_E017: DcmDspDidIdentifier=57367, DcmDspDidInfoRef=DidInfo_Tbox_Gateway_sub_mask_E017
            Tbox_Gateway_sub_mask (DcmDspDidSignal): DcmDspDidDataPos=0, DcmDspDidDataRef=Tbox_Gateway_sub_mask_E017_Tbox_Gateway_sub_mask
          Tbox_Last_connection_lost_time_stamp_E018: DcmDspDidIdentifier=57368, DcmDspDidInfoRef=DidInfo_Tbox_Last_connection_lost_time_stamp_E018
            Tbox_Last_connection_lost_time_stamp (DcmDspDidSignal): DcmDspDidDataPos=0, DcmDspDidDataRef=Tbox_Last_connection_lost_time_stamp_E018_Tbox_Last_connection_lost_time_stamp
          Tbox_geographical_coordinates_when_connection_lost_E019: DcmDspDidIdentifier=57369, DcmDspDidInfoRef=DidInfo_Tbox_geographical_coordinates_when_connection_lost_E019
            Tbox_geographical_coordinates_when_connection_lost (DcmDspDidSignal):
              DcmDspDidDataPos = 0
              DcmDspDidDataRef = Tbox_geographical_coordinates_when_connection_lost_E019_Tbox_geographical_coordinates_when_connection_lost
          Telematics_Module_Status_E01A: DcmDspDidIdentifier=57370, DcmDspDidInfoRef=DidInfo_Telematics_Module_Status_E01A
            Telematics_Module_Status (DcmDspDidSignal): DcmDspDidDataPos=0, DcmDspDidDataRef=Telematics_Module_Status_E01A_Telematics_Module_Status
          Number_of_installed_speakers_E01C: DcmDspDidIdentifier=57372, DcmDspDidInfoRef=DidInfo_Number_of_installed_speakers_E01C
            Number_of_installed_speakers (DcmDspDidSignal): DcmDspDidDataPos=0, DcmDspDidDataRef=Number_of_installed_speakers_E01C_Number_of_installed_speakers
          Vehicle_Manufacture_Spare_Part_Number_F187: DcmDspDidIdentifier=61831, DcmDspDidInfoRef=DidInfo_Vehicle_Manufacture_Spare_Part_Number_F187
            Vehicle_Manufacture_Spare_Part_Number (DcmDspDidSignal): DcmDspDidDataPos=0, DcmDspDidDataRef=Vehicle_Manufacture_Spare_Part_Number_F187_Vehicle_Manufacture_Spare_Part_Number
          System_Supplier_Identifier_F18A: DcmDspDidIdentifier=61834, DcmDspDidInfoRef=DidInfo_System_Supplier_Identifier_F18A
            System_Supplier_Identifier (DcmDspDidSignal): DcmDspDidDataPos=0, DcmDspDidDataRef=System_Supplier_Identifier_F18A_System_Supplier_Identifier
          ECU_Serial_Number_F18C: DcmDspDidIdentifier=61836, DcmDspDidInfoRef=DidInfo_ECU_Serial_Number_F18C
            ECU_Serial_Number (DcmDspDidSignal): DcmDspDidDataPos=0, DcmDspDidDataRef=ECU_Serial_Number_F18C_ECU_Serial_Number
          Vehicle_Identification_Number_F190: DcmDspDidIdentifier=61840, DcmDspDidInfoRef=DidInfo_Vehicle_Identification_Number_F190
            VIN (DcmDspDidSignal): DcmDspDidDataPos=0, DcmDspDidDataRef=Vehicle_Identification_Number_F190_VIN
          System_Supplier_ECU_Hardware_Version_Number_F193: DcmDspDidIdentifier=61843, DcmDspDidInfoRef=DidInfo_System_Supplier_ECU_Hardware_Version_Number_F193
            Hardware_Version_Number (DcmDspDidSignal): DcmDspDidDataPos=0, DcmDspDidDataRef=System_Supplier_ECU_Hardware_Version_Number_F193_Hardware_Version_Number
          System_Supplier_ECU_Software_Version_Number_F195: DcmDspDidIdentifier=61845, DcmDspDidInfoRef=DidInfo_System_Supplier_ECU_Software_Version_Number_F195
            INVALID_SHORTNAME_Software_Version_Number (DcmDspDidSignal): DcmDspDidDataPos=0, DcmDspDidDataRef=System_Supplier_ECU_Software_Version_Number_F195_Software_Version_Number
          VehicleNetworkConfiguration_F1A1: DcmDspDidIdentifier=61857, DcmDspDidInfoRef=DidInfo_VehicleNetworkConfiguration_F1A1
            VehicleNetworkConfiguration (DcmDspDidSignal): DcmDspDidDataPos=0, DcmDspDidDataRef=VehicleNetworkConfiguration_F1A1_VehicleNetworkConfiguration
          C_matrix_Version_of_the_ECU_product_F1A2: DcmDspDidIdentifier=61858, DcmDspDidInfoRef=DidInfo_C_matrix_Version_of_the_ECU_product_F1A2
            C_matrix_Version (DcmDspDidSignal): DcmDspDidDataPos=0, DcmDspDidDataRef=C_matrix_Version_of_the_ECU_product_F1A2_C_matrix_Version
          AME_Power_Control_FD01: DcmDspDidIdentifier=64769, DcmDspDidInfoRef=DidInfo_AME_Power_Control_FD01
            Power_Control (DcmDspDidSignal): DcmDspDidDataPos=0, DcmDspDidDataRef=AME_Power_Control_FD01_Power_Control
          AME_Switch_BIOS_Mode_FD02: DcmDspDidIdentifier=64770, DcmDspDidInfoRef=DidInfo_AME_Switch_BIOS_Mode_FD02
            Switch_BIOS (DcmDspDidSignal): DcmDspDidDataPos=0, DcmDspDidDataRef=AME_Switch_BIOS_Mode_FD02_Switch_BIOS
          AME_Read_SW_and_HW_Version_FD04: DcmDspDidIdentifier=64772, DcmDspDidInfoRef=DidInfo_AME_Read_SW_and_HW_Version_FD04
            CombinedDataElement (DcmDspDidSignal): DcmDspDidDataPos=0, DcmDspDidDataRef=AME_Read_SW_and_HW_Version_FD04_CombinedDataElement
          INVALID_SHORTNAME_AME_Reset_Factory_Mode_FD05: DcmDspDidIdentifier=64773, DcmDspDidInfoRef=DidInfo_AME_Reset_Factory_Mode_FD05
            Reset_Factory_Mode (DcmDspDidSignal): DcmDspDidDataPos=0, DcmDspDidDataRef=INVALID_SHORTNAME_AME_Reset_Factory_Mode_FD05_Reset_Factory_Mode
          AME_Read_harman_manufactory_part_number_FD06: DcmDspDidIdentifier=64774, DcmDspDidInfoRef=DidInfo_AME_Read_harman_manufactory_part_number_FD06
            Harman_Manufactory_Part_Number (DcmDspDidSignal): DcmDspDidDataPos=0, DcmDspDidDataRef=AME_Read_harman_manufactory_part_number_FD06_Harman_Manufactory_Part_Number
          AME_Write_harman_manufactory_part_number_FD07: DcmDspDidIdentifier=64775, DcmDspDidInfoRef=DidInfo_AME_Write_harman_manufactory_part_number_FD07
            Harman_Manufactory_Part_Number (DcmDspDidSignal): DcmDspDidDataPos=0, DcmDspDidDataRef=AME_Write_harman_manufactory_part_number_FD07_Harman_Manufactory_Part_Number
          AME_Read_AME_diagnostic_version_FD08: DcmDspDidIdentifier=64776, DcmDspDidInfoRef=DidInfo_AME_Read_AME_diagnostic_version_FD08
            CombinedDataElement (DcmDspDidSignal): DcmDspDidDataPos=0, DcmDspDidDataRef=AME_Read_AME_diagnostic_version_FD08_CombinedDataElement
          AME_Read_FAN_speed_FD11: DcmDspDidIdentifier=64785, DcmDspDidInfoRef=DidInfo_AME_Read_FAN_speed_FD11
            FAN_Speed (DcmDspDidSignal): DcmDspDidDataPos=0, DcmDspDidDataRef=AME_Read_FAN_speed_FD11_FAN_Speed
          AME_Set_FAN_speed_FD12: DcmDspDidIdentifier=64786, DcmDspDidInfoRef=DidInfo_AME_Set_FAN_speed_FD12
            FAN_Speed (DcmDspDidSignal): DcmDspDidDataPos=0, DcmDspDidDataRef=AME_Set_FAN_speed_FD12_FAN_Speed
          AME_Read_system_temperature_FD13: DcmDspDidIdentifier=64787, DcmDspDidInfoRef=DidInfo_AME_Read_system_temperature_FD13
            CombinedDataElement (DcmDspDidSignal): DcmDspDidDataPos=0, DcmDspDidDataRef=AME_Read_system_temperature_FD13_CombinedDataElement
          AME_Read_system_voltage_FD14: DcmDspDidIdentifier=64788, DcmDspDidInfoRef=DidInfo_AME_Read_system_voltage_FD14
            CombinedDataElement (DcmDspDidSignal): DcmDspDidDataPos=0, DcmDspDidDataRef=AME_Read_system_voltage_FD14_CombinedDataElement
          AME_Input_Output_OnOff_control_FD18: DcmDspDidIdentifier=64792, DcmDspDidInfoRef=DidInfo_AME_Input_Output_OnOff_control_FD18
            OnOffModule (DcmDspDidSignal): DcmDspDidDataPos=0, DcmDspDidDataRef=AME_Input_Output_OnOff_control_FD18_OnOffModule
            OnOffValue (DcmDspDidSignal): DcmDspDidDataPos=8, DcmDspDidDataRef=AME_Input_Output_OnOff_control_FD18_OnOffValue
          AME_Skip_welcome_confirm_FD20: DcmDspDidIdentifier=64800, DcmDspDidInfoRef=DidInfo_AME_Skip_welcome_confirm_FD20
            Reserved_Byte (DcmDspDidSignal): DcmDspDidDataPos=0, DcmDspDidDataRef=AME_Skip_welcome_confirm_FD20_Reserved_Byte
          AME_Set_HMI_Language_FD21: DcmDspDidIdentifier=64801, DcmDspDidInfoRef=DidInfo_AME_Set_HMI_Language_FD21
            Set_HMI_Language (DcmDspDidSignal): DcmDspDidDataPos=0, DcmDspDidDataRef=AME_Set_HMI_Language_FD21_Set_HMI_Language
          AME_Set_Volume_FD30: DcmDspDidIdentifier=64816, DcmDspDidInfoRef=DidInfo_AME_Set_Volume_FD30
            Set_Volume (DcmDspDidSignal): DcmDspDidDataPos=0, DcmDspDidDataRef=AME_Set_Volume_FD30_Set_Volume
          AME_Set_Mute_Control_FD31: DcmDspDidIdentifier=64817, DcmDspDidInfoRef=DidInfo_AME_Set_Mute_Control_FD31
            Set_Mute_Control (DcmDspDidSignal): DcmDspDidDataPos=0, DcmDspDidDataRef=AME_Set_Mute_Control_FD31_Set_Mute_Control
          AME_Select_Speaker_Zone_FD33: DcmDspDidIdentifier=64819, DcmDspDidInfoRef=DidInfo_AME_Select_Speaker_Zone_FD33
            Select_Speaker_Zone (DcmDspDidSignal): DcmDspDidDataPos=0, DcmDspDidDataRef=AME_Select_Speaker_Zone_FD33_Select_Speaker_Zone
          Select_Speaker_Test_Tone_FD34: DcmDspDidIdentifier=64820, DcmDspDidInfoRef=DidInfo_Select_Speaker_Test_Tone_FD34
            Select_tone (DcmDspDidSignal): DcmDspDidDataPos=0, DcmDspDidDataRef=Select_Speaker_Test_Tone_FD34_Select_tone
          AME_Route_MIC_To_Internal_Speaker_FD36: DcmDspDidIdentifier=64822, DcmDspDidInfoRef=DidInfo_AME_Route_MIC_To_Internal_Speaker_FD36
            Mic (DcmDspDidSignal): DcmDspDidDataPos=0, DcmDspDidDataRef=AME_Route_MIC_To_Internal_Speaker_FD36_Mic
            Control (DcmDspDidSignal): DcmDspDidDataPos=8, DcmDspDidDataRef=AME_Route_MIC_To_Internal_Speaker_FD36_Control
          AME_Route_Video_To_HMI_FD37: DcmDspDidIdentifier=64823, DcmDspDidInfoRef=DidInfo_AME_Route_Video_To_HMI_FD37
            Route_Vedio_To_HMI (DcmDspDidSignal): DcmDspDidDataPos=0, DcmDspDidDataRef=AME_Route_Video_To_HMI_FD37_Route_Vedio_To_HMI
          AME_Display_Color_Bar_Control_FD38: DcmDspDidIdentifier=64824, DcmDspDidInfoRef=DidInfo_AME_Display_Color_Bar_Control_FD38
            Display_Color_Bar_Control (DcmDspDidSignal): DcmDspDidDataPos=0, DcmDspDidDataRef=AME_Display_Color_Bar_Control_FD38_Display_Color_Bar_Control
          AME_Select_Audio_Buffer_Channel_Output_FD39: DcmDspDidIdentifier=64825, DcmDspDidInfoRef=DidInfo_AME_Select_Audio_Buffer_Channel_Output_FD39
            SelectAudioBufferChannelOutput (DcmDspDidSignal): DcmDspDidDataPos=0, DcmDspDidDataRef=AME_Select_Audio_Buffer_Channel_Output_FD39_SelectAudioBufferChannelOutput
          AME_Switch_Source_FD40: DcmDspDidIdentifier=64832, DcmDspDidInfoRef=DidInfo_AME_Switch_Source_FD40
            SelectAudioBufferChannelOutput (DcmDspDidSignal): DcmDspDidDataPos=0, DcmDspDidDataRef=AME_Switch_Source_FD40_SelectAudioBufferChannelOutput
          AME_TrackMedia_Audio_Source_Play_FD41: DcmDspDidIdentifier=64833, DcmDspDidInfoRef=DidInfo_AME_TrackMedia_Audio_Source_Play_FD41
            TrackMedia_AudioSourcePlay (DcmDspDidSignal): DcmDspDidDataPos=0, DcmDspDidDataRef=AME_TrackMedia_Audio_Source_Play_FD41_TrackMedia_AudioSourcePlay
          AME_Set_FM_Frequency_FD50: DcmDspDidIdentifier=64848, DcmDspDidInfoRef=DidInfo_AME_Set_FM_Frequency_FD50
            FM_Frequency (DcmDspDidSignal): DcmDspDidDataPos=0, DcmDspDidDataRef=AME_Set_FM_Frequency_FD50_FM_Frequency
          AME_Set_AM_Frequency_FD52: DcmDspDidIdentifier=64850, DcmDspDidInfoRef=DidInfo_AME_Set_AM_Frequency_FD52
            AM_Frequency (DcmDspDidSignal): DcmDspDidDataPos=0, DcmDspDidDataRef=AME_Set_AM_Frequency_FD52_AM_Frequency
          AME_Read_MAC_Address_FD60: DcmDspDidIdentifier=64864, DcmDspDidInfoRef=DidInfo_AME_Read_MAC_Address_FD60
            CombinedDataElement (DcmDspDidSignal): DcmDspDidDataPos=0, DcmDspDidDataRef=AME_Read_MAC_Address_FD60_CombinedDataElement
          AME_Write_MAC_Address_FD61: DcmDspDidIdentifier=64865, DcmDspDidInfoRef=DidInfo_AME_Write_MAC_Address_FD61
            7 x DcmDspDidSignal:
              subID: DcmDspDidDataPos=0, DcmDspDidDataRef=AME_Write_MAC_Address_FD61_subID
              A0: DcmDspDidDataPos=8, DcmDspDidDataRef=AME_Write_MAC_Address_FD61_A0
              A1: DcmDspDidDataPos=16, DcmDspDidDataRef=AME_Write_MAC_Address_FD61_A1
              A2: DcmDspDidDataPos=24, DcmDspDidDataRef=AME_Write_MAC_Address_FD61_A2
              A3: DcmDspDidDataPos=32, DcmDspDidDataRef=AME_Write_MAC_Address_FD61_A3
              A4: DcmDspDidDataPos=40, DcmDspDidDataRef=AME_Write_MAC_Address_FD61_A4
              A5: DcmDspDidDataPos=48, DcmDspDidDataRef=AME_Write_MAC_Address_FD61_A5
          AME_Connectivy_OnOff_Control_FD62: DcmDspDidIdentifier=64866, DcmDspDidInfoRef=DidInfo_AME_Connectivy_OnOff_Control_FD62
            BT_WiFi (DcmDspDidSignal): DcmDspDidDataPos=0, DcmDspDidDataRef=AME_Connectivy_OnOff_Control_FD62_BT_WiFi
            ON_OFF (DcmDspDidSignal): DcmDspDidDataPos=8, DcmDspDidDataRef=AME_Connectivy_OnOff_Control_FD62_ON_OFF
          AME_BT_Auto_Pairing_FD63: DcmDspDidIdentifier=64867, DcmDspDidInfoRef=DidInfo_AME_BT_Auto_Pairing_FD63
            BT_Chip (DcmDspDidSignal): DcmDspDidDataPos=0, DcmDspDidDataRef=AME_BT_Auto_Pairing_FD63_BT_Chip
            BT_MAC_Address (DcmDspDidSignal): DcmDspDidDataPos=8, DcmDspDidDataRef=AME_BT_Auto_Pairing_FD63_BT_MAC_Address
          AME_Play_BT_Audio_Control_FD64: DcmDspDidIdentifier=64868, DcmDspDidInfoRef=DidInfo_AME_Play_BT_Audio_Control_FD64
            Reserved_Byte (DcmDspDidSignal): DcmDspDidDataPos=0, DcmDspDidDataRef=AME_Play_BT_Audio_Control_FD64_Reserved_Byte
          AME_Set_WIFI_Mode_FD67: DcmDspDidIdentifier=64871, DcmDspDidInfoRef=DidInfo_AME_Set_WIFI_Mode_FD67
            WiFi_Mode (DcmDspDidSignal): DcmDspDidDataPos=0, DcmDspDidDataRef=AME_Set_WIFI_Mode_FD67_WiFi_Mode
          AME_BT_Handfree_Loopback_Test_FD6B: DcmDspDidIdentifier=64875, DcmDspDidInfoRef=DidInfo_AME_BT_Handfree_Loopback_Test_FD6B
            Reserved_Byte (DcmDspDidSignal): DcmDspDidDataPos=0, DcmDspDidDataRef=AME_BT_Handfree_Loopback_Test_FD6B_Reserved_Byte
          AME_Mirror_Link_connection_FD6D: DcmDspDidIdentifier=64877, DcmDspDidInfoRef=DidInfo_AME_Mirror_Link_connection_FD6D
            Mirror_Link_connection (DcmDspDidSignal): DcmDspDidDataPos=0, DcmDspDidDataRef=AME_Mirror_Link_connection_FD6D_Mirror_Link_connection
          AME_Ethernet_IP_Ping_Function_FD6E: DcmDspDidIdentifier=64878, DcmDspDidInfoRef=DidInfo_AME_Ethernet_IP_Ping_Function_FD6E
            5 x DcmDspDidSignal:
              Ethernet_Channel: DcmDspDidDataPos=0, DcmDspDidDataRef=AME_Ethernet_IP_Ping_Function_FD6E_Ethernet_Channel
              IPAddress_Byte1: DcmDspDidDataPos=8, DcmDspDidDataRef=AME_Ethernet_IP_Ping_Function_FD6E_IPAddress_Byte1
              IPAddress_Byte2: DcmDspDidDataPos=16, DcmDspDidDataRef=AME_Ethernet_IP_Ping_Function_FD6E_IPAddress_Byte2
              IPAddress_Byte3: DcmDspDidDataPos=24, DcmDspDidDataRef=AME_Ethernet_IP_Ping_Function_FD6E_IPAddress_Byte3
              IPAddress_Byte4: DcmDspDidDataPos=32, DcmDspDidDataRef=AME_Ethernet_IP_Ping_Function_FD6E_IPAddress_Byte4
          AME_Enter_NAV_Demo_Mode_FD70: DcmDspDidIdentifier=64880, DcmDspDidInfoRef=DidInfo_AME_Enter_NAV_Demo_Mode_FD70
            INVALID_SHORTNAME_Demo_Mode (DcmDspDidSignal): DcmDspDidDataPos=0, DcmDspDidDataRef=AME_Enter_NAV_Demo_Mode_FD70_Demo_Mode
          AME_Read_GYRO_Status_FD71: DcmDspDidIdentifier=64881, DcmDspDidInfoRef=DidInfo_AME_Read_GYRO_Status_FD71
            GYRO_Status (DcmDspDidSignal): DcmDspDidDataPos=0, DcmDspDidDataRef=AME_Read_GYRO_Status_FD71_GYRO_Status
          AME_Read_GPS_Info_FD72: DcmDspDidIdentifier=64882, DcmDspDidInfoRef=DidInfo_AME_Read_GPS_Info_FD72
            3 x DcmDspDidSignal:
              Number_of_visible_staellite: DcmDspDidDataPos=0, DcmDspDidDataRef=AME_Read_GPS_Info_FD72_Number_of_visible_staellite
              Number_of_fix: DcmDspDidDataPos=8, DcmDspDidDataRef=AME_Read_GPS_Info_FD72_Number_of_fix
              Number_of_used_satellite: DcmDspDidDataPos=16, DcmDspDidDataRef=AME_Read_GPS_Info_FD72_Number_of_used_satellite
          AME_ReadGPSSNR_FD73: DcmDspDidIdentifier=64883, DcmDspDidInfoRef=DidInfo_AME_ReadGPSSNR_FD73
            GPSSNR (DcmDspDidSignal): DcmDspDidDataPos=0, DcmDspDidDataRef=AME_ReadGPSSNR_FD73_GPSSNR
          AME_TBOX_communication_status_check_FD80: DcmDspDidIdentifier=64896, DcmDspDidInfoRef=DidInfo_AME_TBOX_communication_status_check_FD80
            TBOX_status (DcmDspDidSignal): DcmDspDidDataPos=0, DcmDspDidDataRef=AME_TBOX_communication_status_check_FD80_TBOX_status
          AME_Read_Head_Unit_Connector_Status_FD90: DcmDspDidIdentifier=64912, DcmDspDidInfoRef=DidInfo_AME_Read_Head_Unit_Connector_Status_FD90
            CombinedDataElement (DcmDspDidSignal): DcmDspDidDataPos=0, DcmDspDidDataRef=AME_Read_Head_Unit_Connector_Status_FD90_CombinedDataElement
          AME_Read_Detection_Input_Info_FD92: DcmDspDidIdentifier=64914, DcmDspDidInfoRef=DidInfo_AME_Read_Detection_Input_Info_FD92
            CombinedDataElement (DcmDspDidSignal): DcmDspDidDataPos=0, DcmDspDidDataRef=AME_Read_Detection_Input_Info_FD92_CombinedDataElement
          AME_Set_External_Output_Status_FD93: DcmDspDidIdentifier=64915, DcmDspDidInfoRef=DidInfo_AME_Set_External_Output_Status_FD93
            HW (DcmDspDidSignal): DcmDspDidDataPos=0, DcmDspDidDataRef=AME_Set_External_Output_Status_FD93_HW
            Status (DcmDspDidSignal): DcmDspDidDataPos=8, DcmDspDidDataRef=AME_Set_External_Output_Status_FD93_Status
          Set_debug_on_off_control_FDF0: DcmDspDidIdentifier=65008, DcmDspDidInfoRef=DidInfo_Set_debug_on_off_control_FDF0
            CombinedDataElement (DcmDspDidSignal): DcmDspDidDataPos=0, DcmDspDidDataRef=Set_debug_on_off_control_FDF0_CombinedDataElement
          Switch_HU_boot_mode_FDF1: DcmDspDidIdentifier=65009, DcmDspDidInfoRef=DidInfo_Switch_HU_boot_mode_FDF1
            Boot_Mode (DcmDspDidSignal): DcmDspDidDataPos=0, DcmDspDidDataRef=Switch_HU_boot_mode_FDF1_Boot_Mode
        84 x DcmDspDidInfo:
          DidInfo_Vehicle_Speed_D001
            DcmDspDidAccess
              DcmDspDidRead
          DidInfo_Engine_Speed_D002
            DcmDspDidAccess
              DcmDspDidRead
          DidInfo_Operating_Voltage_Value_D003
            DcmDspDidAccess
              DcmDspDidRead
          DidInfo_Odometer_D004
            DcmDspDidAccess
              DcmDspDidRead
          DidInfo_DTC_Occurrence_Timer_D005
            DcmDspDidAccess
              DcmDspDidRead
          DidInfo_Number_of_installed_cameras_E001
            DcmDspDidAccess
              DcmDspDidRead
          DidInfo_Screen_resolution_E002
            DcmDspDidAccess
              DcmDspDidRead
          DidInfo_Present_GPS_coordinates_shift_data_E003
            DcmDspDidAccess
              DcmDspDidRead
          DidInfo_Bluetooth_Current_Discoverability_modes_E005
            DcmDspDidAccess
              DcmDspDidRead
          DidInfo_Bluetooth_Status_E006
            DcmDspDidAccess
              DcmDspDidRead
          DidInfo_BT_Power_Class_E007
            DcmDspDidAccess
              DcmDspDidRead
          DidInfo_BT_active_profile_list_E008
            DcmDspDidAccess
              DcmDspDidRead
          DidInfo_BT_firmware_version_E009
            DcmDspDidAccess
              DcmDspDidRead
          DidInfo_Audio_jack_status_E00A
            DcmDspDidAccess
              DcmDspDidRead
          DidInfo_Number_of_external_USB_devices_plugged_E00B
            DcmDspDidAccess
              DcmDspDidRead
          DidInfo_Currently_connected_USB_Type_E00C
            DcmDspDidAccess
              DcmDspDidRead
          DidInfo_Support_AM_frequency_Min_E00D
            DcmDspDidAccess
              DcmDspDidRead
          DidInfo_Support_AM_frequency_Max_E00E
            DcmDspDidAccess
              DcmDspDidRead
          DidInfo_Support_FM_frequency_Min_E00F
            DcmDspDidAccess
              DcmDspDidRead
          DidInfo_Support_FM_frequency_Max_E010
            DcmDspDidAccess
              DcmDspDidRead
          DidInfo_AM_signal_Strength_E011
            DcmDspDidAccess
              DcmDspDidRead
          DidInfo_FM_signal_Strength_E012
            DcmDspDidAccess
              DcmDspDidRead
          DidInfo_Wi_Fi_Module_Status_E013
            DcmDspDidAccess
              DcmDspDidRead
          DidInfo_Wi_Fi_Module_Firmware_Version_E014
            DcmDspDidAccess
              DcmDspDidRead
          DidInfo_Wi_Fi_Module_Hardware_Part_Number_E015
            DcmDspDidAccess
              DcmDspDidRead
          DidInfo_Tbox_IP_Address_E016
            DcmDspDidAccess
              DcmDspDidRead
          DidInfo_Tbox_Gateway_sub_mask_E017
            DcmDspDidAccess
              DcmDspDidRead
          DidInfo_Tbox_Last_connection_lost_time_stamp_E018
            DcmDspDidAccess
              DcmDspDidRead
          DidInfo_Tbox_geographical_coordinates_when_connection_lost_E019
            DcmDspDidAccess
              DcmDspDidRead
          DidInfo_Telematics_Module_Status_E01A
            DcmDspDidAccess
              DcmDspDidRead
          DidInfo_Number_of_installed_speakers_E01C
            DcmDspDidAccess
              DcmDspDidRead
          DidInfo_Vehicle_Manufacture_Spare_Part_Number_F187
            DcmDspDidAccess
              DcmDspDidRead
          DidInfo_System_Supplier_Identifier_F18A
            DcmDspDidAccess
              DcmDspDidRead
          DidInfo_ECU_Serial_Number_F18C
            DcmDspDidAccess
              DcmDspDidRead
              DcmDspDidWrite: DcmDspDidWriteSessionRef=DcmDspSession/Extended, DcmDspDidWriteSecurityLevelRef=UnlockedL1
          DidInfo_Vehicle_Identification_Number_F190
            DcmDspDidAccess
              DcmDspDidRead
              DcmDspDidWrite: DcmDspDidWriteSessionRef=DcmDspSession/Extended, DcmDspDidWriteSecurityLevelRef=UnlockedL1
          DidInfo_System_Supplier_ECU_Hardware_Version_Number_F193
            DcmDspDidAccess
              DcmDspDidRead
          DidInfo_System_Supplier_ECU_Software_Version_Number_F195
            DcmDspDidAccess
              DcmDspDidRead
          DidInfo_VehicleNetworkConfiguration_F1A1
            DcmDspDidAccess
              DcmDspDidRead
              DcmDspDidWrite: DcmDspDidWriteSessionRef=DcmDspSession/Extended, DcmDspDidWriteSecurityLevelRef=UnlockedL1
          DidInfo_C_matrix_Version_of_the_ECU_product_F1A2
            DcmDspDidAccess
              DcmDspDidRead
          DidInfo_AME_Power_Control_FD01
            DcmDspDidAccess
              DcmDspDidWrite
          DidInfo_AME_Switch_BIOS_Mode_FD02
            DcmDspDidAccess
              DcmDspDidWrite
          DidInfo_AME_Read_SW_and_HW_Version_FD04
            DcmDspDidAccess
              DcmDspDidRead
          DidInfo_AME_Reset_Factory_Mode_FD05
            DcmDspDidAccess
              DcmDspDidWrite
          DidInfo_AME_Read_harman_manufactory_part_number_FD06
            DcmDspDidAccess
              DcmDspDidRead
          DidInfo_AME_Write_harman_manufactory_part_number_FD07
            DcmDspDidAccess
              DcmDspDidWrite
          DidInfo_AME_Read_AME_diagnostic_version_FD08
            DcmDspDidAccess
              DcmDspDidRead
          DidInfo_AME_Read_FAN_speed_FD11
            DcmDspDidAccess
              DcmDspDidRead
          DidInfo_AME_Set_FAN_speed_FD12
            DcmDspDidAccess
              DcmDspDidWrite
          DidInfo_AME_Read_system_temperature_FD13
            DcmDspDidAccess
              DcmDspDidRead
          DidInfo_AME_Read_system_voltage_FD14
            DcmDspDidAccess
              DcmDspDidRead
          DidInfo_AME_Input_Output_OnOff_control_FD18
            DcmDspDidAccess
              DcmDspDidWrite
          DidInfo_AME_Skip_welcome_confirm_FD20
            DcmDspDidAccess
              DcmDspDidWrite
          DidInfo_AME_Set_HMI_Language_FD21
            DcmDspDidAccess
              DcmDspDidWrite
          DidInfo_AME_Set_Volume_FD30
            DcmDspDidAccess
              DcmDspDidWrite
          DidInfo_AME_Set_Mute_Control_FD31
            DcmDspDidAccess
              DcmDspDidWrite
          DidInfo_AME_Select_Speaker_Zone_FD33
            DcmDspDidAccess
              DcmDspDidWrite
          DidInfo_Select_Speaker_Test_Tone_FD34
            DcmDspDidAccess
              DcmDspDidWrite
          DidInfo_AME_Route_MIC_To_Internal_Speaker_FD36
            DcmDspDidAccess
              DcmDspDidWrite
          DidInfo_AME_Route_Video_To_HMI_FD37
            DcmDspDidAccess
              DcmDspDidWrite
          DidInfo_AME_Display_Color_Bar_Control_FD38
            DcmDspDidAccess
              DcmDspDidWrite
          DidInfo_AME_Select_Audio_Buffer_Channel_Output_FD39
            DcmDspDidAccess
              DcmDspDidWrite
          DidInfo_AME_Switch_Source_FD40
            DcmDspDidAccess
              DcmDspDidWrite
          DidInfo_AME_TrackMedia_Audio_Source_Play_FD41
            DcmDspDidAccess
              DcmDspDidWrite
          DidInfo_AME_Set_FM_Frequency_FD50
            DcmDspDidAccess
              DcmDspDidWrite
          DidInfo_AME_Set_AM_Frequency_FD52
            DcmDspDidAccess
              DcmDspDidWrite
          DidInfo_AME_Read_MAC_Address_FD60
            DcmDspDidAccess
              DcmDspDidRead
          DidInfo_AME_Write_MAC_Address_FD61
            DcmDspDidAccess
              DcmDspDidWrite
          DidInfo_AME_Connectivy_OnOff_Control_FD62
            DcmDspDidAccess
              DcmDspDidWrite
          DidInfo_AME_BT_Auto_Pairing_FD63
            DcmDspDidAccess
              DcmDspDidWrite
          DidInfo_AME_Play_BT_Audio_Control_FD64
            DcmDspDidAccess
              DcmDspDidWrite
          DidInfo_AME_Set_WIFI_Mode_FD67
            DcmDspDidAccess
              DcmDspDidWrite
          DidInfo_AME_BT_Handfree_Loopback_Test_FD6B
            DcmDspDidAccess
              DcmDspDidWrite
          DidInfo_AME_Mirror_Link_connection_FD6D
            DcmDspDidAccess
              DcmDspDidWrite: DcmDspDidWriteSessionRef=DcmDspSession/Extended
          DidInfo_AME_Ethernet_IP_Ping_Function_FD6E
            DcmDspDidAccess
              DcmDspDidWrite
          DidInfo_AME_Enter_NAV_Demo_Mode_FD70
            DcmDspDidAccess
              DcmDspDidWrite
          DidInfo_AME_Read_GYRO_Status_FD71
            DcmDspDidAccess
              DcmDspDidRead
          DidInfo_AME_Read_GPS_Info_FD72
            DcmDspDidAccess
              DcmDspDidRead
          DidInfo_AME_ReadGPSSNR_FD73
            DcmDspDidAccess
              DcmDspDidRead
          DidInfo_AME_TBOX_communication_status_check_FD80
            DcmDspDidAccess
              DcmDspDidRead
          DidInfo_AME_Read_Head_Unit_Connector_Status_FD90
            DcmDspDidAccess
              DcmDspDidRead
          DidInfo_AME_Read_Detection_Input_Info_FD92
            DcmDspDidAccess
              DcmDspDidRead
          DidInfo_AME_Set_External_Output_Status_FD93
            DcmDspDidAccess
              DcmDspDidWrite
          DidInfo_Set_debug_on_off_control_FDF0
            DcmDspDidAccess
              DcmDspDidRead
              DcmDspDidWrite
          DidInfo_Switch_HU_boot_mode_FDF1
            DcmDspDidAccess
              DcmDspDidWrite
        HUT_self_check (DcmDspRoutine):
          DcmDspRequestResultsRoutineSupported = true
          DcmDspStopRoutineSupported = true
          DcmDspRoutineIdentifier = 57601
          DcmDspRoutineInfoRef = RoutineInfo_HUT_self_check
        RoutineInfo_HUT_self_check (DcmDspRoutineInfo)
          DcmDspRoutineAuthorization: DcmDspRoutineSessionRef=DcmDspSession/Extended, DcmDspRoutineSecurityLevelRef=UnlockedL1
        DcmDspSecurity
          Locked (DcmDspSecurityRow): DcmDspSecurityLevel=0
          UnlockedL1 (DcmDspSecurityRow):
            DcmDspSecurityDelayTime = 10
            DcmDspSecurityDelayTimeOnBoot = 0
            DcmDspSecurityKeySize = 4
            DcmDspSecurityLevel = 1
            DcmDspSecurityNumAttDelay = 3
            DcmDspSecuritySeedSize = 4
        DcmDspSession
          Default (DcmDspSessionRow): DcmDspSessionLevel=1, DcmDspSessionP2ServerMax=0.05, DcmDspSessionP2StarServerMax=5
          Extended (DcmDspSessionRow): DcmDspSessionLevel=3, DcmDspSessionP2ServerMax=0.05, DcmDspSessionP2StarServerMax=5
        ComControl (DcmDspComControl)
          DspComContolAllChannel (DcmDspComControlAllChannel)
  module config Dem: module-description=Dem_Impl
    DemConfigSet
      DTCClass_DTC_0X908E87 (DemDTCClass): DemDTCSeverity=DEM_DTC_SEV_CHECK_AT_NEXT_HALT, DemUdsDTC=9473671
      DTC_0X908E87 (DemEventParameter):
        DemEventKind = DEM_EVENT_KIND_SWC
        DemMaxNumberFreezeFrameRecords = 1
        DemDTCClassRef = DTCClass_DTC_0X908E87
        DemExtendedDataClassRef = ExtendedDataClass_83dcefb7
        DemFreezeFrameClassRef = FreezeFrameClass_fb82c988
        DemEventClass:
          DemAgingAllowed = true
          DemAgingCycleCounterThreshold = 80
          DemEventDestination = DEM_DTC_ORIGIN_PRIMARY_MEMORY
          DemEventPriority = 0
          DemEventFailureCycleCounterThreshold = 0
          DemAgingCycleRef = PowerCycle
          DemEnableConditionGroupRef = EnableConditionGroup_3e8e3f33
          DemOperationCycleRef = PowerCycle
          DemDebounceAlgorithmClass
            DemDebounceCounterBased: DemDebounceCounterDecrementStepSize=1, DemDebounceCounterIncrementStepSize=1, DemDebounceCounterJumpDown=false, DemDebounceCounterJumpUp=false
      DTCClass_DTC_0X909502 (DemDTCClass): DemDTCSeverity=DEM_DTC_SEV_MAINTENANCE_ONLY, DemUdsDTC=9475330
      DTC_0X909502 (DemEventParameter):
        DemEventKind = DEM_EVENT_KIND_SWC
        DemMaxNumberFreezeFrameRecords = 1
        DemDTCClassRef = DTCClass_DTC_0X909502
        DemExtendedDataClassRef = ExtendedDataClass_83dcefb7
        DemFreezeFrameClassRef = FreezeFrameClass_fb82c988
        DemEventClass:
          DemAgingAllowed = true
          DemAgingCycleCounterThreshold = 80
          DemEventDestination = DEM_DTC_ORIGIN_PRIMARY_MEMORY
          DemEventPriority = 0
          DemEventFailureCycleCounterThreshold = 0
          DemAgingCycleRef = PowerCycle
          DemEnableConditionGroupRef = EnableConditionGroup_b30aa5c2
          DemOperationCycleRef = PowerCycle
          DemDebounceAlgorithmClass
            DemDebounceCounterBased: DemDebounceCounterDecrementStepSize=1, DemDebounceCounterIncrementStepSize=1, DemDebounceCounterJumpDown=false, DemDebounceCounterJumpUp=false
      DTCClass_DTC_0X909602 (DemDTCClass): DemDTCSeverity=DEM_DTC_SEV_MAINTENANCE_ONLY, DemUdsDTC=9475586
      DTC_0X909602 (DemEventParameter):
        DemEventKind = DEM_EVENT_KIND_SWC
        DemMaxNumberFreezeFrameRecords = 1
        DemDTCClassRef = DTCClass_DTC_0X909602
        DemExtendedDataClassRef = ExtendedDataClass_83dcefb7
        DemFreezeFrameClassRef = FreezeFrameClass_fb82c988
        DemEventClass:
          DemAgingAllowed = true
          DemAgingCycleCounterThreshold = 80
          DemEventDestination = DEM_DTC_ORIGIN_PRIMARY_MEMORY
          DemEventPriority = 0
          DemEventFailureCycleCounterThreshold = 0
          DemAgingCycleRef = PowerCycle
          DemEnableConditionGroupRef = EnableConditionGroup_b30aa5c2
          DemOperationCycleRef = PowerCycle
          DemDebounceAlgorithmClass
            DemDebounceCounterBased: DemDebounceCounterDecrementStepSize=1, DemDebounceCounterIncrementStepSize=1, DemDebounceCounterJumpDown=false, DemDebounceCounterJumpUp=false
      DTCClass_DTC_0X919F11 (DemDTCClass): DemDTCSeverity=DEM_DTC_SEV_CHECK_AT_NEXT_HALT, DemUdsDTC=9543441
      DTC_0X919F11 (DemEventParameter):
        DemEventKind = DEM_EVENT_KIND_SWC
        DemMaxNumberFreezeFrameRecords = 1
        DemDTCClassRef = DTCClass_DTC_0X919F11
        DemExtendedDataClassRef = ExtendedDataClass_83dcefb7
        DemFreezeFrameClassRef = FreezeFrameClass_fb82c988
        DemEventClass:
          DemAgingAllowed = true
          DemAgingCycleCounterThreshold = 80
          DemEventDestination = DEM_DTC_ORIGIN_PRIMARY_MEMORY
          DemEventPriority = 0
          DemEventFailureCycleCounterThreshold = 0
          DemAgingCycleRef = PowerCycle
          DemEnableConditionGroupRef = EnableConditionGroup_b30aa5c2
          DemOperationCycleRef = PowerCycle
          DemDebounceAlgorithmClass
            DemDebounceCounterBased: DemDebounceCounterDecrementStepSize=1, DemDebounceCounterIncrementStepSize=1, DemDebounceCounterJumpDown=false, DemDebounceCounterJumpUp=false
      DTCClass_DTC_0X919F12 (DemDTCClass): DemDTCSeverity=DEM_DTC_SEV_CHECK_AT_NEXT_HALT, DemUdsDTC=9543442
      DTC_0X919F12 (DemEventParameter):
        DemEventKind = DEM_EVENT_KIND_SWC
        DemMaxNumberFreezeFrameRecords = 1
        DemDTCClassRef = DTCClass_DTC_0X919F12
        DemExtendedDataClassRef = ExtendedDataClass_83dcefb7
        DemFreezeFrameClassRef = FreezeFrameClass_fb82c988
        DemEventClass:
          DemAgingAllowed = true
          DemAgingCycleCounterThreshold = 80
          DemEventDestination = DEM_DTC_ORIGIN_PRIMARY_MEMORY
          DemEventPriority = 0
          DemEventFailureCycleCounterThreshold = 0
          DemAgingCycleRef = PowerCycle
          DemEnableConditionGroupRef = EnableConditionGroup_b30aa5c2
          DemOperationCycleRef = PowerCycle
          DemDebounceAlgorithmClass
            DemDebounceCounterBased: DemDebounceCounterDecrementStepSize=1, DemDebounceCounterIncrementStepSize=1, DemDebounceCounterJumpDown=false, DemDebounceCounterJumpUp=false
      DTCClass_DTC_0X919F13 (DemDTCClass): DemDTCSeverity=DEM_DTC_SEV_CHECK_AT_NEXT_HALT, DemUdsDTC=9543443
      DTC_0X919F13 (DemEventParameter):
        DemEventKind = DEM_EVENT_KIND_SWC
        DemMaxNumberFreezeFrameRecords = 1
        DemDTCClassRef = DTCClass_DTC_0X919F13
        DemExtendedDataClassRef = ExtendedDataClass_83dcefb7
        DemFreezeFrameClassRef = FreezeFrameClass_fb82c988
        DemEventClass:
          DemAgingAllowed = true
          DemAgingCycleCounterThreshold = 80
          DemEventDestination = DEM_DTC_ORIGIN_PRIMARY_MEMORY
          DemEventPriority = 0
          DemEventFailureCycleCounterThreshold = 0
          DemAgingCycleRef = PowerCycle
          DemEnableConditionGroupRef = EnableConditionGroup_b30aa5c2
          DemOperationCycleRef = PowerCycle
          DemDebounceAlgorithmClass
            DemDebounceCounterBased: DemDebounceCounterDecrementStepSize=1, DemDebounceCounterIncrementStepSize=1, DemDebounceCounterJumpDown=false, DemDebounceCounterJumpUp=false
      DTCClass_DTC_0X91BA63 (DemDTCClass): DemDTCSeverity=DEM_DTC_SEV_CHECK_AT_NEXT_HALT, DemUdsDTC=9550435
      DTC_0X91BA63 (DemEventParameter):
        DemEventKind = DEM_EVENT_KIND_SWC
        DemMaxNumberFreezeFrameRecords = 1
        DemDTCClassRef = DTCClass_DTC_0X91BA63
        DemExtendedDataClassRef = ExtendedDataClass_83dcefb7
        DemFreezeFrameClassRef = FreezeFrameClass_fb82c988
        DemEventClass:
          DemAgingAllowed = true
          DemAgingCycleCounterThreshold = 80
          DemEventDestination = DEM_DTC_ORIGIN_PRIMARY_MEMORY
          DemEventPriority = 0
          DemEventFailureCycleCounterThreshold = 0
          DemAgingCycleRef = PowerCycle
          DemEnableConditionGroupRef = EnableConditionGroup_5fbd712e
          DemOperationCycleRef = PowerCycle
          DemDebounceAlgorithmClass
            DemDebounceCounterBased: DemDebounceCounterDecrementStepSize=1, DemDebounceCounterIncrementStepSize=1, DemDebounceCounterJumpDown=false, DemDebounceCounterJumpUp=false
      DTCClass_DTC_0X923816 (DemDTCClass): DemDTCSeverity=DEM_DTC_SEV_MAINTENANCE_ONLY, DemUdsDTC=9582614
      DTC_0X923816 (DemEventParameter):
        DemEventKind = DEM_EVENT_KIND_SWC
        DemMaxNumberFreezeFrameRecords = 1
        DemDTCClassRef = DTCClass_DTC_0X923816
        DemExtendedDataClassRef = ExtendedDataClass_83dcefb7
        DemFreezeFrameClassRef = FreezeFrameClass_fb82c988
        DemEventClass:
          DemAgingAllowed = true
          DemAgingCycleCounterThreshold = 80
          DemEventDestination = DEM_DTC_ORIGIN_PRIMARY_MEMORY
          DemEventPriority = 0
          DemEventFailureCycleCounterThreshold = 0
          DemAgingCycleRef = PowerCycle
          DemEnableConditionGroupRef = EnableConditionGroup_b30aa5c2
          DemOperationCycleRef = PowerCycle
          DemDebounceAlgorithmClass
            DemDebounceCounterBased: DemDebounceCounterDecrementStepSize=1, DemDebounceCounterIncrementStepSize=1, DemDebounceCounterJumpDown=false, DemDebounceCounterJumpUp=false
      DTCClass_DTC_0X923817 (DemDTCClass): DemDTCSeverity=DEM_DTC_SEV_MAINTENANCE_ONLY, DemUdsDTC=9582615
      DTC_0X923817 (DemEventParameter):
        DemEventKind = DEM_EVENT_KIND_SWC
        DemMaxNumberFreezeFrameRecords = 1
        DemDTCClassRef = DTCClass_DTC_0X923817
        DemExtendedDataClassRef = ExtendedDataClass_83dcefb7
        DemFreezeFrameClassRef = FreezeFrameClass_fb82c988
        DemEventClass:
          DemAgingAllowed = true
          DemAgingCycleCounterThreshold = 80
          DemEventDestination = DEM_DTC_ORIGIN_PRIMARY_MEMORY
          DemEventPriority = 0
          DemEventFailureCycleCounterThreshold = 0
          DemAgingCycleRef = PowerCycle
          DemEnableConditionGroupRef = EnableConditionGroup_b30aa5c2
          DemOperationCycleRef = PowerCycle
          DemDebounceAlgorithmClass
            DemDebounceCounterBased: DemDebounceCounterDecrementStepSize=1, DemDebounceCounterIncrementStepSize=1, DemDebounceCounterJumpDown=false, DemDebounceCounterJumpUp=false
      DTCClass_DTC_0X925211 (DemDTCClass): DemDTCSeverity=DEM_DTC_SEV_MAINTENANCE_ONLY, DemUdsDTC=9589250
      DTC_0X925211 (DemEventParameter):
        DemEventKind = DEM_EVENT_KIND_SWC
        DemMaxNumberFreezeFrameRecords = 1
        DemDTCClassRef = DTCClass_DTC_0X925211
        DemExtendedDataClassRef = ExtendedDataClass_83dcefb7
        DemFreezeFrameClassRef = FreezeFrameClass_fb82c988
        DemEventClass:
          DemAgingAllowed = true
          DemAgingCycleCounterThreshold = 80
          DemEventDestination = DEM_DTC_ORIGIN_PRIMARY_MEMORY
          DemEventPriority = 0
          DemEventFailureCycleCounterThreshold = 0
          DemAgingCycleRef = PowerCycle
          DemEnableConditionGroupRef = EnableConditionGroup_b30aa5c2
          DemOperationCycleRef = PowerCycle
          DemDebounceAlgorithmClass
            DemDebounceCounterBased: DemDebounceCounterDecrementStepSize=1, DemDebounceCounterIncrementStepSize=1, DemDebounceCounterJumpDown=false, DemDebounceCounterJumpUp=false
      DTCClass_DTC_0X925311 (DemDTCClass): DemDTCSeverity=DEM_DTC_SEV_MAINTENANCE_ONLY, DemUdsDTC=9589506
      DTC_0X925311 (DemEventParameter):
        DemEventKind = DEM_EVENT_KIND_SWC
        DemMaxNumberFreezeFrameRecords = 1
        DemDTCClassRef = DTCClass_DTC_0X925311
        DemExtendedDataClassRef = ExtendedDataClass_83dcefb7
        DemFreezeFrameClassRef = FreezeFrameClass_fb82c988
        DemEventClass:
          DemAgingAllowed = true
          DemAgingCycleCounterThreshold = 80
          DemEventDestination = DEM_DTC_ORIGIN_PRIMARY_MEMORY
          DemEventPriority = 0
          DemEventFailureCycleCounterThreshold = 0
          DemAgingCycleRef = PowerCycle
          DemEnableConditionGroupRef = EnableConditionGroup_b30aa5c2
          DemOperationCycleRef = PowerCycle
          DemDebounceAlgorithmClass
            DemDebounceCounterBased: DemDebounceCounterDecrementStepSize=1, DemDebounceCounterIncrementStepSize=1, DemDebounceCounterJumpDown=false, DemDebounceCounterJumpUp=false
      DTCClass_DTC_0X925411 (DemDTCClass): DemDTCSeverity=DEM_DTC_SEV_MAINTENANCE_ONLY, DemUdsDTC=9589762
      DTC_0X925411 (DemEventParameter):
        DemEventKind = DEM_EVENT_KIND_SWC
        DemMaxNumberFreezeFrameRecords = 1
        DemDTCClassRef = DTCClass_DTC_0X925411
        DemExtendedDataClassRef = ExtendedDataClass_83dcefb7
        DemFreezeFrameClassRef = FreezeFrameClass_fb82c988
        DemEventClass:
          DemAgingAllowed = true
          DemAgingCycleCounterThreshold = 80
          DemEventDestination = DEM_DTC_ORIGIN_PRIMARY_MEMORY
          DemEventPriority = 0
          DemEventFailureCycleCounterThreshold = 0
          DemAgingCycleRef = PowerCycle
          DemEnableConditionGroupRef = EnableConditionGroup_b30aa5c2
          DemOperationCycleRef = PowerCycle
          DemDebounceAlgorithmClass
            DemDebounceCounterBased: DemDebounceCounterDecrementStepSize=1, DemDebounceCounterIncrementStepSize=1, DemDebounceCounterJumpDown=false, DemDebounceCounterJumpUp=false
      DTCClass_DTC_0X93F511 (DemDTCClass): DemDTCSeverity=DEM_DTC_SEV_CHECK_AT_NEXT_HALT, DemUdsDTC=9696529
      DTC_0X93F511 (DemEventParameter):
        DemEventKind = DEM_EVENT_KIND_SWC
        DemMaxNumberFreezeFrameRecords = 1
        DemDTCClassRef = DTCClass_DTC_0X93F511
        DemExtendedDataClassRef = ExtendedDataClass_83dcefb7
        DemFreezeFrameClassRef = FreezeFrameClass_fb82c988
        DemEventClass:
          DemAgingAllowed = true
          DemAgingCycleCounterThreshold = 80
          DemEventDestination = DEM_DTC_ORIGIN_PRIMARY_MEMORY
          DemEventPriority = 0
          DemEventFailureCycleCounterThreshold = 0
          DemAgingCycleRef = PowerCycle
          DemEnableConditionGroupRef = EnableConditionGroup_b30aa5c2
          DemOperationCycleRef = PowerCycle
          DemDebounceAlgorithmClass
            DemDebounceCounterBased: DemDebounceCounterDecrementStepSize=1, DemDebounceCounterIncrementStepSize=1, DemDebounceCounterJumpDown=false, DemDebounceCounterJumpUp=false
      DTCClass_DTC_0X93F512 (DemDTCClass): DemDTCSeverity=DEM_DTC_SEV_CHECK_AT_NEXT_HALT, DemUdsDTC=9696530
      DTC_0X93F512 (DemEventParameter):
        DemEventKind = DEM_EVENT_KIND_SWC
        DemMaxNumberFreezeFrameRecords = 1
        DemDTCClassRef = DTCClass_DTC_0X93F512
        DemExtendedDataClassRef = ExtendedDataClass_83dcefb7
        DemFreezeFrameClassRef = FreezeFrameClass_fb82c988
        DemEventClass:
          DemAgingAllowed = true
          DemAgingCycleCounterThreshold = 80
          DemEventDestination = DEM_DTC_ORIGIN_PRIMARY_MEMORY
          DemEventPriority = 0
          DemEventFailureCycleCounterThreshold = 0
          DemAgingCycleRef = PowerCycle
          DemEnableConditionGroupRef = EnableConditionGroup_b30aa5c2
          DemOperationCycleRef = PowerCycle
          DemDebounceAlgorithmClass
            DemDebounceCounterBased: DemDebounceCounterDecrementStepSize=1, DemDebounceCounterIncrementStepSize=1, DemDebounceCounterJumpDown=false, DemDebounceCounterJumpUp=false
      DTCClass_DTC_0X93F513 (DemDTCClass): DemDTCSeverity=DEM_DTC_SEV_CHECK_AT_NEXT_HALT, DemUdsDTC=9696531
      DTC_0X93F513 (DemEventParameter):
        DemEventKind = DEM_EVENT_KIND_SWC
        DemMaxNumberFreezeFrameRecords = 1
        DemDTCClassRef = DTCClass_DTC_0X93F513
        DemExtendedDataClassRef = ExtendedDataClass_83dcefb7
        DemFreezeFrameClassRef = FreezeFrameClass_fb82c988
        DemEventClass:
          DemAgingAllowed = true
          DemAgingCycleCounterThreshold = 80
          DemEventDestination = DEM_DTC_ORIGIN_PRIMARY_MEMORY
          DemEventPriority = 0
          DemEventFailureCycleCounterThreshold = 0
          DemAgingCycleRef = PowerCycle
          DemEnableConditionGroupRef = EnableConditionGroup_b30aa5c2
          DemOperationCycleRef = PowerCycle
          DemDebounceAlgorithmClass
            DemDebounceCounterBased: DemDebounceCounterDecrementStepSize=1, DemDebounceCounterIncrementStepSize=1, DemDebounceCounterJumpDown=false, DemDebounceCounterJumpUp=false
      DTCClass_DTC_0X93F611 (DemDTCClass): DemDTCSeverity=DEM_DTC_SEV_CHECK_AT_NEXT_HALT, DemUdsDTC=9696785
      DTC_0X93F611 (DemEventParameter):
        DemEventKind = DEM_EVENT_KIND_SWC
        DemMaxNumberFreezeFrameRecords = 1
        DemDTCClassRef = DTCClass_DTC_0X93F611
        DemExtendedDataClassRef = ExtendedDataClass_83dcefb7
        DemFreezeFrameClassRef = FreezeFrameClass_fb82c988
        DemEventClass:
          DemAgingAllowed = true
          DemAgingCycleCounterThreshold = 80
          DemEventDestination = DEM_DTC_ORIGIN_PRIMARY_MEMORY
          DemEventPriority = 0
          DemEventFailureCycleCounterThreshold = 0
          DemAgingCycleRef = PowerCycle
          DemEnableConditionGroupRef = EnableConditionGroup_b30aa5c2
          DemOperationCycleRef = PowerCycle
          DemDebounceAlgorithmClass
            DemDebounceCounterBased: DemDebounceCounterDecrementStepSize=1, DemDebounceCounterIncrementStepSize=1, DemDebounceCounterJumpDown=false, DemDebounceCounterJumpUp=false
      DTCClass_DTC_0X93F612 (DemDTCClass): DemDTCSeverity=DEM_DTC_SEV_CHECK_AT_NEXT_HALT, DemUdsDTC=9696786
      DTC_0X93F612 (DemEventParameter):
        DemEventKind = DEM_EVENT_KIND_SWC
        DemMaxNumberFreezeFrameRecords = 1
        DemDTCClassRef = DTCClass_DTC_0X93F612
        DemExtendedDataClassRef = ExtendedDataClass_83dcefb7
        DemFreezeFrameClassRef = FreezeFrameClass_fb82c988
        DemEventClass:
          DemAgingAllowed = true
          DemAgingCycleCounterThreshold = 80
          DemEventDestination = DEM_DTC_ORIGIN_PRIMARY_MEMORY
          DemEventPriority = 0
          DemEventFailureCycleCounterThreshold = 0
          DemAgingCycleRef = PowerCycle
          DemEnableConditionGroupRef = EnableConditionGroup_b30aa5c2
          DemOperationCycleRef = PowerCycle
          DemDebounceAlgorithmClass
            DemDebounceCounterBased: DemDebounceCounterDecrementStepSize=1, DemDebounceCounterIncrementStepSize=1, DemDebounceCounterJumpDown=false, DemDebounceCounterJumpUp=false
      DTCClass_DTC_0X93F613 (DemDTCClass): DemDTCSeverity=DEM_DTC_SEV_CHECK_AT_NEXT_HALT, DemUdsDTC=9696787
      DTC_0X93F613 (DemEventParameter):
        DemEventKind = DEM_EVENT_KIND_SWC
        DemMaxNumberFreezeFrameRecords = 1
        DemDTCClassRef = DTCClass_DTC_0X93F613
        DemExtendedDataClassRef = ExtendedDataClass_83dcefb7
        DemFreezeFrameClassRef = FreezeFrameClass_fb82c988
        DemEventClass:
          DemAgingAllowed = true
          DemAgingCycleCounterThreshold = 80
          DemEventDestination = DEM_DTC_ORIGIN_PRIMARY_MEMORY
          DemEventPriority = 0
          DemEventFailureCycleCounterThreshold = 0
          DemAgingCycleRef = PowerCycle
          DemEnableConditionGroupRef = EnableConditionGroup_b30aa5c2
          DemOperationCycleRef = PowerCycle
          DemDebounceAlgorithmClass
            DemDebounceCounterBased: DemDebounceCounterDecrementStepSize=1, DemDebounceCounterIncrementStepSize=1, DemDebounceCounterJumpDown=false, DemDebounceCounterJumpUp=false
      DTCClass_DTC_0X9A0101 (DemDTCClass): DemDTCSeverity=DEM_DTC_SEV_MAINTENANCE_ONLY, DemUdsDTC=10092801
      DTC_0X9A0101 (DemEventParameter):
        DemEventKind = DEM_EVENT_KIND_SWC
        DemMaxNumberFreezeFrameRecords = 1
        DemDTCClassRef = DTCClass_DTC_0X9A0101
        DemExtendedDataClassRef = ExtendedDataClass_83dcefb7
        DemFreezeFrameClassRef = FreezeFrameClass_fb82c988
        DemEventClass:
          DemAgingAllowed = true
          DemAgingCycleCounterThreshold = 80
          DemEventDestination = DEM_DTC_ORIGIN_PRIMARY_MEMORY
          DemEventPriority = 0
          DemEventFailureCycleCounterThreshold = 0
          DemAgingCycleRef = PowerCycle
          DemEnableConditionGroupRef = EnableConditionGroup_b30aa5c2
          DemOperationCycleRef = PowerCycle
          DemDebounceAlgorithmClass
            DemDebounceCounterBased: DemDebounceCounterDecrementStepSize=1, DemDebounceCounterIncrementStepSize=1, DemDebounceCounterJumpDown=false, DemDebounceCounterJumpUp=false
      DTCClass_DTC_0X9A0111 (DemDTCClass): DemDTCSeverity=DEM_DTC_SEV_MAINTENANCE_ONLY, DemUdsDTC=10092817
      DTC_0X9A0111 (DemEventParameter):
        DemEventKind = DEM_EVENT_KIND_SWC
        DemMaxNumberFreezeFrameRecords = 1
        DemDTCClassRef = DTCClass_DTC_0X9A0111
        DemExtendedDataClassRef = ExtendedDataClass_83dcefb7
        DemFreezeFrameClassRef = FreezeFrameClass_fb82c988
        DemEventClass:
          DemAgingAllowed = true
          DemAgingCycleCounterThreshold = 80
          DemEventDestination = DEM_DTC_ORIGIN_PRIMARY_MEMORY
          DemEventPriority = 0
          DemEventFailureCycleCounterThreshold = 0
          DemAgingCycleRef = PowerCycle
          DemEnableConditionGroupRef = EnableConditionGroup_b30aa5c2
          DemOperationCycleRef = PowerCycle
          DemDebounceAlgorithmClass
            DemDebounceCounterBased: DemDebounceCounterDecrementStepSize=1, DemDebounceCounterIncrementStepSize=1, DemDebounceCounterJumpDown=false, DemDebounceCounterJumpUp=false
      DTCClass_DTC_0X9A0112 (DemDTCClass): DemDTCSeverity=DEM_DTC_SEV_MAINTENANCE_ONLY, DemUdsDTC=10092818
      DTC_0X9A0112 (DemEventParameter):
        DemEventKind = DEM_EVENT_KIND_SWC
        DemMaxNumberFreezeFrameRecords = 1
        DemDTCClassRef = DTCClass_DTC_0X9A0112
        DemExtendedDataClassRef = ExtendedDataClass_83dcefb7
        DemFreezeFrameClassRef = FreezeFrameClass_fb82c988
        DemEventClass:
          DemAgingAllowed = true
          DemAgingCycleCounterThreshold = 80
          DemEventDestination = DEM_DTC_ORIGIN_PRIMARY_MEMORY
          DemEventPriority = 0
          DemEventFailureCycleCounterThreshold = 0
          DemAgingCycleRef = PowerCycle
          DemEnableConditionGroupRef = EnableConditionGroup_b30aa5c2
          DemOperationCycleRef = PowerCycle
          DemDebounceAlgorithmClass
            DemDebounceCounterBased: DemDebounceCounterDecrementStepSize=1, DemDebounceCounterIncrementStepSize=1, DemDebounceCounterJumpDown=false, DemDebounceCounterJumpUp=false
      DTCClass_DTC_0X9A0113 (DemDTCClass): DemDTCSeverity=DEM_DTC_SEV_MAINTENANCE_ONLY, DemUdsDTC=10092819
      DTC_0X9A0113 (DemEventParameter):
        DemEventKind = DEM_EVENT_KIND_SWC
        DemMaxNumberFreezeFrameRecords = 1
        DemDTCClassRef = DTCClass_DTC_0X9A0113
        DemExtendedDataClassRef = ExtendedDataClass_83dcefb7
        DemFreezeFrameClassRef = FreezeFrameClass_fb82c988
        DemEventClass:
          DemAgingAllowed = true
          DemAgingCycleCounterThreshold = 80
          DemEventDestination = DEM_DTC_ORIGIN_PRIMARY_MEMORY
          DemEventPriority = 0
          DemEventFailureCycleCounterThreshold = 0
          DemAgingCycleRef = PowerCycle
          DemEnableConditionGroupRef = EnableConditionGroup_b30aa5c2
          DemOperationCycleRef = PowerCycle
          DemDebounceAlgorithmClass
            DemDebounceCounterBased: DemDebounceCounterDecrementStepSize=1, DemDebounceCounterIncrementStepSize=1, DemDebounceCounterJumpDown=false, DemDebounceCounterJumpUp=false
      DTCClass_DTC_0X9A011E (DemDTCClass): DemDTCSeverity=DEM_DTC_SEV_MAINTENANCE_ONLY, DemUdsDTC=10092830
      DTC_0X9A011E (DemEventParameter):
        DemEventKind = DEM_EVENT_KIND_SWC
        DemMaxNumberFreezeFrameRecords = 1
        DemDTCClassRef = DTCClass_DTC_0X9A011E
        DemExtendedDataClassRef = ExtendedDataClass_83dcefb7
        DemFreezeFrameClassRef = FreezeFrameClass_fb82c988
        DemEventClass:
          DemAgingAllowed = true
          DemAgingCycleCounterThreshold = 80
          DemEventDestination = DEM_DTC_ORIGIN_PRIMARY_MEMORY
          DemEventPriority = 0
          DemEventFailureCycleCounterThreshold = 0
          DemAgingCycleRef = PowerCycle
          DemEnableConditionGroupRef = EnableConditionGroup_b30aa5c2
          DemOperationCycleRef = PowerCycle
          DemDebounceAlgorithmClass
            DemDebounceCounterBased: DemDebounceCounterDecrementStepSize=1, DemDebounceCounterIncrementStepSize=1, DemDebounceCounterJumpDown=false, DemDebounceCounterJumpUp=false
      DTCClass_DTC_0X9A0125 (DemDTCClass): DemDTCSeverity=DEM_DTC_SEV_MAINTENANCE_ONLY, DemUdsDTC=10092837
      DTC_0X9A0125 (DemEventParameter):
        DemEventKind = DEM_EVENT_KIND_SWC
        DemMaxNumberFreezeFrameRecords = 1
        DemDTCClassRef = DTCClass_DTC_0X9A0125
        DemExtendedDataClassRef = ExtendedDataClass_83dcefb7
        DemFreezeFrameClassRef = FreezeFrameClass_fb82c988
        DemEventClass:
          DemAgingAllowed = true
          DemAgingCycleCounterThreshold = 80
          DemEventDestination = DEM_DTC_ORIGIN_PRIMARY_MEMORY
          DemEventPriority = 0
          DemEventFailureCycleCounterThreshold = 0
          DemAgingCycleRef = PowerCycle
          DemEnableConditionGroupRef = EnableConditionGroup_b30aa5c2
          DemOperationCycleRef = PowerCycle
          DemDebounceAlgorithmClass
            DemDebounceCounterBased: DemDebounceCounterDecrementStepSize=1, DemDebounceCounterIncrementStepSize=1, DemDebounceCounterJumpDown=false, DemDebounceCounterJumpUp=false
      DTCClass_DTC_0X9A0201 (DemDTCClass): DemDTCSeverity=DEM_DTC_SEV_MAINTENANCE_ONLY, DemUdsDTC=10093057
      DTC_0X9A0201 (DemEventParameter):
        DemEventKind = DEM_EVENT_KIND_SWC
        DemMaxNumberFreezeFrameRecords = 1
        DemDTCClassRef = DTCClass_DTC_0X9A0201
        DemExtendedDataClassRef = ExtendedDataClass_83dcefb7
        DemFreezeFrameClassRef = FreezeFrameClass_fb82c988
        DemEventClass:
          DemAgingAllowed = true
          DemAgingCycleCounterThreshold = 80
          DemEventDestination = DEM_DTC_ORIGIN_PRIMARY_MEMORY
          DemEventPriority = 0
          DemEventFailureCycleCounterThreshold = 0
          DemAgingCycleRef = PowerCycle
          DemEnableConditionGroupRef = EnableConditionGroup_b30aa5c2
          DemOperationCycleRef = PowerCycle
          DemDebounceAlgorithmClass
            DemDebounceCounterBased: DemDebounceCounterDecrementStepSize=1, DemDebounceCounterIncrementStepSize=1, DemDebounceCounterJumpDown=false, DemDebounceCounterJumpUp=false
      DTCClass_DTC_0X9A0211 (DemDTCClass): DemDTCSeverity=DEM_DTC_SEV_MAINTENANCE_ONLY, DemUdsDTC=10093073
      DTC_0X9A0211 (DemEventParameter):
        DemEventKind = DEM_EVENT_KIND_SWC
        DemMaxNumberFreezeFrameRecords = 1
        DemDTCClassRef = DTCClass_DTC_0X9A0211
        DemExtendedDataClassRef = ExtendedDataClass_83dcefb7
        DemFreezeFrameClassRef = FreezeFrameClass_fb82c988
        DemEventClass:
          DemAgingAllowed = true
          DemAgingCycleCounterThreshold = 80
          DemEventDestination = DEM_DTC_ORIGIN_PRIMARY_MEMORY
          DemEventPriority = 0
          DemEventFailureCycleCounterThreshold = 0
          DemAgingCycleRef = PowerCycle
          DemEnableConditionGroupRef = EnableConditionGroup_b30aa5c2
          DemOperationCycleRef = PowerCycle
          DemDebounceAlgorithmClass
            DemDebounceCounterBased: DemDebounceCounterDecrementStepSize=1, DemDebounceCounterIncrementStepSize=1, DemDebounceCounterJumpDown=false, DemDebounceCounterJumpUp=false
      DTCClass_DTC_0X9A0212 (DemDTCClass): DemDTCSeverity=DEM_DTC_SEV_MAINTENANCE_ONLY, DemUdsDTC=10093074
      DTC_0X9A0212 (DemEventParameter):
        DemEventKind = DEM_EVENT_KIND_SWC
        DemMaxNumberFreezeFrameRecords = 1
        DemDTCClassRef = DTCClass_DTC_0X9A0212
        DemExtendedDataClassRef = ExtendedDataClass_83dcefb7
        DemFreezeFrameClassRef = FreezeFrameClass_fb82c988
        DemEventClass:
          DemAgingAllowed = true
          DemAgingCycleCounterThreshold = 80
          DemEventDestination = DEM_DTC_ORIGIN_PRIMARY_MEMORY
          DemEventPriority = 0
          DemEventFailureCycleCounterThreshold = 0
          DemAgingCycleRef = PowerCycle
          DemEnableConditionGroupRef = EnableConditionGroup_b30aa5c2
          DemOperationCycleRef = PowerCycle
          DemDebounceAlgorithmClass
            DemDebounceCounterBased: DemDebounceCounterDecrementStepSize=1, DemDebounceCounterIncrementStepSize=1, DemDebounceCounterJumpDown=false, DemDebounceCounterJumpUp=false
      DTCClass_DTC_0X9A0213 (DemDTCClass): DemDTCSeverity=DEM_DTC_SEV_MAINTENANCE_ONLY, DemUdsDTC=10093075
      DTC_0X9A0213 (DemEventParameter):
        DemEventKind = DEM_EVENT_KIND_SWC
        DemMaxNumberFreezeFrameRecords = 1
        DemDTCClassRef = DTCClass_DTC_0X9A0213
        DemExtendedDataClassRef = ExtendedDataClass_83dcefb7
        DemFreezeFrameClassRef = FreezeFrameClass_fb82c988
        DemEventClass:
          DemAgingAllowed = true
          DemAgingCycleCounterThreshold = 80
          DemEventDestination = DEM_DTC_ORIGIN_PRIMARY_MEMORY
          DemEventPriority = 0
          DemEventFailureCycleCounterThreshold = 0
          DemAgingCycleRef = PowerCycle
          DemEnableConditionGroupRef = EnableConditionGroup_b30aa5c2
          DemOperationCycleRef = PowerCycle
          DemDebounceAlgorithmClass
            DemDebounceCounterBased: DemDebounceCounterDecrementStepSize=1, DemDebounceCounterIncrementStepSize=1, DemDebounceCounterJumpDown=false, DemDebounceCounterJumpUp=false
      DTCClass_DTC_0X9A021E (DemDTCClass): DemDTCSeverity=DEM_DTC_SEV_MAINTENANCE_ONLY, DemUdsDTC=10093086
      DTC_0X9A021E (DemEventParameter):
        DemEventKind = DEM_EVENT_KIND_SWC
        DemMaxNumberFreezeFrameRecords = 1
        DemDTCClassRef = DTCClass_DTC_0X9A021E
        DemExtendedDataClassRef = ExtendedDataClass_83dcefb7
        DemFreezeFrameClassRef = FreezeFrameClass_fb82c988
        DemEventClass:
          DemAgingAllowed = true
          DemAgingCycleCounterThreshold = 80
          DemEventDestination = DEM_DTC_ORIGIN_PRIMARY_MEMORY
          DemEventPriority = 0
          DemEventFailureCycleCounterThreshold = 0
          DemAgingCycleRef = PowerCycle
          DemEnableConditionGroupRef = EnableConditionGroup_b30aa5c2
          DemOperationCycleRef = PowerCycle
          DemDebounceAlgorithmClass
            DemDebounceCounterBased: DemDebounceCounterDecrementStepSize=1, DemDebounceCounterIncrementStepSize=1, DemDebounceCounterJumpDown=false, DemDebounceCounterJumpUp=false
      DTCClass_DTC_0X9A0225 (DemDTCClass): DemDTCSeverity=DEM_DTC_SEV_MAINTENANCE_ONLY, DemUdsDTC=10093093
      DTC_0X9A0225 (DemEventParameter):
        DemEventKind = DEM_EVENT_KIND_SWC
        DemMaxNumberFreezeFrameRecords = 1
        DemDTCClassRef = DTCClass_DTC_0X9A0225
        DemExtendedDataClassRef = ExtendedDataClass_83dcefb7
        DemFreezeFrameClassRef = FreezeFrameClass_fb82c988
        DemEventClass:
          DemAgingAllowed = true
          DemAgingCycleCounterThreshold = 80
          DemEventDestination = DEM_DTC_ORIGIN_PRIMARY_MEMORY
          DemEventPriority = 0
          DemEventFailureCycleCounterThreshold = 0
          DemAgingCycleRef = PowerCycle
          DemEnableConditionGroupRef = EnableConditionGroup_b30aa5c2
          DemOperationCycleRef = PowerCycle
          DemDebounceAlgorithmClass
            DemDebounceCounterBased: DemDebounceCounterDecrementStepSize=1, DemDebounceCounterIncrementStepSize=1, DemDebounceCounterJumpDown=false, DemDebounceCounterJumpUp=false
      DTCClass_DTC_0X9A0301 (DemDTCClass): DemDTCSeverity=DEM_DTC_SEV_MAINTENANCE_ONLY, DemUdsDTC=10093313
      DTC_0X9A0301 (DemEventParameter):
        DemEventKind = DEM_EVENT_KIND_SWC
        DemMaxNumberFreezeFrameRecords = 1
        DemDTCClassRef = DTCClass_DTC_0X9A0301
        DemExtendedDataClassRef = ExtendedDataClass_83dcefb7
        DemFreezeFrameClassRef = FreezeFrameClass_fb82c988
        DemEventClass:
          DemAgingAllowed = true
          DemAgingCycleCounterThreshold = 80
          DemEventDestination = DEM_DTC_ORIGIN_PRIMARY_MEMORY
          DemEventPriority = 0
          DemEventFailureCycleCounterThreshold = 0
          DemAgingCycleRef = PowerCycle
          DemEnableConditionGroupRef = EnableConditionGroup_b30aa5c2
          DemOperationCycleRef = PowerCycle
          DemDebounceAlgorithmClass
            DemDebounceCounterBased: DemDebounceCounterDecrementStepSize=1, DemDebounceCounterIncrementStepSize=1, DemDebounceCounterJumpDown=false, DemDebounceCounterJumpUp=false
      DTCClass_DTC_0X9A0311 (DemDTCClass): DemDTCSeverity=DEM_DTC_SEV_MAINTENANCE_ONLY, DemUdsDTC=10093329
      DTC_0X9A0311 (DemEventParameter):
        DemEventKind = DEM_EVENT_KIND_SWC
        DemMaxNumberFreezeFrameRecords = 1
        DemDTCClassRef = DTCClass_DTC_0X9A0311
        DemExtendedDataClassRef = ExtendedDataClass_83dcefb7
        DemFreezeFrameClassRef = FreezeFrameClass_fb82c988
        DemEventClass:
          DemAgingAllowed = true
          DemAgingCycleCounterThreshold = 80
          DemEventDestination = DEM_DTC_ORIGIN_PRIMARY_MEMORY
          DemEventPriority = 0
          DemEventFailureCycleCounterThreshold = 0
          DemAgingCycleRef = PowerCycle
          DemEnableConditionGroupRef = EnableConditionGroup_b30aa5c2
          DemOperationCycleRef = PowerCycle
          DemDebounceAlgorithmClass
            DemDebounceCounterBased: DemDebounceCounterDecrementStepSize=1, DemDebounceCounterIncrementStepSize=1, DemDebounceCounterJumpDown=false, DemDebounceCounterJumpUp=false
      DTCClass_DTC_0X9A0312 (DemDTCClass): DemDTCSeverity=DEM_DTC_SEV_MAINTENANCE_ONLY, DemUdsDTC=10093330
      DTC_0X9A0312 (DemEventParameter):
        DemEventKind = DEM_EVENT_KIND_SWC
        DemMaxNumberFreezeFrameRecords = 1
        DemDTCClassRef = DTCClass_DTC_0X9A0312
        DemExtendedDataClassRef = ExtendedDataClass_83dcefb7
        DemFreezeFrameClassRef = FreezeFrameClass_fb82c988
        DemEventClass:
          DemAgingAllowed = true
          DemAgingCycleCounterThreshold = 80
          DemEventDestination = DEM_DTC_ORIGIN_PRIMARY_MEMORY
          DemEventPriority = 0
          DemEventFailureCycleCounterThreshold = 0
          DemAgingCycleRef = PowerCycle
          DemEnableConditionGroupRef = EnableConditionGroup_b30aa5c2
          DemOperationCycleRef = PowerCycle
          DemDebounceAlgorithmClass
            DemDebounceCounterBased: DemDebounceCounterDecrementStepSize=1, DemDebounceCounterIncrementStepSize=1, DemDebounceCounterJumpDown=false, DemDebounceCounterJumpUp=false
      DTCClass_DTC_0X9A0313 (DemDTCClass): DemDTCSeverity=DEM_DTC_SEV_MAINTENANCE_ONLY, DemUdsDTC=10093331
      DTC_0X9A0313 (DemEventParameter):
        DemEventKind = DEM_EVENT_KIND_SWC
        DemMaxNumberFreezeFrameRecords = 1
        DemDTCClassRef = DTCClass_DTC_0X9A0313
        DemExtendedDataClassRef = ExtendedDataClass_83dcefb7
        DemFreezeFrameClassRef = FreezeFrameClass_fb82c988
        DemEventClass:
          DemAgingAllowed = true
          DemAgingCycleCounterThreshold = 80
          DemEventDestination = DEM_DTC_ORIGIN_PRIMARY_MEMORY
          DemEventPriority = 0
          DemEventFailureCycleCounterThreshold = 0
          DemAgingCycleRef = PowerCycle
          DemEnableConditionGroupRef = EnableConditionGroup_b30aa5c2
          DemOperationCycleRef = PowerCycle
          DemDebounceAlgorithmClass
            DemDebounceCounterBased: DemDebounceCounterDecrementStepSize=1, DemDebounceCounterIncrementStepSize=1, DemDebounceCounterJumpDown=false, DemDebounceCounterJumpUp=false
      DTCClass_DTC_0X9A031E (DemDTCClass): DemDTCSeverity=DEM_DTC_SEV_MAINTENANCE_ONLY, DemUdsDTC=10093342
      DTC_0X9A031E (DemEventParameter):
        DemEventKind = DEM_EVENT_KIND_SWC
        DemMaxNumberFreezeFrameRecords = 1
        DemDTCClassRef = DTCClass_DTC_0X9A031E
        DemExtendedDataClassRef = ExtendedDataClass_83dcefb7
        DemFreezeFrameClassRef = FreezeFrameClass_fb82c988
        DemEventClass:
          DemAgingAllowed = true
          DemAgingCycleCounterThreshold = 80
          DemEventDestination = DEM_DTC_ORIGIN_PRIMARY_MEMORY
          DemEventPriority = 0
          DemEventFailureCycleCounterThreshold = 0
          DemAgingCycleRef = PowerCycle
          DemEnableConditionGroupRef = EnableConditionGroup_b30aa5c2
          DemOperationCycleRef = PowerCycle
          DemDebounceAlgorithmClass
            DemDebounceCounterBased: DemDebounceCounterDecrementStepSize=1, DemDebounceCounterIncrementStepSize=1, DemDebounceCounterJumpDown=false, DemDebounceCounterJumpUp=false
      DTCClass_DTC_0X9A0325 (DemDTCClass): DemDTCSeverity=DEM_DTC_SEV_MAINTENANCE_ONLY, DemUdsDTC=10093349
      DTC_0X9A0325 (DemEventParameter):
        DemEventKind = DEM_EVENT_KIND_SWC
        DemMaxNumberFreezeFrameRecords = 1
        DemDTCClassRef = DTCClass_DTC_0X9A0325
        DemExtendedDataClassRef = ExtendedDataClass_83dcefb7
        DemFreezeFrameClassRef = FreezeFrameClass_fb82c988
        DemEventClass:
          DemAgingAllowed = true
          DemAgingCycleCounterThreshold = 80
          DemEventDestination = DEM_DTC_ORIGIN_PRIMARY_MEMORY
          DemEventPriority = 0
          DemEventFailureCycleCounterThreshold = 0
          DemAgingCycleRef = PowerCycle
          DemEnableConditionGroupRef = EnableConditionGroup_b30aa5c2
          DemOperationCycleRef = PowerCycle
          DemDebounceAlgorithmClass
            DemDebounceCounterBased: DemDebounceCounterDecrementStepSize=1, DemDebounceCounterIncrementStepSize=1, DemDebounceCounterJumpDown=false, DemDebounceCounterJumpUp=false
      DTCClass_DTC_0X9A0401 (DemDTCClass): DemDTCSeverity=DEM_DTC_SEV_MAINTENANCE_ONLY, DemUdsDTC=10093569
      DTC_0X9A0401 (DemEventParameter):
        DemEventKind = DEM_EVENT_KIND_SWC
        DemMaxNumberFreezeFrameRecords = 1
        DemDTCClassRef = DTCClass_DTC_0X9A0401
        DemExtendedDataClassRef = ExtendedDataClass_83dcefb7
        DemFreezeFrameClassRef = FreezeFrameClass_fb82c988
        DemEventClass:
          DemAgingAllowed = true
          DemAgingCycleCounterThreshold = 80
          DemEventDestination = DEM_DTC_ORIGIN_PRIMARY_MEMORY
          DemEventPriority = 0
          DemEventFailureCycleCounterThreshold = 0
          DemAgingCycleRef = PowerCycle
          DemEnableConditionGroupRef = EnableConditionGroup_b30aa5c2
          DemOperationCycleRef = PowerCycle
          DemDebounceAlgorithmClass
            DemDebounceCounterBased: DemDebounceCounterDecrementStepSize=1, DemDebounceCounterIncrementStepSize=1, DemDebounceCounterJumpDown=false, DemDebounceCounterJumpUp=false
      DTCClass_DTC_0X9A0411 (DemDTCClass): DemDTCSeverity=DEM_DTC_SEV_MAINTENANCE_ONLY, DemUdsDTC=10093585
      DTC_0X9A0411 (DemEventParameter):
        DemEventKind = DEM_EVENT_KIND_SWC
        DemMaxNumberFreezeFrameRecords = 1
        DemDTCClassRef = DTCClass_DTC_0X9A0411
        DemExtendedDataClassRef = ExtendedDataClass_83dcefb7
        DemFreezeFrameClassRef = FreezeFrameClass_fb82c988
        DemEventClass:
          DemAgingAllowed = true
          DemAgingCycleCounterThreshold = 80
          DemEventDestination = DEM_DTC_ORIGIN_PRIMARY_MEMORY
          DemEventPriority = 0
          DemEventFailureCycleCounterThreshold = 0
          DemAgingCycleRef = PowerCycle
          DemEnableConditionGroupRef = EnableConditionGroup_b30aa5c2
          DemOperationCycleRef = PowerCycle
          DemDebounceAlgorithmClass
            DemDebounceCounterBased: DemDebounceCounterDecrementStepSize=1, DemDebounceCounterIncrementStepSize=1, DemDebounceCounterJumpDown=false, DemDebounceCounterJumpUp=false
      DTCClass_DTC_0X9A0412 (DemDTCClass): DemDTCSeverity=DEM_DTC_SEV_MAINTENANCE_ONLY, DemUdsDTC=10093586
      DTC_0X9A0412 (DemEventParameter):
        DemEventKind = DEM_EVENT_KIND_SWC
        DemMaxNumberFreezeFrameRecords = 1
        DemDTCClassRef = DTCClass_DTC_0X9A0412
        DemExtendedDataClassRef = ExtendedDataClass_83dcefb7
        DemFreezeFrameClassRef = FreezeFrameClass_fb82c988
        DemEventClass:
          DemAgingAllowed = true
          DemAgingCycleCounterThreshold = 80
          DemEventDestination = DEM_DTC_ORIGIN_PRIMARY_MEMORY
          DemEventPriority = 0
          DemEventFailureCycleCounterThreshold = 0
          DemAgingCycleRef = PowerCycle
          DemEnableConditionGroupRef = EnableConditionGroup_b30aa5c2
          DemOperationCycleRef = PowerCycle
          DemDebounceAlgorithmClass
            DemDebounceCounterBased: DemDebounceCounterDecrementStepSize=1, DemDebounceCounterIncrementStepSize=1, DemDebounceCounterJumpDown=false, DemDebounceCounterJumpUp=false
      DTCClass_DTC_0X9A0413 (DemDTCClass): DemDTCSeverity=DEM_DTC_SEV_MAINTENANCE_ONLY, DemUdsDTC=10093587
      DTC_0X9A0413 (DemEventParameter):
        DemEventKind = DEM_EVENT_KIND_SWC
        DemMaxNumberFreezeFrameRecords = 1
        DemDTCClassRef = DTCClass_DTC_0X9A0413
        DemExtendedDataClassRef = ExtendedDataClass_83dcefb7
        DemFreezeFrameClassRef = FreezeFrameClass_fb82c988
        DemEventClass:
          DemAgingAllowed = true
          DemAgingCycleCounterThreshold = 80
          DemEventDestination = DEM_DTC_ORIGIN_PRIMARY_MEMORY
          DemEventPriority = 0
          DemEventFailureCycleCounterThreshold = 0
          DemAgingCycleRef = PowerCycle
          DemEnableConditionGroupRef = EnableConditionGroup_b30aa5c2
          DemOperationCycleRef = PowerCycle
          DemDebounceAlgorithmClass
            DemDebounceCounterBased: DemDebounceCounterDecrementStepSize=1, DemDebounceCounterIncrementStepSize=1, DemDebounceCounterJumpDown=false, DemDebounceCounterJumpUp=false
      DTCClass_DTC_0X9A041E (DemDTCClass): DemDTCSeverity=DEM_DTC_SEV_MAINTENANCE_ONLY, DemUdsDTC=10093598
      DTC_0X9A041E (DemEventParameter):
        DemEventKind = DEM_EVENT_KIND_SWC
        DemMaxNumberFreezeFrameRecords = 1
        DemDTCClassRef = DTCClass_DTC_0X9A041E
        DemExtendedDataClassRef = ExtendedDataClass_83dcefb7
        DemFreezeFrameClassRef = FreezeFrameClass_fb82c988
        DemEventClass:
          DemAgingAllowed = true
          DemAgingCycleCounterThreshold = 80
          DemEventDestination = DEM_DTC_ORIGIN_PRIMARY_MEMORY
          DemEventPriority = 0
          DemEventFailureCycleCounterThreshold = 0
          DemAgingCycleRef = PowerCycle
          DemEnableConditionGroupRef = EnableConditionGroup_b30aa5c2
          DemOperationCycleRef = PowerCycle
          DemDebounceAlgorithmClass
            DemDebounceCounterBased: DemDebounceCounterDecrementStepSize=1, DemDebounceCounterIncrementStepSize=1, DemDebounceCounterJumpDown=false, DemDebounceCounterJumpUp=false
      DTCClass_DTC_0X9A0425 (DemDTCClass): DemDTCSeverity=DEM_DTC_SEV_MAINTENANCE_ONLY, DemUdsDTC=10093605
      DTC_0X9A0425 (DemEventParameter):
        DemEventKind = DEM_EVENT_KIND_SWC
        DemMaxNumberFreezeFrameRecords = 1
        DemDTCClassRef = DTCClass_DTC_0X9A0425
        DemExtendedDataClassRef = ExtendedDataClass_83dcefb7
        DemFreezeFrameClassRef = FreezeFrameClass_fb82c988
        DemEventClass:
          DemAgingAllowed = true
          DemAgingCycleCounterThreshold = 80
          DemEventDestination = DEM_DTC_ORIGIN_PRIMARY_MEMORY
          DemEventPriority = 0
          DemEventFailureCycleCounterThreshold = 0
          DemAgingCycleRef = PowerCycle
          DemEnableConditionGroupRef = EnableConditionGroup_b30aa5c2
          DemOperationCycleRef = PowerCycle
          DemDebounceAlgorithmClass
            DemDebounceCounterBased: DemDebounceCounterDecrementStepSize=1, DemDebounceCounterIncrementStepSize=1, DemDebounceCounterJumpDown=false, DemDebounceCounterJumpUp=false
      DTCClass_DTC_0XA10602 (DemDTCClass): DemDTCSeverity=DEM_DTC_SEV_MAINTENANCE_ONLY, DemUdsDTC=10552834
      DTC_0XA10602 (DemEventParameter):
        DemEventKind = DEM_EVENT_KIND_SWC
        DemMaxNumberFreezeFrameRecords = 1
        DemDTCClassRef = DTCClass_DTC_0XA10602
        DemExtendedDataClassRef = ExtendedDataClass_83dcefb7
        DemFreezeFrameClassRef = FreezeFrameClass_fb82c988
        DemEventClass:
          DemAgingAllowed = true
          DemAgingCycleCounterThreshold = 80
          DemEventDestination = DEM_DTC_ORIGIN_PRIMARY_MEMORY
          DemEventPriority = 0
          DemEventFailureCycleCounterThreshold = 0
          DemAgingCycleRef = PowerCycle
          DemEnableConditionGroupRef = EnableConditionGroup_b30aa5c2
          DemOperationCycleRef = PowerCycle
          DemDebounceAlgorithmClass
            DemDebounceCounterBased: DemDebounceCounterDecrementStepSize=1, DemDebounceCounterIncrementStepSize=1, DemDebounceCounterJumpDown=false, DemDebounceCounterJumpUp=false
      DTCClass_DTC_0XA10604 (DemDTCClass): DemDTCSeverity=DEM_DTC_SEV_MAINTENANCE_ONLY, DemUdsDTC=10552836
      DTC_0XA10604 (DemEventParameter):
        DemEventKind = DEM_EVENT_KIND_SWC
        DemMaxNumberFreezeFrameRecords = 1
        DemDTCClassRef = DTCClass_DTC_0XA10604
        DemExtendedDataClassRef = ExtendedDataClass_83dcefb7
        DemFreezeFrameClassRef = FreezeFrameClass_fb82c988
        DemEventClass:
          DemAgingAllowed = true
          DemAgingCycleCounterThreshold = 80
          DemEventDestination = DEM_DTC_ORIGIN_PRIMARY_MEMORY
          DemEventPriority = 0
          DemEventFailureCycleCounterThreshold = 0
          DemAgingCycleRef = PowerCycle
          DemEnableConditionGroupRef = EnableConditionGroup_b30aa5c2
          DemOperationCycleRef = PowerCycle
          DemDebounceAlgorithmClass
            DemDebounceCounterBased: DemDebounceCounterDecrementStepSize=1, DemDebounceCounterIncrementStepSize=1, DemDebounceCounterJumpDown=false, DemDebounceCounterJumpUp=false
      DTCClass_DTC_0XA11204 (DemDTCClass): DemDTCSeverity=DEM_DTC_SEV_MAINTENANCE_ONLY, DemUdsDTC=10555908
      DTC_0XA11204 (DemEventParameter):
        DemEventKind = DEM_EVENT_KIND_SWC
        DemMaxNumberFreezeFrameRecords = 1
        DemDTCClassRef = DTCClass_DTC_0XA11204
        DemExtendedDataClassRef = ExtendedDataClass_83dcefb7
        DemFreezeFrameClassRef = FreezeFrameClass_fb82c988
        DemEventClass:
          DemAgingAllowed = true
          DemAgingCycleCounterThreshold = 80
          DemEventDestination = DEM_DTC_ORIGIN_PRIMARY_MEMORY
          DemEventPriority = 0
          DemEventFailureCycleCounterThreshold = 0
          DemAgingCycleRef = PowerCycle
          DemEnableConditionGroupRef = EnableConditionGroup_ce4d85f8
          DemOperationCycleRef = PowerCycle
          DemDebounceAlgorithmClass
            DemDebounceCounterBased: DemDebounceCounterDecrementStepSize=1, DemDebounceCounterIncrementStepSize=1, DemDebounceCounterJumpDown=false, DemDebounceCounterJumpUp=false
      DTCClass_DTC_0XC01988 (DemDTCClass): DemDTCSeverity=DEM_DTC_SEV_MAINTENANCE_ONLY, DemUdsDTC=12589448
      DTC_0XC01988 (DemEventParameter):
        DemEventKind = DEM_EVENT_KIND_SWC
        DemMaxNumberFreezeFrameRecords = 1
        DemDTCClassRef = DTCClass_DTC_0XC01988
        DemExtendedDataClassRef = ExtendedDataClass_83dcefb7
        DemFreezeFrameClassRef = FreezeFrameClass_fb82c988
        DemEventClass:
          DemAgingAllowed = true
          DemAgingCycleCounterThreshold = 80
          DemEventDestination = DEM_DTC_ORIGIN_PRIMARY_MEMORY
          DemEventPriority = 0
          DemEventFailureCycleCounterThreshold = 0
          DemAgingCycleRef = PowerCycle
          DemEnableConditionGroupRef = EnableConditionGroup_ce4d85f8
          DemOperationCycleRef = PowerCycle
          DemDebounceAlgorithmClass
            DemDebounceCounterBased: DemDebounceCounterDecrementStepSize=1, DemDebounceCounterIncrementStepSize=1, DemDebounceCounterJumpDown=false, DemDebounceCounterJumpUp=false
      DTCClass_DTC_0XC14687 (DemDTCClass): DemDTCSeverity=DEM_DTC_SEV_IMMEDIATELY, DemUdsDTC=12666503
      DTC_0XC14687 (DemEventParameter):
        DemEventKind = DEM_EVENT_KIND_SWC
        DemMaxNumberFreezeFrameRecords = 1
        DemDTCClassRef = DTCClass_DTC_0XC14687
        DemExtendedDataClassRef = ExtendedDataClass_83dcefb7
        DemFreezeFrameClassRef = FreezeFrameClass_fb82c988
        DemEventClass:
          DemAgingAllowed = true
          DemAgingCycleCounterThreshold = 80
          DemEventDestination = DEM_DTC_ORIGIN_PRIMARY_MEMORY
          DemEventPriority = 0
          DemEventFailureCycleCounterThreshold = 0
          DemAgingCycleRef = PowerCycle
          DemEnableConditionGroupRef = EnableConditionGroup_ce4d85f8
          DemOperationCycleRef = PowerCycle
          DemDebounceAlgorithmClass
            DemDebounceCounterBased: DemDebounceCounterDecrementStepSize=1, DemDebounceCounterIncrementStepSize=1, DemDebounceCounterJumpDown=false, DemDebounceCounterJumpUp=false
      DTCClass_DTC_0XC15502 (DemDTCClass): DemDTCSeverity=DEM_DTC_SEV_CHECK_AT_NEXT_HALT, DemUdsDTC=12670210
      DTC_0XC15502 (DemEventParameter):
        DemEventKind = DEM_EVENT_KIND_SWC
        DemMaxNumberFreezeFrameRecords = 1
        DemDTCClassRef = DTCClass_DTC_0XC15502
        DemExtendedDataClassRef = ExtendedDataClass_83dcefb7
        DemFreezeFrameClassRef = FreezeFrameClass_fb82c988
        DemEventClass:
          DemAgingAllowed = true
          DemAgingCycleCounterThreshold = 80
          DemEventDestination = DEM_DTC_ORIGIN_PRIMARY_MEMORY
          DemEventPriority = 0
          DemEventFailureCycleCounterThreshold = 0
          DemAgingCycleRef = PowerCycle
          DemEnableConditionGroupRef = EnableConditionGroup_f70a9d46
          DemOperationCycleRef = PowerCycle
          DemDebounceAlgorithmClass
            DemDebounceCounterBased: DemDebounceCounterDecrementStepSize=1, DemDebounceCounterIncrementStepSize=1, DemDebounceCounterJumpDown=false, DemDebounceCounterJumpUp=false
      DTCClass_DTC_0XC15582 (DemDTCClass): DemDTCSeverity=DEM_DTC_SEV_IMMEDIATELY, DemUdsDTC=12670338
      DTC_0XC15582 (DemEventParameter):
        DemEventKind = DEM_EVENT_KIND_SWC
        DemMaxNumberFreezeFrameRecords = 1
        DemDTCClassRef = DTCClass_DTC_0XC15582
        DemExtendedDataClassRef = ExtendedDataClass_83dcefb7
        DemFreezeFrameClassRef = FreezeFrameClass_fb82c988
        DemEventClass:
          DemAgingAllowed = true
          DemAgingCycleCounterThreshold = 80
          DemEventDestination = DEM_DTC_ORIGIN_PRIMARY_MEMORY
          DemEventPriority = 0
          DemEventFailureCycleCounterThreshold = 0
          DemAgingCycleRef = PowerCycle
          DemEnableConditionGroupRef = EnableConditionGroup_b30aa5c2
          DemOperationCycleRef = PowerCycle
          DemDebounceAlgorithmClass
            DemDebounceCounterBased: DemDebounceCounterDecrementStepSize=1, DemDebounceCounterIncrementStepSize=1, DemDebounceCounterJumpDown=false, DemDebounceCounterJumpUp=false
      DTCClass_DTC_0XC19887 (DemDTCClass): DemDTCSeverity=DEM_DTC_SEV_IMMEDIATELY, DemUdsDTC=12687495
      DTC_0XC19887 (DemEventParameter):
        DemEventKind = DEM_EVENT_KIND_SWC
        DemMaxNumberFreezeFrameRecords = 1
        DemDTCClassRef = DTCClass_DTC_0XC19887
        DemExtendedDataClassRef = ExtendedDataClass_83dcefb7
        DemFreezeFrameClassRef = FreezeFrameClass_fb82c988
        DemEventClass:
          DemAgingAllowed = true
          DemAgingCycleCounterThreshold = 80
          DemEventDestination = DEM_DTC_ORIGIN_PRIMARY_MEMORY
          DemEventPriority = 0
          DemEventFailureCycleCounterThreshold = 0
          DemAgingCycleRef = PowerCycle
          DemEnableConditionGroupRef = EnableConditionGroup_ce4d85f8
          DemOperationCycleRef = PowerCycle
          DemDebounceAlgorithmClass
            DemDebounceCounterBased: DemDebounceCounterDecrementStepSize=1, DemDebounceCounterIncrementStepSize=1, DemDebounceCounterJumpDown=false, DemDebounceCounterJumpUp=false
      DTCClass_DTC_0XC19988 (DemDTCClass): DemDTCSeverity=DEM_DTC_SEV_MAINTENANCE_ONLY, DemUdsDTC=12687752
      DTC_0XC19988 (DemEventParameter):
        DemEventKind = DEM_EVENT_KIND_SWC
        DemMaxNumberFreezeFrameRecords = 1
        DemDTCClassRef = DTCClass_DTC_0XC19988
        DemExtendedDataClassRef = ExtendedDataClass_83dcefb7
        DemFreezeFrameClassRef = FreezeFrameClass_fb82c988
        DemEventClass:
          DemAgingAllowed = true
          DemAgingCycleCounterThreshold = 80
          DemEventDestination = DEM_DTC_ORIGIN_PRIMARY_MEMORY
          DemEventPriority = 0
          DemEventFailureCycleCounterThreshold = 0
          DemAgingCycleRef = PowerCycle
          DemEnableConditionGroupRef = EnableConditionGroup_ce4d85f8
          DemOperationCycleRef = PowerCycle
          DemDebounceAlgorithmClass
            DemDebounceCounterBased: DemDebounceCounterDecrementStepSize=1, DemDebounceCounterIncrementStepSize=1, DemDebounceCounterJumpDown=false, DemDebounceCounterJumpUp=false
      DTCClass_DTC_0XC26402 (DemDTCClass): DemDTCSeverity=DEM_DTC_SEV_CHECK_AT_NEXT_HALT, DemUdsDTC=12739586
      DTC_0XC26402 (DemEventParameter):
        DemEventKind = DEM_EVENT_KIND_SWC
        DemMaxNumberFreezeFrameRecords = 1
        DemDTCClassRef = DTCClass_DTC_0XC26402
        DemExtendedDataClassRef = ExtendedDataClass_83dcefb7
        DemFreezeFrameClassRef = FreezeFrameClass_fb82c988
        DemEventClass:
          DemAgingAllowed = true
          DemAgingCycleCounterThreshold = 80
          DemEventDestination = DEM_DTC_ORIGIN_PRIMARY_MEMORY
          DemEventPriority = 0
          DemEventFailureCycleCounterThreshold = 0
          DemAgingCycleRef = PowerCycle
          DemEnableConditionGroupRef = EnableConditionGroup_2d4cad61
          DemOperationCycleRef = PowerCycle
          DemDebounceAlgorithmClass
            DemDebounceCounterBased: DemDebounceCounterDecrementStepSize=1, DemDebounceCounterIncrementStepSize=1, DemDebounceCounterJumpDown=false, DemDebounceCounterJumpUp=false
      DTCClass_DTC_0XD10017 (DemDTCClass): DemDTCSeverity=DEM_DTC_SEV_IMMEDIATELY, DemUdsDTC=13697047
      DTC_0XD10017 (DemEventParameter):
        DemEventKind = DEM_EVENT_KIND_SWC
        DemMaxNumberFreezeFrameRecords = 1
        DemDTCClassRef = DTCClass_DTC_0XD10017
        DemExtendedDataClassRef = ExtendedDataClass_83dcefb7
        DemFreezeFrameClassRef = FreezeFrameClass_fb82c988
        DemEventClass:
          DemAgingAllowed = true
          DemAgingCycleCounterThreshold = 80
          DemEventDestination = DEM_DTC_ORIGIN_PRIMARY_MEMORY
          DemEventPriority = 0
          DemEventFailureCycleCounterThreshold = 0
          DemAgingCycleRef = PowerCycle
          DemEnableConditionGroupRef = EnableConditionGroup_b30aa5c2
          DemOperationCycleRef = PowerCycle
          DemDebounceAlgorithmClass
            DemDebounceCounterBased: DemDebounceCounterDecrementStepSize=1, DemDebounceCounterIncrementStepSize=1, DemDebounceCounterJumpDown=false, DemDebounceCounterJumpUp=false
      DTCClass_DTC_0XD10116 (DemDTCClass): DemDTCSeverity=DEM_DTC_SEV_IMMEDIATELY, DemUdsDTC=13697302
      DTC_0XD10116 (DemEventParameter):
        DemEventKind = DEM_EVENT_KIND_SWC
        DemMaxNumberFreezeFrameRecords = 1
        DemDTCClassRef = DTCClass_DTC_0XD10116
        DemExtendedDataClassRef = ExtendedDataClass_83dcefb7
        DemFreezeFrameClassRef = FreezeFrameClass_fb82c988
        DemEventClass:
          DemAgingAllowed = true
          DemAgingCycleCounterThreshold = 80
          DemEventDestination = DEM_DTC_ORIGIN_PRIMARY_MEMORY
          DemEventPriority = 0
          DemEventFailureCycleCounterThreshold = 0
          DemAgingCycleRef = PowerCycle
          DemEnableConditionGroupRef = EnableConditionGroup_b30aa5c2
          DemOperationCycleRef = PowerCycle
          DemDebounceAlgorithmClass
            DemDebounceCounterBased: DemDebounceCounterDecrementStepSize=1, DemDebounceCounterIncrementStepSize=1, DemDebounceCounterJumpDown=false, DemDebounceCounterJumpUp=false
    DemGeneral:
      DemAgingCycleCounterProcessing = DEM_PROCESS_AGINGCTR_INTERN
      DemDebounceCounterBasedSupport = true
      DemDtcStatusAvailabilityMask = 255
      DemEnableConditionSupport = true
      DemMaxNumberEventEntryMirror = 0
      DemPTOSupport = false
      DemTypeOfFreezeFrameRecordNumeration = DEM_FF_RECNUM_CALCULATED
      DID_0xf414 (DemDidClass): DemDidIdentifier=62484, DemDidDataClassRef=PID_0x14_DID_Data
      24 x DemEnableCondition:
        HUT
        Start
        up
        sequence
        is
        completed
        in
        STATE_NORMAL
        No
        display
        power
        supply
        fault
        Vechile
        variant
        V51
        or
        H9
        China
        diagnostic
        voltage
        IP
        online
        camer
      ExtendedDataClass_83dcefb7 (DemExtendedDataClass): DemExtendedDataRecordClassRef=OccurrenceCounter
      6 x DemEnableConditionGroup, all with DemEnableConditionRef=STATE_NORMAL, DemEnableConditionRef=Start, DemEnableConditionRef=completed, DemEnableConditionRef=in, DemEnableConditionRef=sequence, DemEnableConditionRef=up:
        EnableConditionGroup_2d4cad61: DemEnableConditionRef=HUT, DemEnableConditionRef=HUT, DemEnableConditionRef=No, DemEnableConditionRef=camer, DemEnableConditionRef=fault, DemEnableConditionRef=is, DemEnableConditionRef=is, DemEnableConditionRef=power, DemEnableConditionRef=supply
        EnableConditionGroup_3e8e3f33: DemEnableConditionRef=HUT, DemEnableConditionRef=HUT, DemEnableConditionRef=No, DemEnableConditionRef=display, DemEnableConditionRef=fault, DemEnableConditionRef=is, DemEnableConditionRef=is, DemEnableConditionRef=power, DemEnableConditionRef=supply
        EnableConditionGroup_5fbd712e: DemEnableConditionRef=China, DemEnableConditionRef=H9, DemEnableConditionRef=HUT, DemEnableConditionRef=HUT, DemEnableConditionRef=V51, DemEnableConditionRef=Vechile, DemEnableConditionRef=is, DemEnableConditionRef=is, DemEnableConditionRef=or, DemEnableConditionRef=variant
        EnableConditionGroup_b30aa5c2: DemEnableConditionRef=HUT, DemEnableConditionRef=HUT, DemEnableConditionRef=is, DemEnableConditionRef=is
        EnableConditionGroup_ce4d85f8: DemEnableConditionRef=HUT, DemEnableConditionRef=HUT, DemEnableConditionRef=No, DemEnableConditionRef=diagnostic, DemEnableConditionRef=fault, DemEnableConditionRef=is, DemEnableConditionRef=is, DemEnableConditionRef=voltage
        EnableConditionGroup_f70a9d46: DemEnableConditionRef=HUT, DemEnableConditionRef=HUT, DemEnableConditionRef=IP, DemEnableConditionRef=is, DemEnableConditionRef=is, DemEnableConditionRef=is, DemEnableConditionRef=online
      OccurrenceCounter (DemExtendedDataRecordClass): DemExtendedDataRecordNumber=1, DemDataClassRef=OccurrenceCounter_Occurrence_Counter
      FreezeFrameClass_fb82c988 (DemFreezeFrameClass): DemDidClassRef=DID_0xf414
      PowerCycle (DemOperationCycle): DemOperationCycleType=DEM_OPCYC_POWER
      IgnitionCycle (DemOperationCycle): DemOperationCycleType=DEM_OPCYC_IGNITION
      PID_0x14_DID_Data (DemDataClass):
        DemDataElementDataSize = 2
        DemDataElementDataType = UINT16
        DemDataElementEndianness = BIG_ENDIAN
        DemDataElementUsePort = USE_DATA_CLIENT_SERVER_PORT
        DemDataElementStoreNonVolatile = true
      OccurrenceCounter_Occurrence_Counter (DemDataClass): DemDataElementDataSize=1, DemDataElementInternalData=DEM_OCCCTR, DemDataElementUsePort=USE_DATA_INTERNAL
