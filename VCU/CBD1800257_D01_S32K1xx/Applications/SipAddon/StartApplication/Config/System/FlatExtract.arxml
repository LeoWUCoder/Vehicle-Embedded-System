AUTOSAR XML (schema 4-3-0)
package /COM/VECTOR/CFG/WORKFLOW/SYSDESC/SYNC
  system SYSTEM: category=ECU_EXTRACT
    system mapping MAPPINGS
      data-mappings:
        data-element=StartApplication.COMPOSITIONTYPE.PpSignal_StartAppl_RxCtrl_MyECU_omsg_StartAppl_Rx_MyECU_oCAN_09591065_Rx.DeSignal_StartAppl_RxCtrl_MyECU_omsg_StartAppl_Rx_MyECU_oCAN_09591065_Rx, system-signal=Signal_StartAppl_RxCtrl_MyECU
        data-element=StartApplication.COMPOSITIONTYPE.PpSignal_StartAppl_TxData_MyECU_omsg_StartAppl_Tx_MyECU_oCAN_8c58228b_Tx.DeSignal_StartAppl_TxData_MyECU_omsg_StartAppl_Tx_MyECU_oCAN_8c58228b_Tx, system-signal=Signal_StartAppl_TxData_MyECU
        data-element=StartApplication.COMPOSITIONTYPE.PpSignal_StartAppl_RxData_MyECU_omsg_StartAppl_Rx_MyECU_oCAN_315f9453_Rx.DeSignal_StartAppl_RxData_MyECU_omsg_StartAppl_Rx_MyECU_oCAN_315f9453_Rx, system-signal=Signal_StartAppl_RxData_MyECU
        data-element=StartApplication.COMPOSITIONTYPE.PpSignal_StartAppl_TxCtrl_MyECU_omsg_StartAppl_Tx_MyECU_oCAN_b45ea6bd_Tx.DeSignal_StartAppl_TxCtrl_MyECU_omsg_StartAppl_Tx_MyECU_oCAN_b45ea6bd_Tx, system-signal=Signal_StartAppl_TxCtrl_MyECU
    root-software-compositions:
      root sw composition prototype COMPOSITIONTYPE: flat-map=FLATMAP, software-composition=COMPOSITIONTYPE
  composition sw component type COMPOSITIONTYPE  # UB:Derived from original system description
    14 x component:
      BswM: type=BswM
      ComM: type=ComM
      DemMaster_0: type=DemMaster_0
      DemSatellite_0: type=DemSatellite_0
      Det: type=Det
      EcuM: type=EcuM
      Os_OsCore0_swc: type=Os_OsCore0_swc
      NvM: type=NvM
      Dcm: type=Dcm
      StartApplication: type=StartApplication
      WdgM_OsApplication_Trusted_Core0: type=WdgM_OsApplication_Trusted_Core0
      WdgM_OsApplication_NonTrusted_Core0: type=WdgM_OsApplication_NonTrusted_Core0
      StartApplicationTrusted: type=StartApplicationTrusted
      StartApplicationMemoryAccessState: type=StartApplicationMemoryAccessState
    connect BswM.Switch_ESH_ModeSwitch -> BswM.Notification_ESH_ModeNotification
    connect StartApplication.PpNvM_RpNotifyJobEnd_StartApplication_NvMBlock1 -> NvM.NvM_RpNotifyJobEnd_StartApplication_NvMBlock1
    connect NvM.PS_StartApplication_NvMBlock1 -> StartApplication.PpPS_StartApplication_NvMBlock1
    connect StartApplication.PpNvM_RpNotifyJobEnd_StartApplication_NvMBlock2 -> NvM.NvM_RpNotifyJobEnd_StartApplication_NvMBlock2
    connect NvM.PS_StartApplication_NvMBlock2 -> StartApplication.PpPS_StartApplication_NvMBlock2
    connect ComM.UR_CN_CAN_52ce3533 -> StartApplication.UR_CN_CAN_52ce3533
    connect DemSatellite_0.Event_DEM_EVENT_StartApplication -> StartApplication.PpDiagnosticMonitor_DEM_EVENT_StartApplication
    connect DemMaster_0.OpCycle_PowerCycle -> StartApplication.PpDemOpCycle_PowerCycle
    connect StartApplication.PpDcmDataService_DID_StartApplication -> Dcm.DataServices_Data_DID_StartApplication
    connect StartApplication.PpDemDataService_DemDataElementClass_StartApplication -> DemMaster_0.CBReadData_DemDataElementClass_StartApplication
    connect BswM.Provide_BswMRteModeRequestPort -> BswM.Request_ESH_RunRequest_0
    connect StartApplicationMemoryAccessState.PpMemoryAccessViolationState -> StartApplication.PpMemoryAccessViolationState
    connect StartApplication.PpTrustedData -> StartApplicationTrusted.PpTrustedData
    connect StartApplicationTrusted.PpTrustedDataInvalid -> StartApplication.PpTrustedDataInvalid
    connect StartApplicationTrusted.PpTrustedDataVerification -> StartApplication.PpTrustedDataVerification
  end to end protection set E2EPROTECTIONSET
  port interface mapping set PORTINTERFACEMAPPINGSET
