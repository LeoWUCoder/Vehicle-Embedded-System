AUTOSAR XML (schema 4-0-3)
package /DaVinci_Project
  module config Com
    ComConfig
      4 x ComSignal, all with ComSignalType=UINT8:
        Signal_StartAppl_RxCtrl_MyECU_omsg_StartAppl_Rx_MyECU_oCAN_09591065_Rx: ComNotification=Rte_COMCbk_Signal_StartAppl_RxCtrl_MyECU_omsg_StartAppl_Rx_MyECU_oCAN_09591065_Rx
        Signal_StartAppl_RxData_MyECU_omsg_StartAppl_Rx_MyECU_oCAN_315f9453_Rx: ComNotification=Rte_COMCbk_Signal_StartAppl_RxData_MyECU_omsg_StartAppl_Rx_MyECU_oCAN_315f9453_Rx
        Signal_StartAppl_TxCtrl_MyECU_omsg_StartAppl_Tx_MyECU_oCAN_b45ea6bd_Tx
        Signal_StartAppl_TxData_MyECU_omsg_StartAppl_Tx_MyECU_oCAN_8c58228b_Tx
  module config Rte
    31 x RteBswModuleInstance:
      Adc
      BswM
        BswM_MainFunctionTimingEvent0 (RteBswEventToTaskMapping): RteBswUsedOsEventRef=Rte_Ev_Cyclic2_Default_BSW_Async_Task_0_10ms, RteBswUsedOsAlarmRef=Os/Rte_Al_TE2_Default_BSW_Async_Task_0_10ms
      Can
        4 x RteBswEventToTaskMapping, all with RteBswUsedOsEventRef=Rte_Ev_Cyclic2_Default_BSW_Async_Task_0_10ms, RteBswUsedOsAlarmRef=Os/Rte_Al_TE2_Default_BSW_Async_Task_0_10ms:
          Can_MainFunction_BusOffTimingEvent0
          Can_MainFunction_ModeTimingEvent0
          Can_MainFunction_WakeupTimingEvent0
          Can_MainFunction_WriteTimingEvent0
      CanIf
      CanSM
        CanSM_MainFunctionTimingEvent0 (RteBswEventToTaskMapping): RteBswUsedOsEventRef=Rte_Ev_Cyclic2_Default_BSW_Async_Task_0_10ms, RteBswUsedOsAlarmRef=Os/Rte_Al_TE2_Default_BSW_Async_Task_0_10ms
      CanTp
        CanTp_MainFunctionTimingEvent0 (RteBswEventToTaskMapping): RteBswUsedOsEventRef=Rte_Ev_Cyclic2_Default_BSW_Async_Task_0_5ms, RteBswUsedOsAlarmRef=Os/Rte_Al_TE2_Default_BSW_Async_Task_0_5ms
      Com
        Com_MainFunctionRxTimingEvent0 (RteBswEventToTaskMapping): RteBswUsedOsEventRef=Rte_Ev_Cyclic2_Default_BSW_Async_Task_0_10ms, RteBswUsedOsAlarmRef=Os/Rte_Al_TE2_Default_BSW_Async_Task_0_10ms
        Com_MainFunctionTxTimingEvent0 (RteBswEventToTaskMapping): RteBswUsedOsEventRef=Rte_Ev_Cyclic2_Default_BSW_Async_Task_0_1ms, RteBswUsedOsAlarmRef=Os/Rte_Al_TE2_Default_BSW_Async_Task_0_1ms
      ComM
        ComM_MainFunction_0TimingEvent0 (RteBswEventToTaskMapping): RteBswUsedOsEventRef=Rte_Ev_Cyclic2_Default_BSW_Async_Task_0_20ms, RteBswUsedOsAlarmRef=Os/Rte_Al_TE2_Default_BSW_Async_Task_0_20ms
      Csec
      Dcm
        Dcm_MainFunctionTimingEvent0 (RteBswEventToTaskMapping): RteBswUsedOsEventRef=Rte_Ev_Cyclic2_Default_BSW_Async_Task_0_10ms, RteBswUsedOsAlarmRef=Os/Rte_Al_TE2_Default_BSW_Async_Task_0_10ms
      Dem
        Dem_MasterMainFunctionTimingEvent0 (RteBswEventToTaskMapping): RteBswUsedOsEventRef=Rte_Ev_Cyclic2_Default_BSW_Async_Task_0_10ms, RteBswUsedOsAlarmRef=Os/Rte_Al_TE2_Default_BSW_Async_Task_0_10ms
        Dem_SatelliteMainFunctionTimingEvent0 (RteBswEventToTaskMapping): RteBswUsedOsEventRef=Rte_Ev_Cyclic2_Default_BSW_Async_Task_0_10ms, RteBswUsedOsAlarmRef=Os/Rte_Al_TE2_Default_BSW_Async_Task_0_10ms
      Det
      Dio
      Ea
        Ea_MainFunctionTimingEvent0 (RteBswEventToTaskMapping): RteBswUsedOsEventRef=Rte_Ev_Cyclic2_Default_BSW_Async_Task_0_5ms, RteBswUsedOsAlarmRef=Os/Rte_Al_TE2_Default_BSW_Async_Task_0_5ms
      EcuM
        EcuM_MainFunctionTimingEvent0 (RteBswEventToTaskMapping): RteBswUsedOsEventRef=Rte_Ev_Cyclic2_Default_BSW_Async_Task_0_10ms, RteBswUsedOsAlarmRef=Os/Rte_Al_TE2_Default_BSW_Async_Task_0_10ms
      Eep
        Eep_MainFunctionTimingEvent0 (RteBswEventToTaskMapping): RteBswUsedOsEventRef=Rte_Ev_Cyclic2_Default_BSW_Async_Task_0_5ms, RteBswUsedOsAlarmRef=Os/Rte_Al_TE2_Default_BSW_Async_Task_0_5ms
      Fls
        Fls_MainFunctionTimingEvent0 (RteBswEventToTaskMapping)
      Gpt
      Icu
      Mcl
      Mcu
      Nm
      NmOsek
        NmOsek_MainFunctionTimingEvent0 (RteBswEventToTaskMapping): RteBswUsedOsEventRef=Rte_Ev_Cyclic2_Default_BSW_Async_Task_0_10ms, RteBswUsedOsAlarmRef=Os/Rte_Al_TE2_Default_BSW_Async_Task_0_10ms
      NvM
        NvM_MainFunctionTimingEvent0 (RteBswEventToTaskMapping): RteBswUsedOsEventRef=Rte_Ev_Cyclic2_Default_BSW_Async_Task_0_10ms, RteBswUsedOsAlarmRef=Os/Rte_Al_TE2_Default_BSW_Async_Task_0_10ms
      PduR
      Port
      Pwm
      RamTst
        RamTst_MainFunctionTimingEvent0 (RteBswEventToTaskMapping): RteBswUsedOsEventRef=Rte_Ev_Cyclic2_Default_BSW_Async_Task_0_10ms, RteBswUsedOsAlarmRef=Os/Rte_Al_TE2_Default_BSW_Async_Task_0_10ms
      Spi
        Spi_MainFunction_HandlingTimingEvent0 (RteBswEventToTaskMapping): RteBswUsedOsEventRef=Rte_Ev_Cyclic2_Default_BSW_Async_Task_0_5ms, RteBswUsedOsAlarmRef=Os/Rte_Al_TE2_Default_BSW_Async_Task_0_5ms
      Wdg
      WdgM
        WdgM_MainFunctionTimingEvent0 (RteBswEventToTaskMapping): RteBswUsedOsAlarmRef=Os/Rte_Al_TE2_OsTask_WdgM_Cyclic_0_10ms
    14 x RteSwComponentInstance:
      BswM_EcuSwComposition
        Timer_BswM_MainFunction (RteEventToTaskMapping): RteUsedOsEventRef=Rte_Ev_Cyclic2_Default_BSW_Async_Task_0_10ms, RteUsedOsAlarmRef=Os/Rte_Al_TE2_Default_BSW_Async_Task_0_10ms
      ComM_EcuSwComposition
        Timer_ComM_MainFunction_0 (RteEventToTaskMapping): RteUsedOsEventRef=Rte_Ev_Cyclic2_Default_BSW_Async_Task_0_20ms, RteUsedOsAlarmRef=Os/Rte_Al_TE2_Default_BSW_Async_Task_0_20ms
      Dcm_EcuSwComposition
        Timer_Dcm_MainFunction (RteEventToTaskMapping): RteUsedOsEventRef=Rte_Ev_Cyclic2_Default_BSW_Async_Task_0_10ms, RteUsedOsAlarmRef=Os/Rte_Al_TE2_Default_BSW_Async_Task_0_10ms
      DemMaster_0_EcuSwComposition
        Timer_Dem_MasterMainFunction (RteEventToTaskMapping): RteUsedOsEventRef=Rte_Ev_Cyclic2_Default_BSW_Async_Task_0_10ms, RteUsedOsAlarmRef=Os/Rte_Al_TE2_Default_BSW_Async_Task_0_10ms
      DemSatellite_0_EcuSwComposition
        Timer_Dem_SatelliteMainFunction (RteEventToTaskMapping): RteUsedOsEventRef=Rte_Ev_Cyclic2_Default_BSW_Async_Task_0_10ms, RteUsedOsAlarmRef=Os/Rte_Al_TE2_Default_BSW_Async_Task_0_10ms
      Det_EcuSwComposition
      EcuM_EcuSwComposition
        Timer_EcuM_MainFunction (RteEventToTaskMapping): RteUsedOsEventRef=Rte_Ev_Cyclic2_Default_BSW_Async_Task_0_10ms, RteUsedOsAlarmRef=Os/Rte_Al_TE2_Default_BSW_Async_Task_0_10ms
      NvM_EcuSwComposition
        Timer_NvM_MainFunction (RteEventToTaskMapping): RteUsedOsEventRef=Rte_Ev_Cyclic2_Default_BSW_Async_Task_0_10ms, RteUsedOsAlarmRef=Os/Rte_Al_TE2_Default_BSW_Async_Task_0_10ms
      Os_OsCore0_swc_EcuSwComposition
      StartApplication_EcuSwComposition
        7 x RteEventToTaskMapping:
          Timer_StartApplication_Cyclic1000ms: RteUsedOsEventRef=Rte_Ev_Run_StartApplication_StartApplication_Cyclic1000ms, RteUsedOsAlarmRef=Os/Rte_Al_TE_StartApplication_StartApplication_Cyclic1000ms
          Timer_StartApplication_Cyclic10ms: RteUsedOsEventRef=Rte_Ev_Run_StartApplication_StartApplication_Cyclic10ms, RteUsedOsAlarmRef=Os/Rte_Al_TE_StartApplication_StartApplication_Cyclic10ms
          Timer_StartApplication_Cyclic1ms: RteUsedOsEventRef=Rte_Ev_Run_StartApplication_StartApplication_Cyclic1ms, RteUsedOsAlarmRef=Os/Rte_Al_TE_StartApplication_StartApplication_Cyclic1ms
          Timer_StartApplication_Cyclic250ms: RteUsedOsEventRef=Rte_Ev_Run_StartApplication_StartApplication_Cyclic250ms, RteUsedOsAlarmRef=Os/Rte_Al_TE_StartApplication_StartApplication_Cyclic250ms
          Timer_StartApplication_MEMORYPROTECTION_Cyclic10ms: RteUsedOsAlarmRef=Os/Rte_Al_TE_StartApplication_StartApplication_MEMORYPROTECTION_Cyclic10ms
          DataReceivedEvent_StartApplication_OnDataRec_RxCtrl_PpSignal_StartAppl_RxCtrl_MyECU_omsg_StartAppl_Rx_MyECU_oCAN_095910_3d48f4ff: RteUsedOsEventRef=Rte_Ev_Run_StartApplication_StartApplication_OnDataRec_RxCtrl
          DataReceivedEvent_StartApplication_OnDataRec_RxData_PpSignal_StartAppl_RxData_MyECU_omsg_StartAppl_Rx_MyECU_oCAN_315f94_d6cb9e1e: RteUsedOsEventRef=Rte_Ev_Run_StartApplication_StartApplication_OnDataRec_RxData
      StartApplicationMemoryAccessState_EcuSwComposition
      StartApplicationTrusted_EcuSwComposition
        DataReceivedEvent_StartApplicationTrusted_OnDataRec_TrustedData_PpTrustedData_DeValue (RteEventToTaskMapping)
      WdgM_OsApplication_NonTrusted_Core0_EcuSwComposition
      WdgM_OsApplication_Trusted_Core0_EcuSwComposition
        Timer_WdgM_MainFunction (RteEventToTaskMapping): RteUsedOsAlarmRef=Os/Rte_Al_TE2_OsTask_WdgM_Cyclic_0_10ms
    RteOsInteraction
      10 x RteUsedOsActivation, all with RteExpectedActivationOffset=0:
        Rte_Al_TE_StartApplication_StartApplication_Cyclic1000ms: RteActivationOsAlarmRef=Os/Rte_Al_TE_StartApplication_StartApplication_Cyclic1000ms, RteActivationOsTaskRef=Default_Appl_Task
        Rte_Al_TE_StartApplication_StartApplication_Cyclic10ms: RteActivationOsAlarmRef=Os/Rte_Al_TE_StartApplication_StartApplication_Cyclic10ms, RteActivationOsTaskRef=Default_Appl_Task
        Rte_Al_TE_StartApplication_StartApplication_Cyclic1ms: RteActivationOsAlarmRef=Os/Rte_Al_TE_StartApplication_StartApplication_Cyclic1ms, RteActivationOsTaskRef=Default_Appl_Task
        Rte_Al_TE_StartApplication_StartApplication_Cyclic250ms: RteActivationOsAlarmRef=Os/Rte_Al_TE_StartApplication_StartApplication_Cyclic250ms, RteActivationOsTaskRef=Default_Appl_Task
        Rte_Al_TE2_Default_BSW_Async_Task_0_10ms: RteActivationOsAlarmRef=Os/Rte_Al_TE2_Default_BSW_Async_Task_0_10ms, RteActivationOsTaskRef=Default_BSW_Async_Task
        Rte_Al_TE2_Default_BSW_Async_Task_0_1ms: RteActivationOsAlarmRef=Os/Rte_Al_TE2_Default_BSW_Async_Task_0_1ms, RteActivationOsTaskRef=Default_BSW_Async_Task
        Rte_Al_TE2_Default_BSW_Async_Task_0_20ms: RteActivationOsAlarmRef=Os/Rte_Al_TE2_Default_BSW_Async_Task_0_20ms, RteActivationOsTaskRef=Default_BSW_Async_Task
        Rte_Al_TE2_Default_BSW_Async_Task_0_5ms: RteActivationOsAlarmRef=Os/Rte_Al_TE2_Default_BSW_Async_Task_0_5ms, RteActivationOsTaskRef=Default_BSW_Async_Task
        Rte_Al_TE2_OsTask_WdgM_Cyclic_0_10ms: RteActivationOsAlarmRef=Os/Rte_Al_TE2_OsTask_WdgM_Cyclic_0_10ms, RteActivationOsTaskRef=OsTask_WdgM_Cyclic
        Rte_Al_TE_StartApplication_StartApplication_MEMORYPROTECTION_Cyclic10ms: RteActivationOsAlarmRef=Os/Rte_Al_TE_StartApplication_StartApplication_MEMORYPROTECTION_Cyclic10ms, RteActivationOsTaskRef=StartApplication_MemoryViolation_Task
  module config NvM
  module config Os
    Default_Appl_Init_Task (OsTask): OsTaskActivation=1, OsTaskPriority=45, OsTaskSchedule=NON, OsTaskAccessingApplication=OsApplication_Trusted_Core0
    Default_Appl_Task (OsTask):
      OsTaskActivation = 1
      OsTaskPriority = 5
      OsTaskSchedule = NON
      OsTaskEventRef = Rte_Ev_Run_StartApplication_StartApplication_Cyclic1000ms
      OsTaskEventRef = Rte_Ev_Run_StartApplication_StartApplication_Cyclic10ms
      OsTaskEventRef = Rte_Ev_Run_StartApplication_StartApplication_Cyclic1ms
      OsTaskEventRef = Rte_Ev_Run_StartApplication_StartApplication_Cyclic250ms
      OsTaskEventRef = Rte_Ev_Run_StartApplication_StartApplication_OnDataRec_RxCtrl
      OsTaskEventRef = Rte_Ev_Run_StartApplication_StartApplication_OnDataRec_RxData
      OsTaskAccessingApplication = OsApplication_Trusted_Core0
    4 x OsAlarm, all with OsAlarmCounterRef=SystemTimer, OsAlarmAccessingApplication=OsApplication_Trusted_Core0:
      Rte_Al_TE_StartApplication_StartApplication_Cyclic1000ms
        OsAlarmAction
          OsAlarmSetEvent: OsAlarmSetEventRef=Rte_Ev_Run_StartApplication_StartApplication_Cyclic1000ms, OsAlarmSetEventTaskRef=Default_Appl_Task
      Rte_Al_TE_StartApplication_StartApplication_Cyclic10ms
        OsAlarmAction
          OsAlarmSetEvent: OsAlarmSetEventRef=Rte_Ev_Run_StartApplication_StartApplication_Cyclic10ms, OsAlarmSetEventTaskRef=Default_Appl_Task
      Rte_Al_TE_StartApplication_StartApplication_Cyclic1ms
        OsAlarmAction
          OsAlarmSetEvent: OsAlarmSetEventRef=Rte_Ev_Run_StartApplication_StartApplication_Cyclic1ms, OsAlarmSetEventTaskRef=Default_Appl_Task
      Rte_Al_TE_StartApplication_StartApplication_Cyclic250ms
        OsAlarmAction
          OsAlarmSetEvent: OsAlarmSetEventRef=Rte_Ev_Run_StartApplication_StartApplication_Cyclic250ms, OsAlarmSetEventTaskRef=Default_Appl_Task
    Default_BSW_Async_Task (OsTask):
      OsTaskActivation = 1
      OsTaskPriority = 30
      OsTaskSchedule = NON
      OsTaskEventRef = Rte_Ev_Cyclic2_Default_BSW_Async_Task_0_10ms
      OsTaskEventRef = Rte_Ev_Cyclic2_Default_BSW_Async_Task_0_1ms
      OsTaskEventRef = Rte_Ev_Cyclic2_Default_BSW_Async_Task_0_20ms
      OsTaskEventRef = Rte_Ev_Cyclic2_Default_BSW_Async_Task_0_5ms
      OsTaskAccessingApplication = OsApplication_Trusted_Core0
    4 x OsAlarm, all with OsAlarmCounterRef=SystemTimer, OsAlarmAccessingApplication=OsApplication_Trusted_Core0:
      Rte_Al_TE2_Default_BSW_Async_Task_0_10ms
        OsAlarmAction
          OsAlarmSetEvent: OsAlarmSetEventRef=Rte_Ev_Cyclic2_Default_BSW_Async_Task_0_10ms, OsAlarmSetEventTaskRef=Default_BSW_Async_Task
      Rte_Al_TE2_Default_BSW_Async_Task_0_1ms
        OsAlarmAction
          OsAlarmSetEvent: OsAlarmSetEventRef=Rte_Ev_Cyclic2_Default_BSW_Async_Task_0_1ms, OsAlarmSetEventTaskRef=Default_BSW_Async_Task
      Rte_Al_TE2_Default_BSW_Async_Task_0_20ms
        OsAlarmAction
          OsAlarmSetEvent: OsAlarmSetEventRef=Rte_Ev_Cyclic2_Default_BSW_Async_Task_0_20ms, OsAlarmSetEventTaskRef=Default_BSW_Async_Task
      Rte_Al_TE2_Default_BSW_Async_Task_0_5ms
        OsAlarmAction
          OsAlarmSetEvent: OsAlarmSetEventRef=Rte_Ev_Cyclic2_Default_BSW_Async_Task_0_5ms, OsAlarmSetEventTaskRef=Default_BSW_Async_Task
    OsTask_WdgM_Cyclic (OsTask): OsTaskActivation=1, OsTaskPriority=30, OsTaskSchedule=NON, OsTaskAccessingApplication=OsApplication_NonTrusted_Core0
    Rte_Al_TE2_OsTask_WdgM_Cyclic_0_10ms (OsAlarm): OsAlarmCounterRef=SystemTimer, OsAlarmAccessingApplication=OsApplication_NonTrusted_Core0
      OsAlarmAction
        OsAlarmActivateTask: OsAlarmActivateTaskRef=OsTask_WdgM_Cyclic
    StartApplication_MemoryViolation_Task (OsTask): OsTaskActivation=1, OsTaskPriority=5, OsTaskSchedule=NON, OsTaskAccessingApplication=OsApplication_Trusted_Core0
    Rte_Al_TE_StartApplication_StartApplication_MEMORYPROTECTION_Cyclic10ms (OsAlarm): OsAlarmCounterRef=SystemTimer, OsAlarmAccessingApplication=OsApplication_Trusted_Core0
      OsAlarmAction
        OsAlarmActivateTask: OsAlarmActivateTaskRef=StartApplication_MemoryViolation_Task
    StartApplication_Trusted_Task (OsTask): OsTaskActivation=1, OsTaskPriority=5, OsTaskSchedule=NON, OsTaskAccessingApplication=OsApplication_NonTrusted_Core0
    10 x OsEvent:
      Rte_Ev_Cyclic2_Default_BSW_Async_Task_0_10ms
      Rte_Ev_Cyclic2_Default_BSW_Async_Task_0_1ms
      Rte_Ev_Cyclic2_Default_BSW_Async_Task_0_20ms
      Rte_Ev_Cyclic2_Default_BSW_Async_Task_0_5ms
      Rte_Ev_Run_StartApplication_StartApplication_Cyclic1000ms
      Rte_Ev_Run_StartApplication_StartApplication_Cyclic10ms
      Rte_Ev_Run_StartApplication_StartApplication_Cyclic1ms
      Rte_Ev_Run_StartApplication_StartApplication_Cyclic250ms
      Rte_Ev_Run_StartApplication_StartApplication_OnDataRec_RxCtrl
      Rte_Ev_Run_StartApplication_StartApplication_OnDataRec_RxData
    OsApplication_NonTrusted_Core0 (OsApplication):
      OsTrusted = false
      OsAppTaskRef = Default_Appl_Init_Task
      OsAppTaskRef = Default_Appl_Task
      OsAppAlarmRef = Os/Rte_Al_TE_StartApplication_StartApplication_Cyclic1000ms
      OsAppAlarmRef = Os/Rte_Al_TE_StartApplication_StartApplication_Cyclic10ms
      OsAppAlarmRef = Os/Rte_Al_TE_StartApplication_StartApplication_Cyclic1ms
      OsAppAlarmRef = Os/Rte_Al_TE_StartApplication_StartApplication_Cyclic250ms
      OsAppTaskRef = Default_BSW_Async_Task
      OsAppAlarmRef = Os/Rte_Al_TE2_Default_BSW_Async_Task_0_10ms
      OsAppAlarmRef = Os/Rte_Al_TE2_Default_BSW_Async_Task_0_1ms
      OsAppAlarmRef = Os/Rte_Al_TE2_Default_BSW_Async_Task_0_20ms
      OsAppAlarmRef = Os/Rte_Al_TE2_Default_BSW_Async_Task_0_5ms
      OsAppTaskRef = StartApplication_MemoryViolation_Task
      OsAppAlarmRef = Os/Rte_Al_TE_StartApplication_StartApplication_MEMORYPROTECTION_Cyclic10ms
    OsApplication_Trusted_Core0 (OsApplication): OsTrusted=true, OsAppTaskRef=OsTask_WdgM_Cyclic, OsAppAlarmRef=Os/Rte_Al_TE2_OsTask_WdgM_Cyclic_0_10ms, OsAppTaskRef=StartApplication_Trusted_Task
  module config EcuC
  ecuc value collection DaVinci_Project: ecuc-values=[Com, Rte, Os, EcuC, NvM]
