AUTOSAR XML (schema 4-0-3)
package /DaVinci_Project
  module config Com
    ComConfig
      26 x ComSignal:
        read_AcceleratorPedal_Opening_oVCUHV_Receive_oCAN00_487c0bf6_Rx: ComSignalType=UINT16
        read_ActualGear_Status_oVCUHV_Receive_oCAN00_7e6698b8_Rx: ComSignalType=UINT8
        read_BmsBatteryTotal_Current_oVCUHV_Receive_oCAN00_a76f589b_Rx: ComSignalType=FLOAT64
        read_BmsBattery_SocValue_oVCUHV_Receive_oCAN00_270f3267_Rx: ComSignalType=FLOAT64
        read_BmsMainNegativeRelayClosed_oVCUHV_Receive_oCAN00_753eb224_Rx: ComSignalType=UINT8
        read_BmsMainNegativeRelay_Status_oVCUHV_Receive_oCAN00_d2726e8d_Rx: ComSignalType=BOOLEAN
        read_BmsRelayOff_Request_oVCUHV_Receive_oCAN00_80bc2290_Rx: ComSignalType=UINT8
        read_BrakePedal_Status_oVCUHV_Receive_oCAN00_ff534c6b_Rx: ComSignalType=UINT8
        read_DcdcWorking_Status_oVCUHV_Receive_oCAN00_47bf7105_Rx: ComSignalType=UINT8
        read_FastChargePlug_Status_oVCUHV_Receive_oCAN00_20825129_Rx: ComSignalType=BOOLEAN
        read_KeyONSwitch_Signal_oVCUHV_Receive_oCAN00_cc707b37_Rx: ComSignalType=BOOLEAN
        read_KeyStartSwitch_Signal_oVCUHV_Receive_oCAN00_12b91abc_Rx: ComSignalType=BOOLEAN
        read_McuWorking_Status_oVCUHV_Receive_oCAN00_46e05410_Rx: ComSignalType=UINT8
        read_PduMainPrechargeRelay_oVCUHV_Receive_oCAN00_7a304762_Rx: ComSignalType=UINT8
        read_PduMainRelay_Status_oVCUHV_Receive_oCAN00_4bff4eb0_Rx: ComSignalType=UINT8
        read_SelfCheck_Status_oVCUHV_Receive_oCAN00_932015b8_Rx: ComSignalType=BOOLEAN
        read_SlowChargePlug_Status_oVCUHV_Receive_oCAN00_00e8f3f1_Rx: ComSignalType=BOOLEAN
        read_VehicleFaultLevel_oVCUHV_Receive_oCAN00_cf14497e_Rx: ComSignalType=UINT8
        read_VehicleSpeed_Kph_oVCUHV_Receive_oCAN00_55e74c51_Rx: ComSignalType=FLOAT64
        write_BmsFault_Status_oVCUHV_Send_oCAN00_3bb6edf6_Tx: ComSignalType=UINT8
        write_DcdcFault_Status_oVCUHV_Send_oCAN00_1ff6e880_Tx: ComSignalType=UINT8
        write_Dcdc_Enable_oVCUHV_Send_oCAN00_ff201339_Tx: ComSignalType=UINT8
        write_MainNegativeRelay_Enable_oVCUHV_Send_oCAN00_47506650_Tx: ComSignalType=UINT8
        write_MainPrechargeRelay_Enable_oVCUHV_Send_oCAN00_b12b678a_Tx: ComSignalType=UINT8
        write_MainRelay_Enable_oVCUHV_Send_oCAN00_10fd8b9a_Tx: ComSignalType=UINT8
        write_VehicleReady_Status_oVCUHV_Send_oCAN00_8602d488_Tx: ComSignalType=UINT8
  module config Rte
    16 x RteBswModuleInstance:
      BswM
        BswM_MainFunctionTimingEvent0 (RteBswEventToTaskMapping): RteBswUsedOsEventRef=Rte_Ev_Cyclic2_OsTask_BSW_SCHM_0_10ms, RteBswUsedOsAlarmRef=Os/Rte_Al_TE2_OsTask_BSW_SCHM_0_10ms
      Can
        3 x RteBswEventToTaskMapping, all with RteBswUsedOsEventRef=Rte_Ev_Cyclic2_OsTask_BSW_SCHM_0_10ms, RteBswUsedOsAlarmRef=Os/Rte_Al_TE2_OsTask_BSW_SCHM_0_10ms:
          Can_MainFunction_BusOffTimingEvent0
          Can_MainFunction_ModeTimingEvent0
          Can_MainFunction_WakeupTimingEvent0
      CanIf
      CanSM
        CanSM_MainFunctionTimingEvent0 (RteBswEventToTaskMapping): RteBswUsedOsEventRef=Rte_Ev_Cyclic2_OsTask_BSW_SCHM_0_10ms, RteBswUsedOsAlarmRef=Os/Rte_Al_TE2_OsTask_BSW_SCHM_0_10ms
      CanTp
        CanTp_MainFunctionTimingEvent0 (RteBswEventToTaskMapping): RteBswUsedOsEventRef=Rte_Ev_Run_CanTp_CanTp_MainFunction, RteBswUsedOsAlarmRef=Os/Rte_Al_TE_CanTp_CanTp_MainFunction
      Com
        Com_MainFunctionRxTimingEvent0 (RteBswEventToTaskMapping): RteBswUsedOsEventRef=Rte_Ev_Cyclic2_OsTask_BSW_SCHM_0_10ms, RteBswUsedOsAlarmRef=Os/Rte_Al_TE2_OsTask_BSW_SCHM_0_10ms
        Com_MainFunctionTxTimingEvent0 (RteBswEventToTaskMapping): RteBswUsedOsEventRef=Rte_Ev_Cyclic2_OsTask_BSW_SCHM_0_10ms, RteBswUsedOsAlarmRef=Os/Rte_Al_TE2_OsTask_BSW_SCHM_0_10ms
      ComM
        ComM_MainFunction_0TimingEvent0 (RteBswEventToTaskMapping): RteBswUsedOsEventRef=Rte_Ev_Cyclic2_OsTask_BSW_SCHM_0_20ms, RteBswUsedOsAlarmRef=Os/Rte_Al_TE2_OsTask_BSW_SCHM_0_20ms
      Dcm
        Dcm_MainFunctionTimingEvent0 (RteBswEventToTaskMapping): RteBswUsedOsEventRef=Rte_Ev_Cyclic2_OsTask_BSW_SCHM_0_10ms, RteBswUsedOsAlarmRef=Os/Rte_Al_TE2_OsTask_BSW_SCHM_0_10ms
      Dem
        Dem_MasterMainFunctionTimingEvent0 (RteBswEventToTaskMapping): RteBswUsedOsEventRef=Rte_Ev_Cyclic2_OsTask_BSW_SCHM_0_10ms, RteBswUsedOsAlarmRef=Os/Rte_Al_TE2_OsTask_BSW_SCHM_0_10ms
        Dem_SatelliteMainFunctionTimingEvent0 (RteBswEventToTaskMapping): RteBswUsedOsEventRef=Rte_Ev_Cyclic2_OsTask_BSW_SCHM_0_10ms, RteBswUsedOsAlarmRef=Os/Rte_Al_TE2_OsTask_BSW_SCHM_0_10ms
      Det
      Dio
      EcuM
        EcuM_MainFunctionTimingEvent0 (RteBswEventToTaskMapping): RteBswUsedOsEventRef=Rte_Ev_Cyclic2_OsTask_BSW_SCHM_0_10ms, RteBswUsedOsAlarmRef=Os/Rte_Al_TE2_OsTask_BSW_SCHM_0_10ms
      Mcu
      PduR
      Port
      Spi
        Spi_MainFunction_HandlingTimingEvent0 (RteBswEventToTaskMapping)
    11 x RteSwComponentInstance:
      BswM_EcuSwComposition
        Timer_BswM_MainFunction (RteEventToTaskMapping): RteUsedOsEventRef=Rte_Ev_Cyclic2_OsTask_BSW_SCHM_0_10ms, RteUsedOsAlarmRef=Os/Rte_Al_TE2_OsTask_BSW_SCHM_0_10ms
      Cdd_SBC_UJA1169_EcuSwComposition
        TMT_Sbc_Test_Runnable (RteEventToTaskMapping): RteUsedOsEventRef=Rte_Ev_Cyclic_OsTask_APP_0_100ms, RteUsedOsAlarmRef=Os/Rte_Al_TE_OsTask_APP_0_100ms
      ComM_EcuSwComposition
        Timer_ComM_MainFunction_0 (RteEventToTaskMapping): RteUsedOsEventRef=Rte_Ev_Cyclic2_OsTask_BSW_SCHM_0_20ms, RteUsedOsAlarmRef=Os/Rte_Al_TE2_OsTask_BSW_SCHM_0_20ms
      CpLedTask_EcuSwComposition
        TMT_LedRunnable (RteEventToTaskMapping): RteUsedOsEventRef=Rte_Ev_Run_CpLedTask_LedRunnable, RteUsedOsAlarmRef=Os/Rte_Al_TE_CpLedTask_LedRunnable
      Dcm_EcuSwComposition
        Timer_Dcm_MainFunction (RteEventToTaskMapping): RteUsedOsEventRef=Rte_Ev_Cyclic2_OsTask_BSW_SCHM_0_10ms, RteUsedOsAlarmRef=Os/Rte_Al_TE2_OsTask_BSW_SCHM_0_10ms
      DemMaster_0_EcuSwComposition
        Timer_Dem_MasterMainFunction (RteEventToTaskMapping): RteUsedOsEventRef=Rte_Ev_Cyclic2_OsTask_BSW_SCHM_0_10ms, RteUsedOsAlarmRef=Os/Rte_Al_TE2_OsTask_BSW_SCHM_0_10ms
      DemSatellite_0_EcuSwComposition
        Timer_Dem_SatelliteMainFunction (RteEventToTaskMapping): RteUsedOsEventRef=Rte_Ev_Cyclic2_OsTask_BSW_SCHM_0_10ms, RteUsedOsAlarmRef=Os/Rte_Al_TE2_OsTask_BSW_SCHM_0_10ms
      Det_EcuSwComposition
      EcuM_EcuSwComposition
        Timer_EcuM_MainFunction (RteEventToTaskMapping): RteUsedOsEventRef=Rte_Ev_Cyclic2_OsTask_BSW_SCHM_0_10ms, RteUsedOsAlarmRef=Os/Rte_Al_TE2_OsTask_BSW_SCHM_0_10ms
      Os_OsCore0_swc_EcuSwComposition
      VCUHVACT_EcuSwComposition
        TMT_HVAct_100ms (RteEventToTaskMapping): RteUsedOsEventRef=Rte_Ev_Cyclic_OsTask_APP_0_100ms, RteUsedOsAlarmRef=Os/Rte_Al_TE_OsTask_APP_0_100ms
    RteOsInteraction
      5 x RteUsedOsActivation, all with RteExpectedActivationOffset=0:
        Rte_Al_TE_CpLedTask_LedRunnable: RteActivationOsAlarmRef=Os/Rte_Al_TE_CpLedTask_LedRunnable, RteActivationOsTaskRef=OsTask_APP
        Rte_Al_TE_OsTask_APP_0_100ms: RteActivationOsAlarmRef=Os/Rte_Al_TE_OsTask_APP_0_100ms, RteActivationOsTaskRef=OsTask_APP
        Rte_Al_TE2_OsTask_BSW_SCHM_0_10ms: RteActivationOsAlarmRef=Os/Rte_Al_TE2_OsTask_BSW_SCHM_0_10ms, RteActivationOsTaskRef=OsTask_BSW_SCHM
        Rte_Al_TE2_OsTask_BSW_SCHM_0_20ms: RteActivationOsAlarmRef=Os/Rte_Al_TE2_OsTask_BSW_SCHM_0_20ms, RteActivationOsTaskRef=OsTask_BSW_SCHM
        Rte_Al_TE_CanTp_CanTp_MainFunction: RteActivationOsAlarmRef=Os/Rte_Al_TE_CanTp_CanTp_MainFunction, RteActivationOsTaskRef=OsTask_BSW_SCHM
  module config NvM
  module config Os
    OsTask_APP (OsTask):
      OsTaskActivation = 1
      OsTaskPriority = 15
      OsTaskSchedule = NON
      OsTaskEventRef = Rte_Ev_Cyclic_OsTask_APP_0_100ms
      OsTaskEventRef = Rte_Ev_Run_CpLedTask_LedRunnable
    Rte_Al_TE_CpLedTask_LedRunnable (OsAlarm): OsAlarmCounterRef=SystemTimer
      OsAlarmAction
        OsAlarmSetEvent: OsAlarmSetEventRef=Rte_Ev_Run_CpLedTask_LedRunnable, OsAlarmSetEventTaskRef=OsTask_APP
    Rte_Al_TE_OsTask_APP_0_100ms (OsAlarm): OsAlarmCounterRef=SystemTimer
      OsAlarmAction
        OsAlarmSetEvent: OsAlarmSetEventRef=Rte_Ev_Cyclic_OsTask_APP_0_100ms, OsAlarmSetEventTaskRef=OsTask_APP
    OsTask_BSW_SCHM (OsTask):
      OsTaskActivation = 1
      OsTaskPriority = 10
      OsTaskSchedule = NON
      OsTaskEventRef = Rte_Ev_Cyclic2_OsTask_BSW_SCHM_0_10ms
      OsTaskEventRef = Rte_Ev_Cyclic2_OsTask_BSW_SCHM_0_20ms
      OsTaskEventRef = Rte_Ev_Run_CanTp_CanTp_MainFunction
    3 x OsAlarm, all with OsAlarmCounterRef=SystemTimer:
      Rte_Al_TE2_OsTask_BSW_SCHM_0_10ms
        OsAlarmAction
          OsAlarmSetEvent: OsAlarmSetEventRef=Rte_Ev_Cyclic2_OsTask_BSW_SCHM_0_10ms, OsAlarmSetEventTaskRef=OsTask_BSW_SCHM
      Rte_Al_TE2_OsTask_BSW_SCHM_0_20ms
        OsAlarmAction
          OsAlarmSetEvent: OsAlarmSetEventRef=Rte_Ev_Cyclic2_OsTask_BSW_SCHM_0_20ms, OsAlarmSetEventTaskRef=OsTask_BSW_SCHM
      Rte_Al_TE_CanTp_CanTp_MainFunction
        OsAlarmAction
          OsAlarmSetEvent: OsAlarmSetEventRef=Rte_Ev_Run_CanTp_CanTp_MainFunction, OsAlarmSetEventTaskRef=OsTask_BSW_SCHM
    5 x OsEvent:
      Rte_Ev_Cyclic2_OsTask_BSW_SCHM_0_10ms
      Rte_Ev_Cyclic2_OsTask_BSW_SCHM_0_20ms
      Rte_Ev_Cyclic_OsTask_APP_0_100ms
      Rte_Ev_Run_CanTp_CanTp_MainFunction
      Rte_Ev_Run_CpLedTask_LedRunnable
  module config EcuC
  ecuc value collection DaVinci_Project: ecuc-values=[Com, Rte, Os, EcuC, NvM]
