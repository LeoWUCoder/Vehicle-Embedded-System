AUTOSAR XML (schema 00044)
standard types defined: boolean, uint8
package /Predefined_DEV/ImplementationDataTypes
  impl type NvM_RequestResultType: compu {0=NVM_REQ_OK, 1=NVM_REQ_NOT_OK, 2=NVM_REQ_PENDING, 3=NVM_REQ_INTEGRITY_FAILED, 4=NVM_REQ_BLOCK_SKIPPED, 5=NVM_REQ_NV_INVALIDATED, 6=NVM_REQ_CANCELED, 7=NVM_REQ_REDUNDANCY_FAILED, 8=NVM_REQ_RESTORED_FROM_ROM}, implementation-data-type=uint8
  impl type NvM_ServiceIdType: compu {6=NVM_READ_BLOCK, 7=NVM_WRITE_BLOCK, 8=NVM_RESTORE_BLOCK_DEFAULTS, 9=NVM_ERASE_BLOCK, 11=NVM_INVALIDATE_NV_BLOCK, 12=NVM_READ_ALL}, implementation-data-type=uint8
  impl type Dem_UdsStatusByteType: compu {mask 1: 1=DEM_UDS_STATUS_TF, mask 2: 2=DEM_UDS_STATUS_TFTOC, mask 4: 4=DEM_UDS_STATUS_PDTC, mask 8: 8=DEM_UDS_STATUS_CDTC, mask 16: 16=DEM_UDS_STATUS_TNCSLC, mask 32: 32=DEM_UDS_STATUS_TFSLC, mask 64: 64=DEM_UDS_STATUS_TNCTOC, mask 128: 128=DEM_UDS_STATUS_WIR}, range raw 0..255, implementation-data-type=uint8
package /DataType/Constraint
  range DC_sig_LampCnt: raw 0..255
  range DC_sig_RearInteriorLight: raw 0..1
  range DC_sig_State_RearInteriorLight: raw 0..1
  range DC_sig_State_RearLeftDoor: raw 0..1
  range DC_sig_State_RearRightDoor: raw 0..1
  range DC_read_AcceleratorPedal_Opening: raw 0..100
  range DC_read_ActualGear_Status: raw 0..1
  range DC_read_BmsBattery_SocValue: raw 0..63
  range DC_read_BmsBatteryTotal_Current: raw 0..1
  range DC_read_BmsMainNegativeRelay_Status: raw 0..1
  range DC_read_BmsMainNegativeRelayClosed: raw 0..1
  range DC_read_BmsRelayOff_Request: raw 0..1
  range DC_read_BrakePedal_Status: raw 0..1
  range DC_read_DcdcWorking_Status: raw 0..1
  range DC_read_FastChargePlug_Status: raw 0..1
  range DC_read_KeyONSwitch_Signal: raw 0..1
  range DC_read_KeyStartSwitch_Signal: raw 0..1
  range DC_read_McuWorking_Status: raw 0..1
  range DC_read_PduMainPrechargeRelay: raw 0..1
  range DC_read_PduMainRelay_Status: raw 0..1
  range DC_read_SelfCheck_Status: raw 0..1
  range DC_read_SlowChargePlug_Status: raw 0..1
  range DC_read_VehicleFaultLevel: raw 0..1
  range DC_read_VehicleSpeed_Kph: raw 0..100
  range DC_write_BmsFault_Status: raw 0..1
  range DC_write_Dcdc_Enable: raw 0..1
  range DC_write_DcdcFault_Status: raw 0..1
  range DC_write_MainNegativeRelay_Enable: raw 0..1
  range DC_write_MainPrechargeRelay_Enable: raw 0..1
  range DC_write_MainRelay_Enable: raw 0..1
  range DC_write_VehicleReady_Status: raw 0..1
