AUTOSAR XML (schema 4-2-1)
package /ActiveEcuC
  module config Com: implementation-config-variant=VARIANT-PRE-COMPILE, module-description=Com_Impl
    ComGeneration:
      ComOutOfBoundsWriteProtectionStrategy = NONE
      ComOutOfBoundsWriteSanitizer = false
      ComOutOfBoundsReadSanitizer = false
      ComReduceConstantData2Define = false
      ComBoolDataInArrayOfStructStrategy = BOOLEAN
      ComDeduplicateIndirectedData = true
      ComDataDeduplicationStrategy = WITH_CAST
      ComReduceBoolDataByNegationThreshold = 2
      ComReduceBoolDataByNumericalComparisonThreshold = 2
      ComReduceBoolDataByNumericalRelationThreshold = 2
      ComReduceBoolDataByNumericalOperandStrategy = WITH_ANY_VALUE
      ComReduceNumericalDataByOffsetThreshold = 2
      ComReduceNumericalDataByArraySubtractionThreshold = 2
      ComReduceDataByStreaming = false
      ComShortSymbols = false
      ComInterfacesForDeactivatedData = false
      ComReferringKeysInComments = false
    ComOptimization:
      ComTxCyclicProcessingISRLockThreshold = 1
      ComTxDeadlineMonitoringISRLockThreshold = 1
      ComTxProcessingISRLockThreshold = 1
      ComRxDeadlineMonitoringISRLockThreshold = 1
      ComRxDeferredProcessingISRLockThreshold = 1
      ComGatewayProcessingISRLockThreshold = 1
      ComGatewayDescriptionProcessingISRLockThreshold = 1
      ComIPduGroupISRLockThreshold = 1
    ComConfig: ComConfigurationId=0, ComRxDeferredNotificationCacheSize=0, ComRxImmediateNotificationCacheSize=0
      MyECU_oCAN00_Rx_4cbf71f7 (ComIPduGroup): ComIPduGroupHandleId=0
      sig_State_RearLeftDoor_omsg_Receive_oCAN00_84ad4140_Rx (ComSignal):
        ComBitPosition = 0
        ComBitSize = 1
        ComSignalEndianness = LITTLE_ENDIAN
        ComSignalInitValue = 0
        ComSignalType = BOOLEAN
        ComTimeout = 0
        ComSignalAccess = ACCESS_UNCLEAR
        ComHandleId = 20
        ComSystemTemplateSystemSignalRef = sig_State_RearLeftDoor
      sig_LampCnt_omsg_MyECU_Lamp_oCAN00_f37e68ea_Tx (ComSignal):
        ComBitPosition = 7
        ComBitSize = 8
        ComSignalEndianness = BIG_ENDIAN
        ComSignalInitValue = 0
        ComSignalType = UINT8
        ComTransferProperty = PENDING
        ComSignalAccess = ACCESS_UNCLEAR
        ComHandleId = 0
        ComSystemTemplateSystemSignalRef = sig_LampCnt
      ComTimeBase: ComRxTimeBase=0.01, ComTxTimeBase=0.01, ComGwTimeBase=0.01
      msg_Transmit_oCAN00_0723e95e_Tx (ComIPdu):
        ComIPduDirection = SEND
        ComIPduType = NORMAL
        ComIPduHandleId = 2
        ComIPduSignalProcessing = DEFERRED
        ComIPduCancellationSupport = false
        ComIPduGroupRef = MyECU_oCAN00_Tx_1ae5d671
        ComIPduSignalRef = sig_RearInteriorLight_omsg_Transmit_oCAN00_49a633c1_Tx
        ComPduIdRef = msg_Transmit_oCAN00_0723e95e_Tx
        ComTxIPdu: ComMinimumDelayTime=0, ComTxIPduUnusedAreasDefault=0
          ComTxModeTrue
            ComTxMode: ComTxModeMode=PERIODIC, ComTxModeTimeOffset=0, ComTxModeTimePeriod=0.1
          ComTxModeFalse
            ComTxMode: ComTxModeMode=PERIODIC, ComTxModeTimeOffset=0, ComTxModeTimePeriod=0.1
      sig_State_RearInteriorLight_omsg_Receive_oCAN00_63323183_Rx (ComSignal):
        ComBitPosition = 2
        ComBitSize = 1
        ComSignalEndianness = LITTLE_ENDIAN
        ComSignalInitValue = 0
        ComSignalType = BOOLEAN
        ComTimeout = 0
        ComSignalAccess = ACCESS_UNCLEAR
        ComHandleId = 19
        ComSystemTemplateSystemSignalRef = sig_State_RearInteriorLight
      sig_State_RearRightDoor_omsg_Receive_oCAN00_a8945098_Rx (ComSignal):
        ComBitPosition = 1
        ComBitSize = 1
        ComSignalEndianness = LITTLE_ENDIAN
        ComSignalInitValue = 0
        ComSignalType = BOOLEAN
        ComTimeout = 0
        ComSignalAccess = ACCESS_UNCLEAR
        ComHandleId = 21
        ComSystemTemplateSystemSignalRef = sig_State_RearRightDoor
      msg_Receive_oCAN00_2b456e3f_Rx (ComIPdu):
        ComIPduDirection = RECEIVE
        ComIPduType = NORMAL
        ComIPduHandleId = 1
        ComIPduSignalProcessing = DEFERRED
        ComIPduCancellationSupport = false
        ComIPduGroupRef = MyECU_oCAN00_Rx_4cbf71f7
        ComIPduSignalRef = sig_State_RearInteriorLight_omsg_Receive_oCAN00_63323183_Rx
        ComIPduSignalRef = sig_State_RearLeftDoor_omsg_Receive_oCAN00_84ad4140_Rx
        ComIPduSignalRef = sig_State_RearRightDoor_omsg_Receive_oCAN00_a8945098_Rx
        ComPduIdRef = msg_Receive_oCAN00_2b456e3f_Rx
      MyECU_oCAN00_Tx_1ae5d671 (ComIPduGroup): ComIPduGroupHandleId=1
      msg_MyECU_Lamp_oCAN00_818e1651_Tx (ComIPdu):
        ComIPduDirection = SEND
        ComIPduType = NORMAL
        ComIPduHandleId = 1
        ComIPduSignalProcessing = DEFERRED
        ComIPduCancellationSupport = false
        ComIPduGroupRef = MyECU_oCAN00_Tx_1ae5d671
        ComIPduSignalRef = sig_LampCnt_omsg_MyECU_Lamp_oCAN00_f37e68ea_Tx
        ComPduIdRef = msg_MyECU_Lamp_oCAN00_818e1651_Tx
        ComTxIPdu: ComMinimumDelayTime=0, ComTxIPduUnusedAreasDefault=0
          ComTxModeTrue
            ComTxMode: ComTxModeMode=PERIODIC, ComTxModeTimeOffset=0, ComTxModeTimePeriod=0.1
          ComTxModeFalse
            ComTxMode: ComTxModeMode=PERIODIC, ComTxModeTimeOffset=0, ComTxModeTimePeriod=0.1
      5 x ComSignal, all with ComSignalEndianness=LITTLE_ENDIAN, ComSignalInitValue=0:
        sig_RearInteriorLight_omsg_Transmit_oCAN00_49a633c1_Tx: ComBitPosition=0, ComBitSize=1, ComSignalType=BOOLEAN, ComTransferProperty=PENDING, ComSignalAccess=ACCESS_UNCLEAR, ComHandleId=1, ComSystemTemplateSystemSignalRef=sig_RearInteriorLight
        read_BmsBattery_SocValue_oVCUHV_Receive_oCAN00_270f3267_Rx: ComBitPosition=16, ComBitSize=6, ComSignalType=FLOAT64, ComTimeout=0, ComSignalAccess=ACCESS_NEEDED_BY_SWC_OR_COM, ComHandleId=3, ComSystemTemplateSystemSignalRef=read_BmsBattery_SocValue
        read_VehicleSpeed_Kph_oVCUHV_Receive_oCAN00_55e74c51_Rx: ComBitPosition=33, ComBitSize=7, ComSignalType=FLOAT64, ComTimeout=0, ComSignalAccess=ACCESS_NEEDED_BY_SWC_OR_COM, ComHandleId=18, ComSystemTemplateSystemSignalRef=read_VehicleSpeed_Kph
        write_MainRelay_Enable_oVCUHV_Send_oCAN00_10fd8b9a_Tx: ComBitPosition=8, ComBitSize=1, ComSignalType=UINT8, ComTransferProperty=PENDING, ComSignalAccess=ACCESS_NEEDED_BY_SWC_OR_COM, ComHandleId=7, ComSystemTemplateSystemSignalRef=write_MainRelay_Enable
        read_SlowChargePlug_Status_oVCUHV_Receive_oCAN00_00e8f3f1_Rx: ComBitPosition=4, ComBitSize=1, ComSignalType=BOOLEAN, ComTimeout=0, ComSignalAccess=ACCESS_NEEDED_BY_SWC_OR_COM, ComHandleId=16, ComSystemTemplateSystemSignalRef=read_SlowChargePlug_Status
      VCUHV_Receive_oCAN00_2f877d2a_Rx (ComIPdu):
        ComIPduDirection = RECEIVE
        ComIPduType = NORMAL
        ComIPduHandleId = 0
        ComIPduSignalProcessing = DEFERRED
        ComIPduCancellationSupport = false
        ComIPduGroupRef = MyECU_oCAN00_Rx_4cbf71f7
        ComIPduSignalRef = read_AcceleratorPedal_Opening_oVCUHV_Receive_oCAN00_487c0bf6_Rx
        ComIPduSignalRef = read_ActualGear_Status_oVCUHV_Receive_oCAN00_7e6698b8_Rx
        ComIPduSignalRef = read_BmsBatteryTotal_Current_oVCUHV_Receive_oCAN00_a76f589b_Rx
        ComIPduSignalRef = read_BmsBattery_SocValue_oVCUHV_Receive_oCAN00_270f3267_Rx
        ComIPduSignalRef = read_BmsMainNegativeRelayClosed_oVCUHV_Receive_oCAN00_753eb224_Rx
        ComIPduSignalRef = read_BmsMainNegativeRelay_Status_oVCUHV_Receive_oCAN00_d2726e8d_Rx
        ComIPduSignalRef = read_BmsRelayOff_Request_oVCUHV_Receive_oCAN00_80bc2290_Rx
        ComIPduSignalRef = read_BrakePedal_Status_oVCUHV_Receive_oCAN00_ff534c6b_Rx
        ComIPduSignalRef = read_DcdcWorking_Status_oVCUHV_Receive_oCAN00_47bf7105_Rx
        ComIPduSignalRef = read_FastChargePlug_Status_oVCUHV_Receive_oCAN00_20825129_Rx
        ComIPduSignalRef = read_KeyONSwitch_Signal_oVCUHV_Receive_oCAN00_cc707b37_Rx
        ComIPduSignalRef = read_KeyStartSwitch_Signal_oVCUHV_Receive_oCAN00_12b91abc_Rx
        ComIPduSignalRef = read_McuWorking_Status_oVCUHV_Receive_oCAN00_46e05410_Rx
        ComIPduSignalRef = read_PduMainPrechargeRelay_oVCUHV_Receive_oCAN00_7a304762_Rx
        ComIPduSignalRef = read_PduMainRelay_Status_oVCUHV_Receive_oCAN00_4bff4eb0_Rx
        ComIPduSignalRef = read_SelfCheck_Status_oVCUHV_Receive_oCAN00_932015b8_Rx
        ComIPduSignalRef = read_SlowChargePlug_Status_oVCUHV_Receive_oCAN00_00e8f3f1_Rx
        ComIPduSignalRef = read_VehicleFaultLevel_oVCUHV_Receive_oCAN00_cf14497e_Rx
        ComIPduSignalRef = read_VehicleSpeed_Kph_oVCUHV_Receive_oCAN00_55e74c51_Rx
        ComPduIdRef = VCUHV_Receive_oCAN00_2f877d2a_Rx
      15 x ComSignal, all with ComSignalEndianness=LITTLE_ENDIAN, ComSignalInitValue=0, ComSignalAccess=ACCESS_NEEDED_BY_SWC_OR_COM:
        write_MainNegativeRelay_Enable_oVCUHV_Send_oCAN00_47506650_Tx: ComBitPosition=24, ComBitSize=1, ComSignalType=UINT8, ComTransferProperty=PENDING, ComHandleId=5, ComSystemTemplateSystemSignalRef=write_MainNegativeRelay_Enable
        read_AcceleratorPedal_Opening_oVCUHV_Receive_oCAN00_487c0bf6_Rx: ComBitPosition=25, ComBitSize=7, ComSignalType=UINT16, ComTimeout=0, ComHandleId=0, ComSystemTemplateSystemSignalRef=read_AcceleratorPedal_Opening
        read_VehicleFaultLevel_oVCUHV_Receive_oCAN00_cf14497e_Rx: ComBitPosition=1, ComBitSize=1, ComSignalType=UINT8, ComTimeout=0, ComHandleId=17, ComSystemTemplateSystemSignalRef=read_VehicleFaultLevel
        read_SelfCheck_Status_oVCUHV_Receive_oCAN00_932015b8_Rx: ComBitPosition=0, ComBitSize=1, ComSignalType=BOOLEAN, ComTimeout=0, ComHandleId=15, ComSystemTemplateSystemSignalRef=read_SelfCheck_Status
        read_ActualGear_Status_oVCUHV_Receive_oCAN00_7e6698b8_Rx: ComBitPosition=8, ComBitSize=1, ComSignalType=UINT8, ComTimeout=0, ComHandleId=1, ComSystemTemplateSystemSignalRef=read_ActualGear_Status
        write_VehicleReady_Status_oVCUHV_Send_oCAN00_8602d488_Tx: ComBitPosition=16, ComBitSize=1, ComSignalType=UINT8, ComTransferProperty=PENDING, ComHandleId=8, ComSystemTemplateSystemSignalRef=write_VehicleReady_Status
        read_DcdcWorking_Status_oVCUHV_Receive_oCAN00_47bf7105_Rx: ComBitPosition=24, ComBitSize=1, ComSignalType=UINT8, ComTimeout=0, ComHandleId=8, ComSystemTemplateSystemSignalRef=read_DcdcWorking_Status
        read_BmsRelayOff_Request_oVCUHV_Receive_oCAN00_80bc2290_Rx: ComBitPosition=22, ComBitSize=1, ComSignalType=UINT8, ComTimeout=0, ComHandleId=6, ComSystemTemplateSystemSignalRef=read_BmsRelayOff_Request
        read_McuWorking_Status_oVCUHV_Receive_oCAN00_46e05410_Rx: ComBitPosition=13, ComBitSize=1, ComSignalType=UINT8, ComTimeout=0, ComHandleId=12, ComSystemTemplateSystemSignalRef=read_McuWorking_Status
        read_KeyStartSwitch_Signal_oVCUHV_Receive_oCAN00_12b91abc_Rx: ComBitPosition=6, ComBitSize=1, ComSignalType=BOOLEAN, ComTimeout=0, ComHandleId=11, ComSystemTemplateSystemSignalRef=read_KeyStartSwitch_Signal
        write_Dcdc_Enable_oVCUHV_Send_oCAN00_ff201339_Tx: ComBitPosition=32, ComBitSize=1, ComSignalType=UINT8, ComTransferProperty=PENDING, ComHandleId=4, ComSystemTemplateSystemSignalRef=write_Dcdc_Enable
        read_BmsMainNegativeRelay_Status_oVCUHV_Receive_oCAN00_d2726e8d_Rx: ComBitPosition=2, ComBitSize=1, ComSignalType=BOOLEAN, ComTimeout=0, ComHandleId=5, ComSystemTemplateSystemSignalRef=read_BmsMainNegativeRelay_Status
        write_MainPrechargeRelay_Enable_oVCUHV_Send_oCAN00_b12b678a_Tx: ComBitPosition=0, ComBitSize=1, ComSignalType=UINT8, ComTransferProperty=PENDING, ComHandleId=6, ComSystemTemplateSystemSignalRef=write_MainPrechargeRelay_Enable
        write_DcdcFault_Status_oVCUHV_Send_oCAN00_1ff6e880_Tx: ComBitPosition=40, ComBitSize=1, ComSignalType=UINT8, ComTransferProperty=PENDING, ComHandleId=3, ComSystemTemplateSystemSignalRef=write_DcdcFault_Status
        read_PduMainPrechargeRelay_oVCUHV_Receive_oCAN00_7a304762_Rx: ComBitPosition=11, ComBitSize=1, ComSignalType=UINT8, ComTimeout=0, ComHandleId=13, ComSystemTemplateSystemSignalRef=read_PduMainPrechargeRelay
      VCUHV_Send_oCAN00_b4e3e134_Tx (ComIPdu):
        ComIPduDirection = SEND
        ComIPduType = NORMAL
        ComIPduHandleId = 0
        ComIPduSignalProcessing = DEFERRED
        ComIPduCancellationSupport = false
        ComIPduGroupRef = MyECU_oCAN00_Tx_1ae5d671
        ComIPduSignalRef = write_BmsFault_Status_oVCUHV_Send_oCAN00_3bb6edf6_Tx
        ComIPduSignalRef = write_DcdcFault_Status_oVCUHV_Send_oCAN00_1ff6e880_Tx
        ComIPduSignalRef = write_Dcdc_Enable_oVCUHV_Send_oCAN00_ff201339_Tx
        ComIPduSignalRef = write_MainNegativeRelay_Enable_oVCUHV_Send_oCAN00_47506650_Tx
        ComIPduSignalRef = write_MainPrechargeRelay_Enable_oVCUHV_Send_oCAN00_b12b678a_Tx
        ComIPduSignalRef = write_MainRelay_Enable_oVCUHV_Send_oCAN00_10fd8b9a_Tx
        ComIPduSignalRef = write_VehicleReady_Status_oVCUHV_Send_oCAN00_8602d488_Tx
        ComPduIdRef = VCUHV_Send_oCAN00_b4e3e134_Tx
        ComTxIPdu: ComMinimumDelayTime=0, ComTxIPduUnusedAreasDefault=0
          ComTxModeTrue
            ComTxMode: ComTxModeMode=PERIODIC, ComTxModeTimeOffset=0, ComTxModeTimePeriod=0.1
          ComTxModeFalse
            ComTxMode: ComTxModeMode=PERIODIC, ComTxModeTimeOffset=0, ComTxModeTimePeriod=0.1
      7 x ComSignal, all with ComSignalEndianness=LITTLE_ENDIAN, ComSignalInitValue=0, ComSignalAccess=ACCESS_NEEDED_BY_SWC_OR_COM:
        read_FastChargePlug_Status_oVCUHV_Receive_oCAN00_20825129_Rx: ComBitPosition=5, ComBitSize=1, ComSignalType=BOOLEAN, ComTimeout=0, ComHandleId=9, ComSystemTemplateSystemSignalRef=read_FastChargePlug_Status
        read_BmsMainNegativeRelayClosed_oVCUHV_Receive_oCAN00_753eb224_Rx: ComBitPosition=23, ComBitSize=1, ComSignalType=UINT8, ComTimeout=0, ComHandleId=4, ComSystemTemplateSystemSignalRef=read_BmsMainNegativeRelayClosed
        read_BmsBatteryTotal_Current_oVCUHV_Receive_oCAN00_a76f589b_Rx: ComBitPosition=32, ComBitSize=1, ComSignalType=FLOAT64, ComTimeout=0, ComHandleId=2, ComSystemTemplateSystemSignalRef=read_BmsBatteryTotal_Current
        write_BmsFault_Status_oVCUHV_Send_oCAN00_3bb6edf6_Tx: ComBitPosition=48, ComBitSize=1, ComSignalType=UINT8, ComTransferProperty=PENDING, ComHandleId=2, ComSystemTemplateSystemSignalRef=write_BmsFault_Status
        read_KeyONSwitch_Signal_oVCUHV_Receive_oCAN00_cc707b37_Rx: ComBitPosition=14, ComBitSize=2, ComSignalType=BOOLEAN, ComTimeout=0, ComHandleId=10, ComSystemTemplateSystemSignalRef=read_KeyONSwitch_Signal
        read_PduMainRelay_Status_oVCUHV_Receive_oCAN00_4bff4eb0_Rx: ComBitPosition=12, ComBitSize=1, ComSignalType=UINT8, ComTimeout=0, ComHandleId=14, ComSystemTemplateSystemSignalRef=read_PduMainRelay_Status
        read_BrakePedal_Status_oVCUHV_Receive_oCAN00_ff534c6b_Rx: ComBitPosition=9, ComBitSize=1, ComSignalType=UINT8, ComTimeout=0, ComHandleId=7, ComSystemTemplateSystemSignalRef=read_BrakePedal_Status
    ComGeneral:
      ComConfigurationUseDet = true
      ComEnableSignalGroupArrayApi = false
      ComRetryFailedTransmitRequests = false
      ComSupportedIPduGroups = 2
      ComVersionInfoApi = false
      ComAdvancedIPduCallouts = true
      ComOptimizedIPduGroupHandling = false
      ComMetaDataSupport = false
      ComReceiveSignalMacroAPI = false
      ComDeferredEventCacheSupport = false
      ComMainfunctionTimingDomainSupport = false
      ComDescriptionRoutingCodeGeneration = false
      ComSafeBswChecks = false
