AUTOSAR XML (schema 00044)
package /COM/VECTOR/CFG/WORKFLOW/SYSDESC/SYNC
  system SYSTEM: category=ECU_EXTRACT
    system mapping MAPPINGS
      data-mappings:
        data-element=VCUHVACT.COMPOSITIONTYPE.write_BmsFault_Status.unit8_t, system-signal=write_BmsFault_Status
        data-element=VCUHVACT.COMPOSITIONTYPE.write_Dcdc_Enable.uint8_t, system-signal=write_Dcdc_Enable
        data-element=VCUHVACT.COMPOSITIONTYPE.write_DcdcFault_Status.uint8_t, system-signal=write_DcdcFault_Status
        data-element=VCUHVACT.COMPOSITIONTYPE.write_MainNegativeRelay_Enable.unit8_t, system-signal=write_MainNegativeRelay_Enable
        data-element=VCUHVACT.COMPOSITIONTYPE.write_MainPrechargeRelay_Enable.uint8_t, system-signal=write_MainPrechargeRelay_Enable
        data-element=VCUHVACT.COMPOSITIONTYPE.write_MainRelay_Enable.uint8_t, system-signal=write_MainRelay_Enable
        data-element=VCUHVACT.COMPOSITIONTYPE.write_VehicleReady_Status.uint8_t, system-signal=write_VehicleReady_Status
        data-element=VCUHVACT.COMPOSITIONTYPE.read_AcceleratorPedal_Opening.uint16_t, system-signal=read_AcceleratorPedal_Opening
        data-element=VCUHVACT.COMPOSITIONTYPE.read_ActualGear_Status.uint8_t, system-signal=read_ActualGear_Status
        data-element=VCUHVACT.COMPOSITIONTYPE.read_BmsBattery_SocValue.float64, system-signal=read_BmsBattery_SocValue
        data-element=VCUHVACT.COMPOSITIONTYPE.read_BmsBatteryTotal_Current.float64, system-signal=read_BmsBatteryTotal_Current
        data-element=VCUHVACT.COMPOSITIONTYPE.read_BmsMainNegativeRelay_Status.bool, system-signal=read_BmsMainNegativeRelay_Status
        data-element=VCUHVACT.COMPOSITIONTYPE.read_BmsMainNegativeRelayClosed_Status.uint8_t, system-signal=read_BmsMainNegativeRelayClosed
        data-element=VCUHVACT.COMPOSITIONTYPE.read_BmsRelayOff_Request.uint8_t, system-signal=read_BmsRelayOff_Request
        data-element=VCUHVACT.COMPOSITIONTYPE.read_BrakePedal_Status.uint8_t, system-signal=read_BrakePedal_Status
        data-element=VCUHVACT.COMPOSITIONTYPE.read_DcdcWorking_Status.uint8_t, system-signal=read_DcdcWorking_Status
        data-element=VCUHVACT.COMPOSITIONTYPE.read_FastChargePlug_Status.bool, system-signal=read_FastChargePlug_Status
        data-element=VCUHVACT.COMPOSITIONTYPE.read_KeyOnSwitch_Signal.bool, system-signal=read_KeyONSwitch_Signal
        data-element=VCUHVACT.COMPOSITIONTYPE.read_KeyStartSwitch_Signal.bool, system-signal=read_KeyStartSwitch_Signal
        data-element=VCUHVACT.COMPOSITIONTYPE.read_McuWorking_Status.uint8_t, system-signal=read_McuWorking_Status
        data-element=VCUHVACT.COMPOSITIONTYPE.read_PduMainPrechargeRelay_Status.uint8_t, system-signal=read_PduMainPrechargeRelay
        data-element=VCUHVACT.COMPOSITIONTYPE.read_PduMainRelay_Status.uint8_t, system-signal=read_PduMainRelay_Status
        data-element=VCUHVACT.COMPOSITIONTYPE.read_SelfCheck_Status.bool, system-signal=read_SelfCheck_Status
        data-element=VCUHVACT.COMPOSITIONTYPE.read_SlowChargePlug_Status.bool, system-signal=read_SlowChargePlug_Status
        data-element=VCUHVACT.COMPOSITIONTYPE.read_VehicleFaultLevel.uint8_t, system-signal=read_VehicleFaultLevel
        data-element=VCUHVACT.COMPOSITIONTYPE.read_VehicleSpeed_Kph.float64, system-signal=read_VehicleSpeed_Kph
    root-software-compositions:
      root sw composition prototype COMPOSITIONTYPE: flat-map=FLATMAP, software-composition=COMPOSITIONTYPE
  composition sw component type COMPOSITIONTYPE  # UB:Derived from original system description
    11 x component:
      BswM: type=BswM
      ComM: type=ComM
      Det: type=Det
      EcuM: type=EcuM
      Os_OsCore0_swc: type=Os_OsCore0_swc
      DemMaster_0: type=DemMaster_0
      DemSatellite_0: type=DemSatellite_0
      Dcm: type=Dcm
      CpLedTask: type=CtLedTask
      Cdd_SBC_UJA1169: type=CddSbc
      VCUHVACT: type=VCUHVACT
    connect BswM.Switch_ESH_ModeSwitch -> BswM.Notification_ESH_ModeNotification
    connect ComM.UR_CN_CAN00_06ecbb07 -> CpLedTask.UR_CN_CAN00_06ecbb07
  end to end protection set E2EPROTECTIONSET
  port interface mapping set PORTINTERFACEMAPPINGSET
