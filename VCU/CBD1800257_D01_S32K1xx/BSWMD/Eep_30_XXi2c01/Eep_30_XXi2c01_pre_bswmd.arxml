AUTOSAR XML (schema 4-0-3)
# COPYRIGHT
# Copyright (c) by Vector Informatik GmbH. All rights reserved.
# This software is copyright protected and proprietary to Vector Informatik GmbH.
# Vector Informatik GmbH grants to you only those rights as set out in the license conditions.
package /MICROSAR/Eep_30_XXi2c01
  module config Eep_30_XXi2c01_Pre: definition=Eep
    22 x EepDeviceInformation, all with EepMinimumAddressType=16:
      Microchip_24C65: EepAllowedWriteCycles=1000000, EepTotalSize=16384, EepWriteTime=0.005, EepPageSize=EepPageSize64
      Microchip_24AA64: EepAllowedWriteCycles=1000000, EepTotalSize=8192, EepWriteTime=0.005, EepPageSize=EepPageSize32  # Microchip 24AA64
      Microchip_24AA128: EepAllowedWriteCycles=1000000, EepTotalSize=16384, EepWriteTime=0.005, EepPageSize=EepPageSize64  # Microchip 24AA128
      Microchip_24LC64: EepAllowedWriteCycles=1000000, EepTotalSize=8192, EepWriteTime=0.005, EepPageSize=EepPageSize32  # Microchip 24LC64
      Microchip_24LC256: EepAllowedWriteCycles=1000000, EepTotalSize=32768, EepWriteTime=0.005, EepPageSize=EepPageSize64  # Microchip 24LC256
      ONSemiconductor_CAT24C32: EepAllowedWriteCycles=1000000, EepTotalSize=4096, EepWriteTime=0.005, EepPageSize=EepPageSize32  # ON Semiconductor CAT24C32
      ONSemiconductor_CAT24C64: EepAllowedWriteCycles=1000000, EepTotalSize=8192, EepWriteTime=0.005, EepPageSize=EepPageSize32  # ON Semiconductor CAT24C64
      ONSemiconductor_CAV24C16: EepAllowedWriteCycles=1000000, EepTotalSize=2048, EepWriteTime=0.005, EepPageSize=EepPageSize16  # ON Semiconductor CAV24C16
      ONSemiconductor_CAV24C32: EepAllowedWriteCycles=1000000, EepTotalSize=4096, EepWriteTime=0.005, EepPageSize=EepPageSize32  # ON Semiconductor CAV24C32
      ONSemiconductor_CAV24C64: EepAllowedWriteCycles=1000000, EepTotalSize=8192, EepWriteTime=0.005, EepPageSize=EepPageSize32  # ON Semiconductor CAV24C64
      ONSemiconductor_N24C32: EepAllowedWriteCycles=1000000, EepTotalSize=4096, EepWriteTime=0.004, EepPageSize=EepPageSize32  # ON Semiconductor N24C32
      ROHM_BR24L16: EepAllowedWriteCycles=1000000, EepTotalSize=2048, EepWriteTime=0.005, EepPageSize=EepPageSize16  # ROHM BR24L16
      Ablic_S24C64C: EepAllowedWriteCycles=1000000, EepTotalSize=8192, EepWriteTime=0.005, EepPageSize=EepPageSize32  # Ablic S24C64C
      Seiko_S24C128CH: EepAllowedWriteCycles=1000000, EepTotalSize=16384, EepWriteTime=0.005, EepPageSize=EepPageSize64  # Seiko S24C128CH
      STMicroelectronics_M24C16: EepAllowedWriteCycles=4000000, EepTotalSize=2048, EepWriteTime=0.005, EepPageSize=EepPageSize16  # ST Microelectronics M24C16
      STMicroelectronics_M24C32: EepAllowedWriteCycles=4000000, EepTotalSize=4096, EepWriteTime=0.005, EepPageSize=EepPageSize32  # ST Microelectronics M24C32
      STMicroelectronics_M24C64: EepAllowedWriteCycles=4000000, EepTotalSize=8192, EepWriteTime=0.005, EepPageSize=EepPageSize32  # ST Microelectronics M24C64
      STMicroelectronics_M24128: EepAllowedWriteCycles=4000000, EepTotalSize=16384, EepWriteTime=0.004, EepPageSize=EepPageSize64  # ST Microelectronics M24128
      STMicroelectronics_M24256: EepAllowedWriteCycles=4000000, EepTotalSize=32768, EepWriteTime=0.005, EepPageSize=EepPageSize64  # ST Microelectronics M24256
      STMicroelectronics_ST24C16: EepAllowedWriteCycles=4000000, EepTotalSize=4096, EepWriteTime=0.005, EepPageSize=EepPageSize32  # ST Microelectronics ST24C16
      Atmel_AT24C32: EepAllowedWriteCycles=1000000, EepTotalSize=4096, EepWriteTime=0.01, EepPageSize=EepPageSize32  # Atmel AT24C32
      Atmel_AT24C64: EepAllowedWriteCycles=1000000, EepTotalSize=8192, EepWriteTime=0.01, EepPageSize=EepPageSize32  # Atmel AT24C64
  module config Eep_30_XXi2c01_Rec: definition=Eep, implementation-config-variant=VARIANT-PRE-COMPILE
