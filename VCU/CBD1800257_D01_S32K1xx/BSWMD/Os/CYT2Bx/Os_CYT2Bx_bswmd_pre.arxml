AUTOSAR XML (schema 4-2-1)
package /MICROSAR
  module config Os_Pre: definition=Os
    OsPublishedInformation
      CYT2BX (OsDerivativeInformation):
        OsStackAlignment = 0
        OsExceptionVectorTableAlignment = 0
        OsInterruptVectorTableAlignment = 128
        OsHardwareManuals = ARMv7-M Architecture Reference Manual edition: ARM DDI 0403E.b (ID120114), 02 December 2014 Cortex-M4 Devices Generic User Guide Traveo 2 Automotive Body Controller Entry Family Architecture Technical Reference Manual: 002-19314 Rev.*B, February 2018
        OsMpuAlignment = SIZE
        Core0 (OsPhysicalCore):
          OsPhysicalCoreId = 0
          OsPhysicalCoreExceptionSources = 8
          OsPhysicalCoreIsAutostart = 1
          OsPhysicalCoreMasterStartAllowed = 0
          OsPhysicalCorePrivelegedHwAccess = 1
          OsPhysicalCoreType = Cortex-M
          OsPhysicalCoreDefaultEntrySymbol = _start
          Core0_MPU (OsPhysicalCoreMpu): OsPhysicalCoreMpuId=0, OsPhysicalCoreMpuMaxRegions=8, OsPhysicalCoreMpuType=Cortex-M
          Core0_INTC (OsPhysicalCoreIntCtrl): OsPhysicalCoreIntCtrlMaxPrios=224, OsPhysicalCoreIntCtrlPrioOrder=DESC, OsPhysicalCoreIntCtrlMaxSources=32
            OsPhysicalCoreIntCtrlAddress: OsPhysicalCoreIntCtrlAddressValue=3758153728
        SysTick (OsHardwareTimer): OsHardwareTimerBaseAddress=0, OsHardwareTimerId=0, OsHardwareTimerSize=32, OsHardwareTimerUnit=PIT, OsHardwareTimerType=SysTick
          SysTick_Ch0 (OsHardwareTimerChannel): OsHardwareTimerChannelId=0, OsHardwareTimerChannelIntSource=15, OsHardwareTimerChannelOffset=0
        OsMemoryRegionSpecifics
          10 x OsMemoryRegionAccess:
            SUPERVISOR_R: OsMemoryRegionAccessRights=R, OsMemoryRegionAccessType=SUPERVISOR
            SUPERVISOR_RW: OsMemoryRegionAccessRights=RW, OsMemoryRegionAccessType=SUPERVISOR
            USER_R: OsMemoryRegionAccessRights=R, OsMemoryRegionAccessType=USER
            USER_RW: OsMemoryRegionAccessRights=RW, OsMemoryRegionAccessType=USER
            SUPERVISOR_NONE: OsMemoryRegionAccessRights=NONE, OsMemoryRegionAccessType=SUPERVISOR
            USER_NONE: OsMemoryRegionAccessRights=NONE, OsMemoryRegionAccessType=USER
            SUPERVISOR_RX: OsMemoryRegionAccessRights=RX, OsMemoryRegionAccessType=SUPERVISOR
            SUPERVISOR_RWX: OsMemoryRegionAccessRights=RWX, OsMemoryRegionAccessType=SUPERVISOR
            USER_RX: OsMemoryRegionAccessRights=RX, OsMemoryRegionAccessType=USER
            USER_RWX: OsMemoryRegionAccessRights=RWX, OsMemoryRegionAccessType=USER
          8 x OsMemoryRegionFlag:
            SHAREABLE
            TYPE_STRONGLY_ORDERED
            TYPE_NON_CACHEABLE
            TYPE_CACHEABLE_WRITEBACK_ALLOCATE
            TYPE_SHARED_DEVICE
            TYPE_NON_SHARED_DEVICE
            TYPE_CACHEABLE_WRITETHROUGH_NO_ALLOCATE
            TYPE_CACHEABLE_WRITEBACK_NO_ALLOCATE
        OsMemoryRegionDefaults_AppNT (OsMemoryRegionDefaults):
          OsMemoryRegionDefIdentifier = 1
          OsMemoryRegionDefType = APPLICATION_NONTRUSTED
          OsMemoryRegionDefProtectionUnitSlot = 14
          OsMemoryRegionDefAccessRights = SUPERVISOR_RW
          OsMemoryRegionDefAccessRights = USER_RW
          OsMemoryRegionDefFlags = TYPE_CACHEABLE_WRITEBACK_ALLOCATE
        OsMemoryRegionDefaults_AppT (OsMemoryRegionDefaults):
          OsMemoryRegionDefIdentifier = 1
          OsMemoryRegionDefType = APPLICATION_TRUSTED
          OsMemoryRegionDefProtectionUnitSlot = 14
          OsMemoryRegionDefAccessRights = SUPERVISOR_RW
          OsMemoryRegionDefAccessRights = USER_R
          OsMemoryRegionDefFlags = TYPE_CACHEABLE_WRITEBACK_ALLOCATE
        9 x OsInterruptSupportedType:
          CoreExternalIRQ0: OsInterruptSupportedTypeSeparateSources=0, OsInterruptSupportTypeCoreInterruptSource=16
          CoreExternalIRQ1: OsInterruptSupportedTypeSeparateSources=0, OsInterruptSupportTypeCoreInterruptSource=17
          CoreExternalIRQ2: OsInterruptSupportedTypeSeparateSources=0, OsInterruptSupportTypeCoreInterruptSource=18
          CoreExternalIRQ3: OsInterruptSupportedTypeSeparateSources=0, OsInterruptSupportTypeCoreInterruptSource=19
          CoreExternalIRQ4: OsInterruptSupportedTypeSeparateSources=0, OsInterruptSupportTypeCoreInterruptSource=20
          CoreExternalIRQ5: OsInterruptSupportedTypeSeparateSources=0, OsInterruptSupportTypeCoreInterruptSource=21
          CoreExternalIRQ6: OsInterruptSupportedTypeSeparateSources=0, OsInterruptSupportTypeCoreInterruptSource=22
          CoreExternalIRQ7: OsInterruptSupportedTypeSeparateSources=0, OsInterruptSupportTypeCoreInterruptSource=23
          CoreInternal: OsInterruptSupportedTypeSeparateSources=1
        CPUSS_CM4_SYSTEM (OsSystemIntCtrl):
          OsSystemIntCtrlBaseAddress = 1075879936
          OsSystemIntCtrlMaxPrios = 224
          OsSystemIntCtrlMaxSources = 352
          OsSystemIntCtrlPrioOrder = DESC
          OsSystemIntCtrlType = NVIC_CYT2
          CPUSS_CM4_SYSTEM_INT_STATUS (OsSystemIntCtrlAddress): OsSystemIntCtrlAddressValue=1075839232
