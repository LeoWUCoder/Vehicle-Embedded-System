AUTOSAR XML (schema 4-2-1)
package /MICROSAR
  module config Os_Pre: definition=Os
    OsPublishedInformation
      S32K148 (OsDerivativeInformation):
        OsMpuAlignment = 32
        OsStackAlignment = 32
        OsExceptionVectorTableAlignment = 0
        OsInterruptVectorTableAlignment = 128
        OsHardwareManuals = NXP/Freescale - S32K14x Series Reference Manual - Supports S32K142, S32K144, S32K146, and S32K148 Document Number: S32K14XRM - Rev. 3, 03/2017
        Core0 (OsPhysicalCore):
          OsPhysicalCoreId = 0
          OsPhysicalCoreExceptionSources = 8
          OsPhysicalCoreIsAutostart = 1
          OsPhysicalCoreMasterStartAllowed = 0
          OsPhysicalCorePrivelegedHwAccess = 1
          OsPhysicalCoreType = Cortex-M
          OsPhysicalCoreDefaultEntrySymbol = _start
          OsPhysicalCoreStackProtectionUnit = SystemMPU0
        INTC (OsSystemIntCtrl):
          OsSystemIntCtrlMaxPrios = 224
          OsSystemIntCtrlMaxSources = 240
          OsSystemIntCtrlPrioOrder = DESC
          OsSystemIntCtrlBaseAddress = 3758153728
          OsSystemIntCtrlType = NVIC
        OsMemoryRegionDefaults_AppT (OsMemoryRegionDefaults): OsMemoryRegionDefType=APPLICATION_TRUSTED, OsMemoryRegionDefAccessRights=SUPERVISOR_RWX, OsMemoryRegionDefBusMasters=Core
        OsMemoryRegionDefaults_AppNT (OsMemoryRegionDefaults):
          OsMemoryRegionDefType = APPLICATION_NONTRUSTED
          OsMemoryRegionDefBusMasters = Core
          OsMemoryRegionDefAccessRights = USER_R
          OsMemoryRegionDefAccessRights = USER_W
        OsMemoryRegionSpecifics
          3 x OsMemoryRegionAccess:
            SUPERVISOR_RW: OsMemoryRegionAccessRights=RW, OsMemoryRegionAccessType=SUPERVISOR
            SUPERVISOR_RWX: OsMemoryRegionAccessRights=RWX, OsMemoryRegionAccessType=SUPERVISOR
            USER_W: OsMemoryRegionAccessRights=W, OsMemoryRegionAccessType=USER
          4 x OsMemoryRegionBusMaster:
            Core: OsMemoryRegionBusMasterId=0
            Debugger: OsMemoryRegionBusMasterId=1
            DMA: OsMemoryRegionBusMasterId=2
            ENET: OsMemoryRegionBusMasterId=3
          PID_ENABLE (OsMemoryRegionFlag)
          3 x OsMemoryRegionAccess:
            USER_R: OsMemoryRegionAccessRights=R, OsMemoryRegionAccessType=USER
            USER_X: OsMemoryRegionAccessRights=X, OsMemoryRegionAccessType=USER
            SUPERVISOR_RX: OsMemoryRegionAccessRights=RX, OsMemoryRegionAccessType=SUPERVISOR
        SysTick (OsHardwareTimer): OsHardwareTimerBaseAddress=3758153744, OsHardwareTimerId=0, OsHardwareTimerSize=24, OsHardwareTimerUnit=PIT, OsHardwareTimerType=SysTick
          SysTick_Ch0 (OsHardwareTimerChannel): OsHardwareTimerChannelId=0, OsHardwareTimerChannelIntSource=15, OsHardwareTimerChannelOffset=0
        SystemMPU0 (OsSystemMpu): OsSystemMpuBaseAddress=1073795072, OsSystemMpuId=0, OsSystemMpuMaxRegions=16, OsSystemMpuType=SYSTEM_MPU_NXP
        DEFAULT (OsInterruptSupportedType): OsInterruptSupportedTypeSeparateSources=0
