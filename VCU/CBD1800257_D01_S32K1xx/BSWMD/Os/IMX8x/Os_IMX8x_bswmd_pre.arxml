AUTOSAR XML (schema 4-2-1)
package /MICROSAR
  module config Os_Pre: definition=Os
    OsPublishedInformation
      IMX8x (OsDerivativeInformation):
        OsMpuAlignment = SIZE
        OsStackAlignment = 0
        OsExceptionVectorTableAlignment = 0
        OsInterruptVectorTableAlignment = 128
        OsHardwareManuals = ARMv7-M Architecture Reference Manual edition: ARM DDI 0403E.b (ID120114), 02 December 2014 Cortex-M4 Devices Generic User Guide i.MX 8DualXPlus/8QuadXPlus Applications Processor Reference Manual Document Number: IMX8DQXPRM Rev. B, 5/2018
        Core0 (OsPhysicalCore):
          OsPhysicalCoreId = 0
          OsPhysicalCoreExceptionSources = 8
          OsPhysicalCoreIsAutostart = 1
          OsPhysicalCoreMasterStartAllowed = 0
          OsPhysicalCorePrivelegedHwAccess = 1
          OsPhysicalCoreType = Cortex-M
          OsPhysicalCoreDefaultEntrySymbol = _start
          OsPhysicalCoreStackProtectionUnit = Core0_MPU
          Core0_MPU (OsPhysicalCoreMpu): OsPhysicalCoreMpuMaxRegions=8, OsPhysicalCoreMpuId=0, OsPhysicalCoreMpuType=Cortex-M
          Core0_INTC (OsPhysicalCoreIntCtrl): OsPhysicalCoreIntCtrlMaxPrios=240, OsPhysicalCoreIntCtrlMaxSources=127, OsPhysicalCoreIntCtrlPrioOrder=DESC
            OsPhysicalCoreIntCtrlAddress: OsPhysicalCoreIntCtrlAddressValue=3758153728
        STEER (OsSystemIntCtrl):
          OsSystemIntCtrlMaxPrios = 240
          OsSystemIntCtrlMaxSources = 512
          OsSystemIntCtrlPrioOrder = DESC
          OsSystemIntCtrlBaseAddress = 1359413248
          OsSystemIntCtrlType = NVIC_IMX8
          STEER_CHN_STATUS (OsSystemIntCtrlAddress): OsSystemIntCtrlAddressValue=1359413380
          STEER_CHN_MASK (OsSystemIntCtrlAddress): OsSystemIntCtrlAddressValue=1359413252
        SysTick (OsHardwareTimer): OsHardwareTimerBaseAddress=3758153744, OsHardwareTimerId=0, OsHardwareTimerSize=32, OsHardwareTimerUnit=PIT, OsHardwareTimerType=SysTick
          SysTick_Ch0 (OsHardwareTimerChannel): OsHardwareTimerChannelId=0, OsHardwareTimerChannelIntSource=15, OsHardwareTimerChannelOffset=0
        OsMemoryRegionSpecifics
          10 x OsMemoryRegionAccess:
            SUPERVISOR_R: OsMemoryRegionAccessRights=R, OsMemoryRegionAccessType=SUPERVISOR
            SUPERVISOR_RW: OsMemoryRegionAccessRights=RW, OsMemoryRegionAccessType=SUPERVISOR
            USER_R: OsMemoryRegionAccessRights=R, OsMemoryRegionAccessType=USER
            USER_RW: OsMemoryRegionAccessRights=RW, OsMemoryRegionAccessType=USER
            SUPERVISOR_NONE: OsMemoryRegionAccessRights=NONE, OsMemoryRegionAccessType=SUPERVISOR
            USER_NONE: OsMemoryRegionAccessRights=NONE, OsMemoryRegionAccessType=USER
            SUPERVISOR_RX: OsMemoryRegionAccessRights=RX, OsMemoryRegionAccessType=SUPERVISOR
            SUPERVISOR_RWX: OsMemoryRegionAccessRights=RWX, OsMemoryRegionAccessType=SUPERVISOR
            USER_RX: OsMemoryRegionAccessRights=RX, OsMemoryRegionAccessType=USER
            USER_RWX: OsMemoryRegionAccessRights=RWX, OsMemoryRegionAccessType=USER
          8 x OsMemoryRegionFlag:
            SHAREABLE
            TYPE_STRONGLY_ORDERED
            TYPE_NON_CACHEABLE
            TYPE_CACHEABLE_WRITEBACK_ALLOCATE
            TYPE_SHARED_DEVICE
            TYPE_NON_SHARED_DEVICE
            TYPE_CACHEABLE_WRITETHROUGH_NO_ALLOCATE
            TYPE_CACHEABLE_WRITEBACK_NO_ALLOCATE
        OsMemoryRegionDefaults_AppNT (OsMemoryRegionDefaults):
          OsMemoryRegionDefIdentifier = 1
          OsMemoryRegionDefType = APPLICATION_NONTRUSTED
          OsMemoryRegionDefProtectionUnitSlot = 14
          OsMemoryRegionDefAccessRights = SUPERVISOR_RW
          OsMemoryRegionDefAccessRights = USER_RW
          OsMemoryRegionDefFlags = TYPE_CACHEABLE_WRITEBACK_ALLOCATE
        OsMemoryRegionDefaults_AppT (OsMemoryRegionDefaults):
          OsMemoryRegionDefIdentifier = 1
          OsMemoryRegionDefType = APPLICATION_TRUSTED
          OsMemoryRegionDefProtectionUnitSlot = 14
          OsMemoryRegionDefAccessRights = SUPERVISOR_RW
          OsMemoryRegionDefAccessRights = USER_R
          OsMemoryRegionDefFlags = TYPE_CACHEABLE_WRITEBACK_ALLOCATE
        9 x OsInterruptSupportedType:
          CoreInternal: OsInterruptSupportedTypeSeparateSources=1
          CoreExternalIRQ0: OsInterruptSupportedTypeSeparateSources=0, OsInterruptSupportTypeCoreInterruptSource=48, OsInterruptSupportedTypeMaxSystemSource=63, OsInterruptSupportedTypeMinSystemSource=31
          CoreExternalIRQ1: OsInterruptSupportedTypeSeparateSources=0, OsInterruptSupportTypeCoreInterruptSource=49, OsInterruptSupportedTypeMinSystemSource=64, OsInterruptSupportedTypeMaxSystemSource=127
          CoreExternalIRQ2: OsInterruptSupportedTypeSeparateSources=0, OsInterruptSupportTypeCoreInterruptSource=50, OsInterruptSupportedTypeMaxSystemSource=191, OsInterruptSupportedTypeMinSystemSource=128
          CoreExternalIRQ3: OsInterruptSupportedTypeSeparateSources=0, OsInterruptSupportTypeCoreInterruptSource=51, OsInterruptSupportedTypeMaxSystemSource=255, OsInterruptSupportedTypeMinSystemSource=192
          CoreExternalIRQ4: OsInterruptSupportedTypeSeparateSources=0, OsInterruptSupportTypeCoreInterruptSource=52, OsInterruptSupportedTypeMaxSystemSource=319, OsInterruptSupportedTypeMinSystemSource=256
          CoreExternalIRQ5: OsInterruptSupportedTypeSeparateSources=0, OsInterruptSupportTypeCoreInterruptSource=53, OsInterruptSupportedTypeMaxSystemSource=383, OsInterruptSupportedTypeMinSystemSource=320
          CoreExternalIRQ6: OsInterruptSupportedTypeSeparateSources=0, OsInterruptSupportTypeCoreInterruptSource=54, OsInterruptSupportedTypeMaxSystemSource=447, OsInterruptSupportedTypeMinSystemSource=384
          CoreExternalIRQ7: OsInterruptSupportedTypeSeparateSources=0, OsInterruptSupportTypeCoreInterruptSource=55, OsInterruptSupportedTypeMaxSystemSource=511, OsInterruptSupportedTypeMinSystemSource=448
