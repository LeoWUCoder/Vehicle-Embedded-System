AUTOSAR XML (schema 4-2-1)
package /MICROSAR
  module config Os_Rec: definition=Os
    SystemTimer (OsCounter)
      OsDriver: OsDriverHardwareTimerChannelRef=SysTick_Ch0
    CounterIsr_SystemTimer (OsIsr): OsIsrInterruptPriority=160, OsIsrInterruptMapping=CoreInternal
