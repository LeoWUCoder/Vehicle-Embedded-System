AUTOSAR XML (schema 4-2-1)
package /MICROSAR
  module config Os_Pre: definition=Os
    OsPublishedInformation
      S32x (OsDerivativeInformation):
        OsHardwareManuals = ARMv7-M Architecture Reference Manual edition: ARM DDI 0403E.b (ID120114), 02 December 2014 S32V344 Reference Manual: S32V344RM Rev.1 Draft M, Juni 2018 S32G Reference Manual: S32G275ARM Rev.1 Draft F, May 2018
        OsStackAlignment = 0
        OsExceptionVectorTableAlignment = 0
        OsInterruptVectorTableAlignment = 128
        OsMpuAlignment = SIZE
        Core0 (OsPhysicalCore):
          OsPhysicalCoreId = 4
          OsPhysicalCoreExceptionSources = 8
          OsPhysicalCoreIsAutostart = 1
          OsPhysicalCoreMasterStartAllowed = 0
          OsPhysicalCorePrivelegedHwAccess = 1
          OsPhysicalCoreType = Cortex-M
          OsPhysicalCoreDefaultEntrySymbol = _start
          Core0_MPU (OsPhysicalCoreMpu): OsPhysicalCoreMpuId=0, OsPhysicalCoreMpuMaxRegions=16, OsPhysicalCoreMpuType=Cortex-M
          Core0_INTC (OsPhysicalCoreIntCtrl): OsPhysicalCoreIntCtrlMaxPrios=224, OsPhysicalCoreIntCtrlPrioOrder=DESC, OsPhysicalCoreIntCtrlMaxSources=256
            OsPhysicalCoreIntCtrlAddress: OsPhysicalCoreIntCtrlAddressValue=3758153728
          3 x OsPhysicalCoreAddress:
            RGM_PRST: OsPhysicalCoreAddressValue=1074233408
            RGM_PSTAT: OsPhysicalCoreAddressValue=1074233664
            MC_ME_PRTN0_CORE0: OsPhysicalCoreAddressValue=1074299200
        SysTick_Core0 (OsHardwareTimer): OsHardwareTimerBaseAddress=0, OsHardwareTimerId=0, OsHardwareTimerSize=32, OsHardwareTimerUnit=PIT, OsHardwareTimerType=SysTick
          SysTick_Core0_Ch0 (OsHardwareTimerChannel): OsHardwareTimerChannelId=0, OsHardwareTimerChannelIntSource=15, OsHardwareTimerChannelOffset=0
        OsMemoryRegionSpecifics
          10 x OsMemoryRegionAccess:
            SUPERVISOR_R: OsMemoryRegionAccessRights=R, OsMemoryRegionAccessType=SUPERVISOR
            SUPERVISOR_RW: OsMemoryRegionAccessRights=RW, OsMemoryRegionAccessType=SUPERVISOR
            USER_R: OsMemoryRegionAccessRights=R, OsMemoryRegionAccessType=USER
            USER_RW: OsMemoryRegionAccessRights=RW, OsMemoryRegionAccessType=USER
            SUPERVISOR_NONE: OsMemoryRegionAccessRights=NONE, OsMemoryRegionAccessType=SUPERVISOR
            USER_NONE: OsMemoryRegionAccessRights=NONE, OsMemoryRegionAccessType=USER
            SUPERVISOR_RX: OsMemoryRegionAccessRights=RX, OsMemoryRegionAccessType=SUPERVISOR
            SUPERVISOR_RWX: OsMemoryRegionAccessRights=RWX, OsMemoryRegionAccessType=SUPERVISOR
            USER_RX: OsMemoryRegionAccessRights=RX, OsMemoryRegionAccessType=USER
            USER_RWX: OsMemoryRegionAccessRights=RWX, OsMemoryRegionAccessType=USER
          8 x OsMemoryRegionFlag:
            SHAREABLE
            TYPE_STRONGLY_ORDERED
            TYPE_NON_CACHEABLE
            TYPE_CACHEABLE_WRITEBACK_ALLOCATE
            TYPE_SHARED_DEVICE
            TYPE_NON_SHARED_DEVICE
            TYPE_CACHEABLE_WRITETHROUGH_NO_ALLOCATE
            TYPE_CACHEABLE_WRITEBACK_NO_ALLOCATE
        OsMemoryRegionDefaults_AppNT (OsMemoryRegionDefaults):
          OsMemoryRegionDefIdentifier = 1
          OsMemoryRegionDefType = APPLICATION_NONTRUSTED
          OsMemoryRegionDefProtectionUnitSlot = 14
          OsMemoryRegionDefAccessRights = SUPERVISOR_RW
          OsMemoryRegionDefAccessRights = USER_RW
          OsMemoryRegionDefFlags = TYPE_CACHEABLE_WRITEBACK_ALLOCATE
        OsMemoryRegionDefaults_AppT (OsMemoryRegionDefaults):
          OsMemoryRegionDefIdentifier = 1
          OsMemoryRegionDefType = APPLICATION_TRUSTED
          OsMemoryRegionDefProtectionUnitSlot = 14
          OsMemoryRegionDefAccessRights = SUPERVISOR_RW
          OsMemoryRegionDefAccessRights = USER_R
          OsMemoryRegionDefFlags = TYPE_CACHEABLE_WRITEBACK_ALLOCATE
        MSCM (OsSystemIntCtrl):
          OsSystemIntCtrlBaseAddress = 1075412992
          OsSystemIntCtrlMaxPrios = 224
          OsSystemIntCtrlMaxSources = 240
          OsSystemIntCtrlPrioOrder = DESC
          OsSystemIntCtrlType = NVIC_S32
          MSCM_IRSPRC (OsSystemIntCtrlAddress): OsSystemIntCtrlAddressValue=1075415168
        DEFAULT (OsInterruptSupportedType): OsInterruptSupportedTypeSeparateSources=0
        Core1 (OsPhysicalCore):
          OsPhysicalCoreId = 5
          OsPhysicalCoreType = Cortex-M
          OsPhysicalCoreExceptionSources = 8
          OsPhysicalCoreIsAutostart = 0
          OsPhysicalCoreMasterStartAllowed = 0
          OsPhysicalCorePrivelegedHwAccess = 0
          OsPhysicalCoreDefaultEntrySymbol = _start
          Core1_MPU (OsPhysicalCoreMpu): OsPhysicalCoreMpuId=1, OsPhysicalCoreMpuType=Cortex-M, OsPhysicalCoreMpuMaxRegions=16
          Core1_INTC (OsPhysicalCoreIntCtrl): OsPhysicalCoreIntCtrlMaxPrios=224, OsPhysicalCoreIntCtrlMaxSources=256, OsPhysicalCoreIntCtrlPrioOrder=DESC
            OsPhysicalCoreIntCtrlAddress: OsPhysicalCoreIntCtrlAddressValue=3758153728
          MC_ME_PRTN0_CORE1 (OsPhysicalCoreAddress): OsPhysicalCoreAddressValue=1074299232
        Core2 (OsPhysicalCore):
          OsPhysicalCoreId = 6
          OsPhysicalCoreType = Cortex-M
          OsPhysicalCoreExceptionSources = 8
          OsPhysicalCoreIsAutostart = 0
          OsPhysicalCoreMasterStartAllowed = 0
          OsPhysicalCorePrivelegedHwAccess = 0
          OsPhysicalCoreDefaultEntrySymbol = _start
          Core2_INTC (OsPhysicalCoreIntCtrl): OsPhysicalCoreIntCtrlMaxPrios=224, OsPhysicalCoreIntCtrlMaxSources=256, OsPhysicalCoreIntCtrlPrioOrder=DESC
            OsPhysicalCoreIntCtrlAddress: OsPhysicalCoreIntCtrlAddressValue=3758153728
          Core2_MPU (OsPhysicalCoreMpu): OsPhysicalCoreMpuId=2, OsPhysicalCoreMpuType=Cortex-M, OsPhysicalCoreMpuMaxRegions=16
          MC_ME_PRTN0_CORE2 (OsPhysicalCoreAddress): OsPhysicalCoreAddressValue=1074299264
        SysTick_Core1 (OsHardwareTimer): OsHardwareTimerBaseAddress=0, OsHardwareTimerId=1, OsHardwareTimerSize=32, OsHardwareTimerUnit=PIT, OsHardwareTimerType=SysTick
          SysTick_Core1_Ch0 (OsHardwareTimerChannel): OsHardwareTimerChannelId=0, OsHardwareTimerChannelIntSource=15, OsHardwareTimerChannelOffset=0
        SysTick_Core2 (OsHardwareTimer): OsHardwareTimerBaseAddress=0, OsHardwareTimerId=2, OsHardwareTimerSize=32, OsHardwareTimerUnit=PIT, OsHardwareTimerType=SysTick
          SysTick_Core2_Ch0 (OsHardwareTimerChannel): OsHardwareTimerChannelId=0, OsHardwareTimerChannelIntSource=15, OsHardwareTimerChannelOffset=0
