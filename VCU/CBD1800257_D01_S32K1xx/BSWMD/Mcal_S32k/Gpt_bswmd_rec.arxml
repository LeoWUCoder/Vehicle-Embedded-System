AUTOSAR XML (schema 4.0)
package /TS_T40D2M10I1R0
  module config Gpt_Rec: definition=Gpt
  bsw implementation Gpt_Impl: programming-language=C, used-code-generator=Tresos, behavior=GptBehavior, recommended-configuration=Gpt_Rec, vendor-specific-module-def=Gpt
