AUTOSAR XML (schema 4.0)
package /TS_T40D2M10I1R0
  module config Mcl_Rec: definition=Mcl
  bsw implementation Mcl_Impl: programming-language=C, used-code-generator=Tresos, behavior=MclBehavior, recommended-configuration=Mcl_Rec, vendor-specific-module-def=Mcl
