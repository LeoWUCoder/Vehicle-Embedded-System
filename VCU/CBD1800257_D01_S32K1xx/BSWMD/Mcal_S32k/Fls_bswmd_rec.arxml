AUTOSAR XML (schema 4.0)
package /TS_T40D2M10I1R0
  module config Fls_Rec: definition=Fls
  bsw implementation Fls_Impl: programming-language=C, behavior=FlsBehavior, recommended-configuration=Fls_Rec, vendor-specific-module-def=Fls
