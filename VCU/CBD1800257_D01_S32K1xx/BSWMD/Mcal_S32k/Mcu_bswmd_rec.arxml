AUTOSAR XML (schema 4.0)
package /TS_T40D2M10I1R0
  module config Mcu_Rec: definition=Mcu
    McuGeneralConfiguration: McuNoPll=0
  bsw implementation Mcu_Impl: programming-language=C, used-code-generator=Tresos, behavior=McuBehavior, recommended-configuration=Mcu_Rec, vendor-specific-module-def=Mcu
