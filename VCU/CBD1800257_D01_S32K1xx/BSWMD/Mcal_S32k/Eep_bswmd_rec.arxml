AUTOSAR XML (schema 4.0)
package /TS_T40D2M10I1R0
  module config Eep_Rec: definition=Eep
  bsw implementation Eep_Impl: programming-language=C, behavior=EepBehavior, recommended-configuration=Eep_Rec, vendor-specific-module-def=Eep
