AUTOSAR XML (schema 4.0)
package /TS_T40D2M10I1R0
  module config Csec_Rec: definition=Csec
  bsw implementation Csec_Impl: programming-language=C, behavior=CsecBehavior, recommended-configuration=Csec_Rec, vendor-specific-module-def=Csec
