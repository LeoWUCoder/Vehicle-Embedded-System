AUTOSAR XML (schema 4.0)
package /TS_T40D2M10I1R0
  module config Wdg_Rec: definition=Wdg
  bsw implementation Wdg_Impl: programming-language=C, behavior=WdgBehavior, recommended-configuration=Wdg_Rec, vendor-specific-module-def=Wdg
