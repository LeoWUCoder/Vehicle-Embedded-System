AUTOSAR XML (schema 4.0)
package /TS_T40D2M10I1R0
  module config Ocu_Rec: definition=Ocu
  bsw implementation Ocu_Impl: programming-language=C, behavior=OcuBehavior, recommended-configuration=Ocu_Rec, vendor-specific-module-def=Ocu
