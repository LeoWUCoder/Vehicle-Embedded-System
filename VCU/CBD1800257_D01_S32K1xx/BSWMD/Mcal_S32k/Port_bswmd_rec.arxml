AUTOSAR XML (schema 4.0)
package /TS_T40D2M10I1R0
  module config Port_Rec: definition=Port
  bsw implementation Port_Impl: programming-language=C, used-code-generator=Tresos, behavior=PortBehavior, recommended-configuration=Port_Rec, vendor-specific-module-def=Port
