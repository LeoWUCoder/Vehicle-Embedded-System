AUTOSAR XML (schema 4.0)
package /TS_T40D2M10I1R0
  module config Mcem_Rec: definition=Mcem
  bsw implementation Mcem_Impl: programming-language=C, used-code-generator=Tresos, behavior=McemBehavior, recommended-configuration=Mcem_Rec, vendor-specific-module-def=Mcem
