AUTOSAR XML (schema 4-0-3)
package /MICROSAR
  module config NmOsek_Rec: definition=NmOsek
  module config NmOsek_Rec_Class1: definition=NmOsek
    NmOsekGlobalConfig: NmOsekBusOffNotificationEnabled=1, NmOsekType=NMOSEK_TYPE_VECTOR_OSEK
