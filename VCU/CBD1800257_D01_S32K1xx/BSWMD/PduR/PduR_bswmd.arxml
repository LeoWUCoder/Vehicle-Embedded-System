AUTOSAR XML (schema 4-0-3)
package /MICROSAR
  bsw implementation PduR_Impl: programming-language=C, sw-version=12.03.00, used-code-generator=DaVinci Configurator, vendor-id=30, ar-release-version=4.01.02, behavior=PduRBehavior, preconfigured-configuration=PduR_Pre, recommended-configuration=PduR_Rec, vendor-specific-module-def=PduR
  module definition PduR [0..1]: category=VENDOR_SPECIFIC_MODULE_DEFINITION, refined-module-def=PduR, variants pre-compile/post-build-loadable/post-build-selectable  # Configuration of the PDUR (PDU Router) module.
    container PduRBswModules [1..*]  # Each container describes a specific BSW module that the PDU Router shall interface to. All interfacing modules (below and above the PDUR) including their API requirements need to be configured explicitly. The name of the container defines the module name that will be used to derive the API names from.
      boolean PduRCancelReceive: set at pre-compile, default-value=false  # Specifies if the transport protocol BSW module supports the CancelReceive API or not. The API allows to cancel an ongoing transport protocol reception. Value true means that the BSW module supports the CancelReceive interface which an upper layer module can call and also that it can call the CancelReceive interface of a lower layer module. Value false means that the BSW module does not support the CancelReceive interface which an upper layer module can call and also that it shall not call the CancelReceive interface of a lower layer module.
      boolean PduRCancelTransmit: set at pre-compile, default-value=false  # Specifies if the BSW module supports the CancelTransmit API or not. The API allows to cancel an ongoing transport protocol transmission. Value true means that the BSW module supports the CancelTransmit interface which an upper layer module can call and also that it can call the CancelTransmit interface of a lower layer module. Value false means that the BSW module does not support the CancelTransmit interface which an upper layer module can call and also that it shall not call the CancelTransmit interface of a lower layer module.
      boolean PduRChangeParameterRequestApi: set at pre-compile, default-value=false  # Specifies if the transport protocol BSW module supports the ChangeParameter API or not. The API allows to change transport protocol parameters like BS or STmin. Value true means that the BSW module supports the ChangeParameter interface which an upper layer module can call and also that it can call the ChangeParameter interface of a lower layer module. Value false means that the BSW module does not support the ChangeParameter interface which an upper layer module can call and also that it shall not call the ChangeParameter interface of a lower layer module.
      boolean PduRCommunicationInterface: set at pre-compile, default-value=false  # Specifies if the BSW module supports the communication interface APIs or not. A module can have both APIs, communication interface and transport protocol (e.g. the Com module). Value true means that the BSW module supports the communication interface APIs. Value false means that the BSW module does not support the communication interface APIs.
      boolean PduRLowerModule: set at pre-compile, default-value=false  # Specifies who will call the BSW module APIs and who will implement the called APIs. An upper module can also be an lower module (e.g. the IpduM module). For example, if the CanIf module is referenced then the PduR module will implement the PduR_CanIfRxIndication API. And the PduR module will call the CanIf_Transmit API.
      boolean PduRRetransmission [0..0]: set at pre-compile, default-value=false  # Specifies if the destination transport protocol BSW module supports the the retransmission feature. This parameter might be set to false if the retransmission feature is not used, even though the destination transport protocol is supporting it. This parameter is not used by the PduR. This featue is not supported.
      boolean PduRTransportProtocol: set at pre-compile, default-value=false  # Specifies if the BSW module supports the transport protocol APIs or not. Value true means that the BSW module supports the transport protocol APIs. Value false means that the BSW module does not support the transport protocol APIs.
      boolean PduRTriggertransmit: set at pre-compile, default-value=false  # Specifies if the BSW module supports the TriggerTransmit API or not. Value true means that the BSW module supports the TriggerTransmit interface which a lower layer module can call and also that it can call the TriggerTransmit interface of an upper layer module. Value false means that the BSW module does not support the TriggerTransmit interface which a lower layer module can call and also that it shall not call the TriggerTransmit interface of an upper layer module.
      boolean PduRTxConfirmation: set at pre-compile, default-value=false  # Specifies if the transport protocol BSW module supports the TxConfirmation API or not. Value true means that the BSW module supports the TxConfirmation interface which a lower layer module can call and also that it can call the TxConfirmation interface of an upper layer module. Value false means that the BSW module does not support the TxConfirmation interface which a lower layer module can call and also that it shall not call the TxConfirmation interface of an upper layer module.
      boolean PduRUpperModule: set at pre-compile, default-value=false  # Specifies who will call the BSW module APIs and who will implement the called APIs. An upper module can also be an lower module (e.g. the IpduM module). For example, if the Com module is referenced then the PduR module will implement the PduR_Transmit API. And the PduR module will call the Com_RxIndication API. Other APIs are of course also covered.
      boolean PduRUseTag: set at pre-compile, default-value=false  # True enables the usage of the tag "<Up>" in the following API calls: - PduR_<Up>CancelReceive - PduR_<Up>CancelTransmit - PduR_<Up>ChangeParameter Example: If used by Com and the parameter is enabled the PduR_ComCancelTransmit is used. The background is that upper layer modules differ in usage of this tag (e.g. Com is using the tag, Dcm is not).
      foreign reference PduRBswModuleRef: set at pre-compile, destination-type=ECUC-MODULE-CONFIGURATION-VALUES  # Reference to the BSW module's configuration.
      reference PduROsApplicationRef [0..1]: set at pre-compile, origin=MICROSAR, destination=OsApplication  # Reference to an Os Application which is mapped to a certain core.
    container PduRGeneral  # Contains the general configuration parameters of the module PduR.
      boolean PduRDevErrorDetect: set at pre-compile, default-value=true  # This parameter switches the Development Error Detection and Notification ON or OFF. true: Development error detection is enabled. false: Development error detection is disabled. Note: In general, the development error detection is recommended during pre-test phase. It is not recommended to enable the development error detection in production code due to increased runtime and ROM needs.
      boolean PduRVersionInfoApi: set at pre-compile, default-value=false  # This parameter enables/disables the function PduR_GetVersionInfo() to get major, minor and patch version information.
      boolean PduRZeroCostOperation [0..1]: set at pre-compile, default-value=false  # If set the PduR configuration generator will report an error if zero-cost-operation cannot be fulfilled. This parameter is not used by the PduR. This featue is not supported.
      string PduRUserConfigurationFile [0..1]: set at pre-compile, origin=Vector Informatik  # Reference to an external text file that will be included during generation to PduR_Cfg.h The content of the user configuration file will be added at the end of the generated module configuration file and allows altering or extending the generated code. Caution: User configuration files can cause the software module to malfunction and must only be used with great care!
      boolean PduRMetaDataSupport: set at pre-compile, origin=Vector Informatik, default-value=false  # If aTransport protocol Protocol use MetaData enable this switch. The size of the MetaData is defined by the configuration parameter MetaDataLength of the global PDU definitions.To route MetaData in case of a Interface routings the switch must not be enabled.
      boolean PduRPduCallback: set at pre-compile, origin=Vector Informatik, default-value=false  # This parameter activates / deactivates Pdu callbacks. The activation of routing path specific BswM callbacks is done by BswM mode request source references.
      boolean PduRSwitching: set at pre-compile, origin=Vector Informatik, default-value=false  # The PduR switching functionality can be used to dynamically learn the destination of routing paths. This will be done using the contents of the Pdu metadata. For a detailed description of this feature see the PduR technical reference. This parameter activates / deactivates the switching functionality. The configuration of the switching behavior is done by the PduRDataPlane configuration structure.
      boolean PduR_QueueOverflowNotification [0..1]: set at pre-compile, origin=Vector Informatik, default-value=false  # This parameter activates / deactivates a PduR InterfaceTxBuffer overflow notification. The PduR_ErrorNotification.h and _PduR_ErrorNotification.c (the C- file is a template) is generated by the PduR if the "PduR Queue Overflow Notification" is enabled. This header must be included and the function must be implemented. Backround: In case of a communication interface routing with unfavourable FIFO configuration or if the destination bus is not available a buffer overflow can occurs. In this case the FIFO is flushed. Caution: The function is called in the interrupt context
      string PduR_ErrorNotificationModuleName [0..1]: set at pre-compile, origin=Vector Informatik, default-value=ErrorNotification  # Error Notification Module Name | If the PduR_QueueOverflowNotification is enabled the parameter can be used to set an individual error notification module name. The header file name is <Prefix>_Cbk.h. The default prefix is "ErrorNotification"
      boolean PduRSafeBswChecks: set at pre-compile, origin=Vector Informatik, default-value=false  # Selects if safety checks are used. These checks improve robustness as e.g. invalid parameters are checked before function is executed. This attribute has to be enabled for safety projects where this component is mapped to an ASIL partition.
      float PduRMainFunctionPeriod [0..1]: 0..0.255, set at pre-compile, origin=Vector Informatik, default-value=0.01  # Allow to configure the time for the MainFunction (as float in seconds).
      boolean PduREnableDeferredTransmission: set at pre-compile, origin=Vector Informatik, default-value=false  # Enables that the deferred transmission can be used.
      boolean PduREnableDeferredReception: set at pre-compile, origin=Vector Informatik, default-value=false  # Enables that the deferred reception can be used.
      boolean PduRSupportMulticore: set at pre-compile, origin=Vector Informatik, default-value=false  # Enable, if multicore capabilities are required.
      integer PduRMulticoreQueueSize [0..1]: 1..4294967295, set at pre-compile, origin=Vector Informatik  # Size of the multicore Queue which is used to perform the routing of unbuffered communication interface routings between different cores. The size is used per Core.
      integer PduRDeferredEventCacheSize [0..1]: 1..65535, set at pre-compile, origin=Vector Informatik  # Size of the Deferred Event Cache. It caches the handle Ids of Deferred routing paths which then will be processed in the next MainFunction. The size is used per Core. The size corresponds to the amount of deferred events which can be cached.
      container PduRGeneration  # Contains the generation configuration parameters of the module PduR.
        enumeration PduROutOfBoundsWriteProtectionStrategy: set at pre-compile, origin=Vector Informatik, default-value=NONE  # This parameter is used to configure a strategy to protect the code to write out of bounds. NONE: no protection strategy is generated in the data access. INDEX_SATURATION: arrays are blown up and the data access index is saturated by an appropriate mask. The advantage is the speed of the data access, but own data elements at other indexes of the same variable can be overridden. This debugging feature must not be used in production code! INDEX_CHECKING: the data access index is validated by a runtime check. The advantage is that values are never written to incorrect indexes of the data access. This debugging feature must not be used in production code!
          NONE  # none
          INDEX_SATURATION  # index saturation
          INDEX_CHECKING  # index checking
        boolean PduROutOfBoundsWriteSanitizer: set at pre-compile, origin=Vector Informatik, default-value=false  # This parameter activates/deactivates the generation of runtime checks which call a DET error notification function to find easily out of bounds write problems. This debugging feature must not be used in production code! FALSE: no checks are generated in the data access. TRUE: the data access is enriched with DET checks to validate indexes.
        boolean PduROutOfBoundsReadSanitizer: set at pre-compile, origin=Vector Informatik, default-value=false  # This parameter activates/deactivates the generation of runtime checks which call a DET error notification function to find easily out of bounds read problems. This debugging feature must not be used in production code! FALSE: no checks are generated in the data access. TRUE: the data access is enriched with DET checks to validate indexes.
        enumeration PduRNumericalDataTypeMinimizationStrategy: set at pre-compile, origin=Vector Informatik, default-value=WITH_CAST  # This parameter is used to minimize the datatypes of CONFIG-CLASS PRE-COMPILE numerical data based on the used values. NONE: the datatype is not minimized. WITHOUT_CAST: the datatype of numerical data is minimized. Unsigned data types are not changed to signed datatypes. WITH_CAST: the datatype of numerical data is minimized. Unsigned data types can be optimized to signed datatypes.
          NONE  # none
          WITHOUT_CAST  # without cast
          WITH_CAST  # with cast
        boolean PduRReduceConstantData2Define: set at pre-compile, origin=Vector Informatik, default-value=false  # Reduce Constant Data To a Define | This parameter activates/deactivates the capability to generate CONFIG-CLASS PRE-COMPILE ROM arrays as constant define. FALSE: ROM arrays are generated as data even if all values are identical. TRUE: ROM arrays are generated as constant define if all values are identical.
        enumeration PduRBoolDataInArrayOfStructStrategy: set at pre-compile, origin=Vector Informatik, default-value=BITMASKING  # This parameter is used to tailor the usage of boolean data in structures in all CONFIG-CLASSES. The difference between BITFIELD and BITMASKING depends on your compiler options and memory mapping. BOOLEAN: The datatype of boolean data is native boolean. Code: the code size is small. RAM: no change expected. ROM: the ROM size is large. Runtime: the runtime is fast. BITFIELD: The bitfield type is used and the compiler extracts the boolean data from structures. Code: the code size is larger than using BOOLEAN. RAM: no change expected. ROM: the ROM size is smaller than using BOOLEAN. Runtime: the runtime is larger than using BOOLEAN. BITMASKING: Generated Masks are used to extract the boolean data from structures. Code: the code size is larger than using BOOLEAN. RAM: no change expected. ROM: the ROM size is smaller than using BOOLEAN. Runtime: the runtime is larger than using BOOLEAN.
          BOOLEAN  # boolean
          BITFIELD  # bitfield
          BITMASKING  # bitmasking
        boolean PduRDeduplicateIndirectedData: set at pre-compile, origin=Vector Informatik, default-value=true  # This parameter activates/deactivates the capability to compress 0:N relational ROM data in all CONFIG-CLASSES without increasing the runtime. This option can be used in lib builds and in postbuild configurations. TRUE: 0:N relational ROM data is compressed without decreasing the runtime. Code: no change expected. RAM: no change expected. ROM: the ROM size is minimized. Runtime: no change expected. FALSE: 0:N relational ROM data is not compressed.
        enumeration PduRDataDeduplicationStrategy: set at pre-compile, origin=Vector Informatik, default-value=WITH_CAST  # This parameter is used to deduplicate CONFIG-CLASS PRE-COMPILE ROM data. NONE: The generated data is not deduplicated. WITHOUT_CAST: The data is deduplicated without using casts. Code: no change expected. RAM: no change expected. ROM: the ROM size can be minimized. Runtime: no change expected. WITH_CAST: The data is deduplicated using casts. Code: no change expected. RAM: no change expected. ROM: the ROM size can be minimized more than in DEDUPLICATE_CONST_DATA_WITHOUT_CAST. Runtime: no change expected.
          NONE  # none
          WITHOUT_CAST  # without cast
          WITH_CAST  # with cast
        integer PduRReduceBoolDataByNegationThreshold: 0..9223372036854775807, set at pre-compile, origin=Vector Informatik, default-value=2  # This parameter activates/deactivates the capability to compress boolean CONFIG-CLASS PRE-COMPILE ROM data by using the negation operator. 0: The optimization is deactivated. >0: If the number of deduplicateable elements is greater than this threshold the data optimization can be performed. Code: the code size is increased due to the usage of the negation operator in the data access. RAM: no change expected. ROM: the ROM size is minimized. Runtime: the runtime is increased due to the usage of the negation operator in the data access.
        integer PduRReduceBoolDataByNumericalComparisonThreshold: 0..9223372036854775807, set at pre-compile, origin=Vector Informatik, default-value=2  # This parameter activates/deactivates the capability to compress boolean CONFIG-CLASS PRE-COMPILE ROM data by using numerical comparison with other ROM data. 0: The optimization is deactivated. >0: If the number of deduplicateable elements is greater than this threshold the data optimization can be performed. Code: the code size is increased due to the usage of the operation in the data access. RAM: no change expected. ROM: the ROM size is minimized. Runtime: the runtime is increased due to the usage of the operation in the data access.
        integer PduRReduceBoolDataByNumericalRelationThreshold: 0..9223372036854775807, set at pre-compile, origin=Vector Informatik, default-value=2  # This parameter activates/deactivates the capability to compress boolean CONFIG-CLASS PRE-COMPILE ROM data by using relational comparison with other ROM data. 0: The optimization is deactivated. >0: If the number of deduplicateable elements is greater than this threshold the data optimization can be performed. Code: the code size is increased due to the usage of the operation in the data access. RAM: no change expected. ROM: the ROM size is minimized. Runtime: the runtime is increased due to the usage of the operation in the data access.
        enumeration PduRReduceBoolDataByNumericalOperandStrategy: set at pre-compile, origin=Vector Informatik, default-value=WITH_ANY_VALUE  # This parameter is used to taylor the CONFIG-CLASS PRE-COMPILE ROM data deduplication mechaisms. A comparison with 0 is very efficient, but a numerical comparison with a value not 0 can be used to increase the ROM data compression rate. NONE: ROM data deduplications are switched off. Code: the code size is small. RAM: no change expected. ROM: the ROM size is large. Runtime: the runtime is fast. WITH_ZERO: ROM data deduplications can be applied with the value 0. Code: the code size is larger than using NONE RAM: no change expected. ROM: the ROM size is smaller than using NONE. Runtime: the runtime is larger than using NONE. WITH_ANY_VALUE: ROM data deduplications can be applied with any numerical value. Code: the code size is larger than using NONE RAM: no change expected. ROM: the ROM size is smaller than using DEDUPLICATE_DATA_WITH_ZERO. Runtime: the runtime is larger than using NONE.
          NONE  # none
          WITH_ZERO  # with 0
          WITH_ANY_VALUE  # with any value
        integer PduRReduceNumericalDataByOffsetThreshold: 0..9223372036854775807, set at pre-compile, origin=Vector Informatik, default-value=2  # This parameter activates/deactivates the capability to compress numerical CONFIG-CLASS PRE-COMPILE ROM data by using a constant offset. 0: The optimization is not performed. >0: This is the threshold to activate the data optimization. Code: the code size is increased due to the usage of the constant offset operation in the data access. RAM: no change expected. ROM: the ROM size is minimized. Runtime: the runtime is increased due to the usage of the constant offset operation in the data access.
        integer PduRReduceNumericalDataByArraySubtractionThreshold: 0..9223372036854775807, set at pre-compile, origin=Vector Informatik, default-value=2  # This parameter activates/deactivates the capability to compress numerical CONFIG-CLASS PRE-COMPILE ROM data by using a sutraction with other ROM data. 0: The optimization is not performed. >0: This is the threshold to activate the data optimization. Code: the code size is increased due to the usage of the operation in the data access. RAM: no change expected. ROM: the ROM size is minimized. Runtime: the runtime is increased due to the usage of the operation in the data access.
        boolean PduRReduceDataByStreaming: set at pre-compile, origin=Vector Informatik, default-value=false  # This parameter activates/deactivates the capability to pack generated CONFIG-CLASS PRE-COMPILE ROM data into a data type dependent stream. TRUE: generated const data is packed into a data type dependent stream. Code: no change expected. RAM: no change expected. ROM: configuration dependent smaller than with FALSE. Runtime: no change expected. FALSE: generated const data is not packed into a data type dependent stream.
        boolean PduRShortSymbols: set at pre-compile, origin=Vector Informatik, default-value=false  # This parameter activates/deactivates the capability to generate shortened symbol names. FALSE: symbol names are generated in a human readable style based on the MIP, tags and variant names. TRUE: symbol names are generated based on the MIP and a CRC32.
        boolean PduRInterfacesForDeactivatedData: set at pre-compile, origin=Vector Informatik, default-value=false  # This parameter activates/deactivates the capability to generate bsw data interfaces for deactivated data elements. This is an advantage for the BSW developer to reduce the time to market with a development environment using auto completition and to investigate potential interfaces. FALSE: data interfaces are not generated if the data elementis deactivated. TRUE: data interfaces are generated as e.g. emty macros.
        boolean PduRReferringKeysInComments: set at pre-compile, origin=Vector Informatik, default-value=false  # This parameter activates/deactivates the capability to generate referring keys in comments. This is an advantage for the developer to investigate indirections, but this feature reduces the overall readability of the generated data. FALSE: referring keys are not generated in comments. TRUE: referring keys are generated in comments.
    container PduRRoutingTables  # This container groups multiple configuration containers that can be used to create several routing tables in the same configuration. This is mainly used for post-build (e.g. post-build selectable) but can be used by pre-compile and link-time for variant handling.
      integer PduRConfigurationId: 0..65535, set at post-build in variant post-build-loadable+post-build-selectable / pre-compile in variant pre-compile, default-value=0  # Identification of the configuration of the PDUR configuration.This identification can be read using the PduR API (PduR_GetConfigurationId).
      container PduRRoutingPathGroup [0..*]: post-build-changeable=true  # A routing path group is a group of I-PDUs that can be disabled and enabled during runtime. The group contains the destination I-PDUs and not the routing path itself. The reason is that it is desirable to enable disable I-PDUs for a specific bus. And a routing path can multicast an I-PDU to several busses. Enabling and disabling of routing path groups is typically used by the BswM module.
        boolean PduRIsEnabledAtInit: set at post-build in variant post-build-loadable+post-build-selectable / pre-compile in variant pre-compile, default-value=false  # If set to true this routing path group will be enabled after initializing the PDU Router module (i.e. enabled in the PduR_Init function). If set to false the routing path group will be disabled after initializing the PDU Router module
        integer PduRRoutingPathGroupId: 0..65535, set at pre-compile, symbolic-name-value=true, default-value=0  # Identification of the routing group.This numerical Identifier will be calculate automatically. Use the generated symbolic value to enable/disable the group.
        reference PduRDestPduRef [1..*]: set at post-build in variant post-build-loadable+post-build-selectable / pre-compile in variant pre-compile, destination=PduRDestPdu  # The destination reference of the routing path which should be enable or disable.
      container PduRRoutingTable  # Contains routing path containers
        boolean PduRIsMinimumRouting [0..0]: set at pre-compile, default-value=false  # This parameter is not used by the PduR. This featue is not supported.
        container PduRRoutingPath [0..*]: post-build-changeable=true  # This container contains the routing pathways.
          enumeration PduRRoutingPathCommunicationType: {COMMUNICATION_INTERFACE, TRANSPORT_PROTOCOL, UNDEFINED}, set at post-build in variant post-build-loadable+post-build-selectable / pre-compile in variant pre-compile, origin=Vector Informatik, default-value=UNDEFINED  # PduR routing path communication type. The communication type determines the used API type of the routing path: COMMUNICATION_INTERFACE: Unsegmented Pdus. TRANSPORT_PROTOCOL: Segmented Pdus UNDEFINED: The communication type cannot be determined.
          boolean PduRMulticoreRoutingPath [0..1]: set at post-build in variant post-build-loadable+post-build-selectable / pre-compile in variant pre-compile, origin=MICROSAR  # This parameter is enabled, if cross-core routing is required. HINT: This is a read-only derived parameter and shall never be modified manually.
          reference PduRLockRef: set at post-build in variant post-build-loadable+post-build-selectable / pre-compile in variant pre-compile, origin=MICROSAR, destination=PduRLock  # Reference to a PduRLock.
          container PduRDestPdu [1..*]: post-build-changeable=true  # This container specifies one destination for the PDU to be routed.
            enumeration PduRDestPduDataProvision [0..1]: {PDUR_DIRECT, PDUR_TRIGGERTRANSMIT}, set at post-build in variant post-build-loadable+post-build-selectable / pre-compile in variant pre-compile  # Specifies how data are provided: direct (as part of the Transmit call) or via the TriggerTransmit callback function after the transmission request. Only required for non-TP I-PDUs (local destinations and gateway destinations).
            integer PduRDestPduHandleId: 0..65535, set at pre-compile, symbolic-name-value=true, default-value=0  # PDU identifier assigned by PDU Router. Used by communication interface and transport protocol modules for confirmation and trigger transmit API calls
            integer PduRTpThreshold [0..1]: 0..65535, set at post-build in variant post-build-loadable+post-build-selectable / pre-compile in variant pre-compile  # Defines the number of bytes which shall be received before transmission on the destination bus may start. Only required for routing-on-the-fly TP gateway PDUs. The threshold shall not be larger than the length of the largest TP Buffer.
            boolean PduRTransmissionConfirmation [0..1]: set at pre-compile, default-value=true  # Specifies if the destination BSW module will call the TxConfirmation API. This parameter is only used for communication interface routing paths. Transport protocol modules will always call the TxConfirmation API.
            enumeration PduRDestPduDirection: {RECEIVE, TRANSMIT, UNDEFINED}, set at post-build in variant post-build-loadable+post-build-selectable / pre-compile in variant pre-compile, origin=Vector Informatik, default-value=UNDEFINED  # PduR routing path destination Pdu communication direction. RECEIVE: The routing path destination is a reception Pdu. TRANSMIT: The routing path destination is a transmission Pdu. UNDEFINED: The communication direction cannot be determined.
            enumeration PduRDestPduRoutingType: {API_FORWARDING, GATEWAY_ROUTING, UNDEFINED}, set at post-build in variant post-build-loadable+post-build-selectable / pre-compile in variant pre-compile, origin=Vector Informatik, default-value=UNDEFINED  # PduR routing path destination Pdu routing type. The routing type determines the routing operation mode of the routing path: API_FORWARDING: Routing between a lower layer and an upper layer module. GATEWAY_ROUTING: Routing between a lower layer module(s). UNDEFINED: The routing type cannot be determined.
            integer PduRDestPduQueueDepth [0..1]: 1..65535, set at post-build in variant post-build-loadable+post-build-selectable / pre-compile in variant pre-compile, origin=Vector Informatik, default-value=2  # Routing path queue depth. The queue depth defines the maximum amount of queued elements in the routing buffer.
            enumeration PduRDestPduDataProcessing: {DEFERRED, IMMEDIATE}, set at post-build in variant post-build-loadable+post-build-selectable / pre-compile in variant pre-compile, origin=Vector Informatik, default-value=IMMEDIATE  # This option determines in which context the routing to the destination module is performed. IMMEDIATE: The routing is performed in either transmit or indication function. DEFERRED: The routing is performed in the context of a main function.
            enumeration PduRPduLengthHandlingStrategy: {UNUSED, SHORTEN, DISCARD}, set at post-build in variant post-build-loadable+post-build-selectable / pre-compile in variant pre-compile, origin=Vector Informatik, default-value=UNUSED  # This parameter is only used for communication interface routings. It is ignored for transport protocol routings. UNUSED: use this value for Tp routing paths or unbuffered If routing paths SHORTEN: the If Pdu is shortened to the configured global Pdu length if a larger Pdu is received at the source (default value from previous PduR versions) DISCARD: the If Pdu is discarded if a larger Pdu than configured is received at the source
            reference PduRDestPduRef: set at pre-compile, destination=Pdu  # This reference selects a destination of the routing path.
            reference PduRDestTxBufferRef [0..*]: set at post-build in variant post-build-loadable+post-build-selectable / pre-compile in variant pre-compile, destination=PduRTxBuffer  # Reference to a buffer that is allocated in the PduRTxBuffer. Having a global PDUR buffers list. Use a dedicated buffer for each routing.
            reference PduRDestPduPduRBswModulesRef [0..1]: set at post-build in variant post-build-loadable+post-build-selectable / pre-compile in variant pre-compile, origin=Vector Informatik, destination=PduRBswModules  # Dest Pdu PduRBswModules Ref | Related PduRBswModules of the PduR routing path destination Pdu.
            container PduRDefaultValue [0..1]  # Specifies the default value of the I-PDU. Only required for gateway operation and if at least one PDU specified by PduRDestPdu uses TriggerTransmit Data provision.
              container PduRDefaultValueElement [0..*]: post-build-changeable=true  # Each value element is represented by the element and the position in an array.
                integer PduRDefaultValueElement: 0..255, set at post-build in variant post-build-loadable+post-build-selectable / pre-compile in variant pre-compile, default-value=0  # The default value consists of a number of elements. Each element is one byte long and the number of elements is specified by SduLength. The position of this parameter in the container is specified by the PduRElementBytePosition parameter.
                integer PduRDefaultValueElementBytePosition: 0..255, set at post-build in variant post-build-loadable+post-build-selectable / pre-compile in variant pre-compile, default-value=0  # This parameter specifies the byte position of the element within the default value
          container PduRSrcPdu  # This container specifies the source of the PDU to be routed.
            integer PduRSourcePduHandleId: 0..65535, set at pre-compile, symbolic-name-value=true, default-value=0  # PDU identifier assigned by PDU Router.
            enumeration PduRSrcPduDirection: {RECEIVE, TRANSMIT, UNDEFINED}, set at post-build in variant post-build-loadable+post-build-selectable / pre-compile in variant pre-compile, origin=Vector Informatik, default-value=UNDEFINED  # PduR routing path source Pdu communication direction. RECEIVE: The routing path source is a reception Pdu. TRANSMIT: The routing path source is a transmission Pdu. UNDEFINED: The communication direction cannot be determined.
            reference PduRSrcPduRef: set at pre-compile, destination=Pdu  # This reference selects a source of the routing path.
            reference PduRSrcPduPduRBswModulesRef [0..1]: set at post-build in variant post-build-loadable+post-build-selectable / pre-compile in variant pre-compile, origin=Vector Informatik, destination=PduRBswModules  # Src Pdu PduRBswModules Ref | Related PduRBswModules of the PduR routing path source Pdu.
      container PduRTpBufferTable [0..0]  # Please add Tp Buffers to the PduRTxBufferTable. TpBufferTable is not used anymore!
        integer PduRMaxTpBufferNumber [0..0]: 0..0, set at pre-compile, default-value=0  # Please add Tp Buffers to the PduRTxBufferTable. TpBufferTable is not used anymore!
        container PduRTpBuffer [0..0]  # Please add Tp Buffers to the PduRTxBufferTable. TpBufferTable is not used anymore!
          integer PduRTpBufferLength [0..0]: 1..65535, set at post-build in variant post-build-loadable+post-build-selectable / pre-compile in variant pre-compile  # Length of the TP buffer in number of bytes
      container PduRTxBufferTable [0..1]  # This container contains the buffers used for gatewaying via communication interfaces and transport protocol.
        integer PduRMaxTxBufferNumber: 0..65535, set at pre-compile, default-value=0  # maximum number of Tx buffers.
        container PduRTxBuffer [0..*]: post-build-changeable=true  # Specifies a buffer used for communication interface and transport protocol gatway routing.
          integer PduRPduMaxLength: 1..65535, set at post-build in variant post-build-loadable+post-build-selectable / pre-compile in variant pre-compile  # Length of the Tx buffer in number of bytes. This parameter limits the size of buffered routed PDUs.
          integer PduRTxBufferDepth [0..0]: 1..67108864, set at post-build in variant post-build-loadable+post-build-selectable / pre-compile in variant pre-compile, default-value=1  # PduRTxBufferDepth is not used anymore. Use PduRDestPduQueueDepth instead. Number of Pdus that can be stored in the buffer. If value is 1 then the buffer semantic is "last is best". If the value is greater then 1 then the buffer semnatic is a FiFo. Hint:Maximum buffer depth is 67108864 to buffer up to 4GB for CANFD (67108864 * 64 Byte = 4294967295)
          reference PduRLockRef [0..1]: set at post-build in variant post-build-loadable+post-build-selectable / pre-compile in variant pre-compile, origin=MICROSAR, destination=PduRLock  # Reference to PduRLock with a PduRSpinLock manifestation. A reference is only required in a mutlicore usecase.
      container PduRDataPlaneTable [0..1]  # This container specifies the available DataPlanes.
        container PduRDataPlane [0..*]: post-build-changeable=true  # This container specifies the behavior of an PduR data plane. A data plane is used for dynamic learning of routing relations between communication sources (e.g. external testers) and communication destinations (e.g. diagnosed onboard ECUs).
          container PduRConnection [1..254]: post-build-changeable=true  # Specifies the communication relation between the communication sources (e.g. request transmitted by external tester) and related communication destinations (e.g. response transmitted by diagnosed onboard ECU).
            integer PduRConnectionHandleId: 1..254, set at pre-compile, origin=Vector Informatik, symbolic-name-value=true, default-value=1  # Connection handle ID
            reference PduRDestPduRef [1..*]: set at post-build in variant post-build-loadable+post-build-selectable / pre-compile in variant pre-compile, origin=Vector Informatik, destination=PduRDestPdu  # Related PduRRoutingPath/PduRDestPdus.
            reference PduRSrcPduRef [1..*]: set at post-build in variant post-build-loadable+post-build-selectable / pre-compile in variant pre-compile, origin=Vector Informatik, destination=PduRSrcPdu  # Related PduRRoutingPath/PduRSrcPdus.
          choice container PduRSwitchingStrategy: post-build-changeable=true  # Switching logic strategies.
            container PduRSaTaSwitchingStrategy [0..1]  # Switching strategy based on a source and target address. - Learn source address location (PduRConnection) from every received Pdu - Broadcast the received Pdu if the target address location is not yet known - Route the received Pdu to the learned location (PduRConnection) if the target address is already known
              choice container PduRSaTaCalculationStrategy  # Strategy used to determine the source- and target address of the Pdus.
                container PduRLinearTaToSaCalculationStrategy [0..1]  # The target address is the CAN ID of the received Pdu. The source address is calculated by adding/subtracting a offset to target address and application of a bit mask. Calculation: for Pdus referenced by PduRAddOffsetSrcPduRef: source address = ( target address + offset) & mask for Pdus referenced by PduRSubtractOffsetSrcPduRef: source address = ( target address - offset) & mask
                  integer PduROffset: 0..4294967295, set at post-build in variant post-build-loadable+post-build-selectable / pre-compile in variant pre-compile, origin=Vector Informatik, default-value=0  # Offset added to the target address.
                  integer PduRMask: 0..4294967295, set at post-build in variant post-build-loadable+post-build-selectable / pre-compile in variant pre-compile, origin=Vector Informatik, default-value=255  # Bit mask applied to the meta data of the received Pdus.
                  reference PduRAddOffsetSrcPduRef [1..*]: set at post-build in variant post-build-loadable+post-build-selectable / pre-compile in variant pre-compile, origin=Vector Informatik, destination=PduRSrcPdu  # Related Pdus where the calculation offset shall be added to the target address to determine the source address.
                  reference PduRSubtractOffsetSrcPduRef [1..*]: set at post-build in variant post-build-loadable+post-build-selectable / pre-compile in variant pre-compile, origin=Vector Informatik, destination=PduRSrcPdu  # Related Pdus where the calculation offset shall be subtracted from the target address to determine the source address.
                container PduRSaTaFromMetaDataCalculationStrategy [0..1]  # The source- and target address are determined from the Pdu meta data (e.g. the CAN ID) based on the configured start- and end bit positions.
                  integer PduRSaStartBitPosition: 0..31, set at post-build in variant post-build-loadable+post-build-selectable / pre-compile in variant pre-compile, origin=Vector Informatik, default-value=0  # Start bit position of the source address.
                  integer PduRSaEndBitPosition: 0..31, set at post-build in variant post-build-loadable+post-build-selectable / pre-compile in variant pre-compile, origin=Vector Informatik, default-value=0  # End bit position of the source address.
                  integer PduRTaStartBitPosition: 0..31, set at post-build in variant post-build-loadable+post-build-selectable / pre-compile in variant pre-compile, origin=Vector Informatik, default-value=0  # Start bit position of the target address.
                  integer PduRTaEndBitPosition: 0..31, set at post-build in variant post-build-loadable+post-build-selectable / pre-compile in variant pre-compile, origin=Vector Informatik, default-value=0  # End bit position of the target address.
      choice container PduRLock [0..*]  # Lock to protect shared memory.
        container PduRExclusiveArea [0..1]  # Exclusive Area that shall protect shared memory in a single core routing relation.
          integer PduRExclusiveAreaId: set at pre-compile, origin=MICROSAR, default-value=0  # Id of the ExclusiveArea that shall protect the shared memory.
        container PduRSpinLock [0..1]  # Spinlock to protect shared memory in multicore usescase. For each Spinlock a designated variable is created which must be locked by a user specific Appl_Get/ReleaseSpinlock function.
  module config PduR_Rec: definition=PduR
  module config PduR_Pre: definition=PduR
