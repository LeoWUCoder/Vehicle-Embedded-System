AUTOSAR XML (schema 4-2-1)
package /InitialEcuC
  ecuc value collection InitialEcuC: ecuc-values=[Dcm, Dem]
  module config Dcm: module-description=Dcm_Impl
    DcmConfigSet
      DcmGeneral
      DcmDsd
        DcmDsdServiceTable
          9 x DcmDsdService:
            DiagSessionControl: DcmDsdSidTabServiceId=16, DcmDsdSidTabSubfuncAvail=true
              3 x DcmDsdSubService:
                Default: DcmDsdSubServiceId=1
                Programming: DcmDsdSubServiceId=2, DcmDsdSubServiceSessionLevelRef=DcmDspSession/Programming, DcmDsdSubServiceSessionLevelRef=DcmDspSession/Extended
                Extended: DcmDsdSubServiceId=3
            EcuReset: DcmDsdSidTabServiceId=17, DcmDsdSidTabSubfuncAvail=true
              Hard (DcmDsdSubService): DcmDsdSubServiceId=1
            ClearDiagInfo: DcmDsdSidTabServiceId=20, DcmDsdSidTabSubfuncAvail=false
            ReadDtcInfo: DcmDsdSidTabServiceId=25, DcmDsdSidTabSubfuncAvail=true
              3 x DcmDsdSubService:
                RDTCBSM: DcmDsdSubServiceId=2
                RNODTCBSM: DcmDsdSubServiceId=1
                RDTCEDRBDN: DcmDsdSubServiceId=6
            ReadDataById: DcmDsdSidTabServiceId=34, DcmDsdSidTabSubfuncAvail=false
            SecurityAccess: DcmDsdSidTabServiceId=39, DcmDsdSidTabSubfuncAvail=true, DcmDsdSidTabSessionLevelRef=DcmDspSession/Programming, DcmDsdSidTabSessionLevelRef=DcmDspSession/Extended
              Seed_Level1_Request (DcmDsdSubService): DcmDsdSubServiceId=1, DcmDsdSubServiceSessionLevelRef=DcmDspSession/Programming, DcmDsdSubServiceSessionLevelRef=DcmDspSession/Extended
              Level1_1_Send (DcmDsdSubService): DcmDsdSubServiceId=2, DcmDsdSubServiceSessionLevelRef=DcmDspSession/Programming, DcmDsdSubServiceSessionLevelRef=DcmDspSession/Extended
            WriteDataById: DcmDsdSidTabServiceId=46, DcmDsdSidTabSubfuncAvail=false
            TesterPresent: DcmDsdSidTabServiceId=62, DcmDsdSidTabSubfuncAvail=true
              TesterPresent (DcmDsdSubService): DcmDsdSubServiceId=0
            ControlDtcSetting: DcmDsdSidTabServiceId=133, DcmDsdSidTabSubfuncAvail=true
              Enable (DcmDsdSubService): DcmDsdSubServiceId=1
              Disable (DcmDsdSubService): DcmDsdSubServiceId=2
      DcmDsp: DcmDspMaxDidToRead=5
        Diag_RWDI_LightOnOffCounter_LightOnOffCounter_Value (DcmDspData): DcmDspDataSize=32, DcmDspDataType=UINT32, DcmDspDataInfoRef=DataInfo_Diag_RWDI_LightOnOffCounter_LightOnOffCounter_Value
        DataInfo_Diag_RWDI_LightOnOffCounter_LightOnOffCounter_Value (DcmDspDataInfo): DcmDspDataFixedLength=true
        Diag_RWDI_LightOnOffCounter (DcmDspDid): DcmDspDidIdentifier=4096, DcmDspDidInfoRef=DidInfo_Diag_RWDI_LightOnOffCounter
          LightOnOffCounter_Value (DcmDspDidSignal): DcmDspDidDataPos=0, DcmDspDidDataRef=Diag_RWDI_LightOnOffCounter_LightOnOffCounter_Value
        DidInfo_Diag_RWDI_LightOnOffCounter (DcmDspDidInfo)
          DcmDspDidAccess
            DcmDspDidRead
            DcmDspDidWrite
        DcmDspControlDTCSetting: DcmSupportDTCSettingControlOptionRecord=true
        DcmDspSecurity
          Level_01 (DcmDspSecurityRow):
            DcmDspSecurityDelayTime = 10
            DcmDspSecurityDelayTimeOnBoot = 0
            DcmDspSecurityKeySize = 2
            DcmDspSecurityLevel = 1
            DcmDspSecurityNumAttDelay = 3
            DcmDspSecuritySeedSize = 2
        DcmDspSession
          3 x DcmDspSessionRow, all with DcmDspSessionP2ServerMax=0.05, DcmDspSessionP2StarServerMax=5:
            Default: DcmDspSessionLevel=1, DcmDspSessionForBoot=DCM_NO_BOOT
            Programming: DcmDspSessionLevel=2
            Extended: DcmDspSessionLevel=3, DcmDspSessionForBoot=DCM_NO_BOOT
  module config Dem: module-description=Dem_Impl
    DemConfigSet
      DTCClass_DTC_0x000002 (DemDTCClass): DemUdsDTC=2
      DTC_0x000002 (DemEventParameter): DemEventKind=DEM_EVENT_KIND_SWC, DemDTCClassRef=DTCClass_DTC_0x000002, DemExtendedDataClassRef=ExtendedDataClass_4f5344cd
        DemEventClass:
          DemAgingAllowed = false
          DemAgingCycleCounterThreshold = 1
          DemEventDestination = DEM_DTC_ORIGIN_PRIMARY_MEMORY
          DemEventPriority = 2
          DemAgingCycleRef = IgnitionCycle
          DemOperationCycleRef = IgnitionCycle
          DemDebounceAlgorithmClass
            DemDebounceCounterBased: DemDebounceCounterDecrementStepSize=1, DemDebounceCounterIncrementStepSize=1, DemDebounceCounterJumpDown=false, DemDebounceCounterJumpUp=true
    DemGeneral:
      DemAgingCycleCounterProcessing = DEM_PROCESS_AGINGCTR_INTERN
      DemDebounceCounterBasedSupport = true
      DemDtcStatusAvailabilityMask = 121
      DemMaxNumberEventEntryMirror = 0
      DemPTOSupport = false
      DemTypeOfFreezeFrameRecordNumeration = DEM_FF_RECNUM_CALCULATED
      ExtendedDataClass_4f5344cd (DemExtendedDataClass): DemExtendedDataRecordClassRef=OccurrenceCounter, DemExtendedDataRecordClassRef=OdometerValue
      OccurrenceCounter (DemExtendedDataRecordClass): DemExtendedDataRecordNumber=1, DemDataClassRef=OccurrenceCounter_OccurenceCounter
      OdometerValue (DemExtendedDataRecordClass): DemExtendedDataRecordNumber=2, DemDataClassRef=OdometerValue_OdometerValue
      IgnitionCycle (DemOperationCycle): DemOperationCycleType=DEM_OPCYC_IGNITION
      PowerCycle (DemOperationCycle): DemOperationCycleType=DEM_OPCYC_POWER
      OccurrenceCounter_OccurenceCounter (DemDataClass):
        DemDataElementDataSize = 4
        DemDataElementDataType = UINT32
        DemDataElementEndianness = LITTLE_ENDIAN
        DemDataElementUsePort = USE_DATA_CLIENT_SERVER_PORT
        DemDataElementStoreNonVolatile = true
      OdometerValue_OdometerValue (DemDataClass):
        DemDataElementDataSize = 4
        DemDataElementDataType = UINT32
        DemDataElementEndianness = LITTLE_ENDIAN
        DemDataElementUsePort = USE_DATA_CLIENT_SERVER_PORT
        DemDataElementStoreNonVolatile = true
