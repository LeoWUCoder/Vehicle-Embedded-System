AUTOSAR XML (schema 4-2-1)
package /TS_T40D2M10I1R0/Adc_ib_bswmd/BswModuleDescriptions
  bsw module description Adc
    bsw internal behavior AdcBehavior
      31 x exclusive area:
        ADC_EXCLUSIVE_AREA_{00..30}
