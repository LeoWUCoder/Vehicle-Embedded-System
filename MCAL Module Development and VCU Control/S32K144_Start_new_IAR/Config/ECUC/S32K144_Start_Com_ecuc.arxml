AUTOSAR XML (schema 4-2-1)
package /ActiveEcuC
  module config Com: implementation-config-variant=VARIANT-PRE-COMPILE, module-description=Com_Impl
    ComGeneration:
      ComOutOfBoundsWriteProtectionStrategy = NONE
      ComOutOfBoundsWriteSanitizer = false
      ComOutOfBoundsReadSanitizer = false
      ComReduceConstantData2Define = false
      ComBoolDataInArrayOfStructStrategy = BOOLEAN
      ComDeduplicateIndirectedData = true
      ComDataDeduplicationStrategy = WITH_CAST
      ComReduceBoolDataByNegationThreshold = 2
      ComReduceBoolDataByNumericalComparisonThreshold = 2
      ComReduceBoolDataByNumericalRelationThreshold = 2
      ComReduceBoolDataByNumericalOperandStrategy = WITH_ANY_VALUE
      ComReduceNumericalDataByOffsetThreshold = 2
      ComReduceNumericalDataByArraySubtractionThreshold = 2
      ComReduceDataByStreaming = false
      ComShortSymbols = false
      ComInterfacesForDeactivatedData = false
      ComReferringKeysInComments = false
    ComOptimization:
      ComTxCyclicProcessingISRLockThreshold = 1
      ComTxDeadlineMonitoringISRLockThreshold = 1
      ComTxProcessingISRLockThreshold = 1
      ComRxDeadlineMonitoringISRLockThreshold = 1
      ComRxDeferredProcessingISRLockThreshold = 1
      ComGatewayProcessingISRLockThreshold = 1
      ComGatewayDescriptionProcessingISRLockThreshold = 1
      ComIPduGroupISRLockThreshold = 1
    ComConfig: ComConfigurationId=0, ComRxDeferredNotificationCacheSize=1, ComRxImmediateNotificationCacheSize=0
      MyECU_oCAN00_Rx_4cbf71f7 (ComIPduGroup): ComIPduGroupHandleId=0
      sig_State_RearLeftDoor_omsg_Receive_oCAN00_84ad4140_Rx (ComSignal):
        ComBitPosition = 0
        ComBitSize = 1
        ComSignalEndianness = LITTLE_ENDIAN
        ComSignalInitValue = 0
        ComSignalType = BOOLEAN
        ComTimeout = 0
        ComSignalAccess = ACCESS_UNCLEAR
        ComHandleId = 4
        ComSystemTemplateSystemSignalRef = sig_State_RearLeftDoor
      sig_LampCnt_omsg_MyECU_Lamp_oCAN00_f37e68ea_Tx (ComSignal):
        ComBitPosition = 7
        ComBitSize = 8
        ComSignalEndianness = BIG_ENDIAN
        ComSignalInitValue = 0
        ComSignalType = UINT8
        ComTransferProperty = PENDING
        ComSignalAccess = ACCESS_UNCLEAR
        ComHandleId = 4
        ComSystemTemplateSystemSignalRef = sig_LampCnt
      ComTimeBase: ComRxTimeBase=0.01, ComTxTimeBase=0.01, ComGwTimeBase=0.01
      msg_Transmit_oCAN00_0723e95e_Tx (ComIPdu):
        ComIPduDirection = SEND
        ComIPduType = NORMAL
        ComIPduHandleId = 4
        ComIPduSignalProcessing = DEFERRED
        ComIPduCancellationSupport = false
        ComIPduGroupRef = MyECU_oCAN00_Tx_1ae5d671
        ComIPduSignalRef = sig_RearInteriorLight_omsg_Transmit_oCAN00_49a633c1_Tx
        ComPduIdRef = msg_Transmit_oCAN00_0723e95e_Tx
        ComTxIPdu: ComMinimumDelayTime=0, ComTxIPduUnusedAreasDefault=0
          ComTxModeTrue
            ComTxMode: ComTxModeMode=PERIODIC, ComTxModeTimeOffset=0, ComTxModeTimePeriod=0.1
          ComTxModeFalse
            ComTxMode: ComTxModeMode=PERIODIC, ComTxModeTimeOffset=0, ComTxModeTimePeriod=0.1
      sig_State_RearInteriorLight_omsg_Receive_oCAN00_63323183_Rx (ComSignal):
        ComBitPosition = 2
        ComBitSize = 1
        ComSignalEndianness = LITTLE_ENDIAN
        ComSignalInitValue = 0
        ComSignalType = BOOLEAN
        ComTimeout = 0
        ComSignalAccess = ACCESS_UNCLEAR
        ComHandleId = 3
        ComSystemTemplateSystemSignalRef = sig_State_RearInteriorLight
      sig_State_RearRightDoor_omsg_Receive_oCAN00_a8945098_Rx (ComSignal):
        ComBitPosition = 1
        ComBitSize = 1
        ComSignalEndianness = LITTLE_ENDIAN
        ComSignalInitValue = 0
        ComSignalType = BOOLEAN
        ComTimeout = 0
        ComSignalAccess = ACCESS_UNCLEAR
        ComHandleId = 5
        ComSystemTemplateSystemSignalRef = sig_State_RearRightDoor
      msg_Receive_oCAN00_2b456e3f_Rx (ComIPdu):
        ComIPduDirection = RECEIVE
        ComIPduType = NORMAL
        ComIPduHandleId = 1
        ComIPduSignalProcessing = DEFERRED
        ComIPduCancellationSupport = false
        ComIPduGroupRef = MyECU_oCAN00_Rx_4cbf71f7
        ComIPduSignalRef = sig_State_RearInteriorLight_omsg_Receive_oCAN00_63323183_Rx
        ComIPduSignalRef = sig_State_RearLeftDoor_omsg_Receive_oCAN00_84ad4140_Rx
        ComIPduSignalRef = sig_State_RearRightDoor_omsg_Receive_oCAN00_a8945098_Rx
        ComPduIdRef = msg_Receive_oCAN00_2b456e3f_Rx
      MyECU_oCAN00_Tx_1ae5d671 (ComIPduGroup): ComIPduGroupHandleId=1
      msg_MyECU_Lamp_oCAN00_818e1651_Tx (ComIPdu):
        ComIPduDirection = SEND
        ComIPduType = NORMAL
        ComIPduHandleId = 3
        ComIPduSignalProcessing = DEFERRED
        ComIPduCancellationSupport = false
        ComIPduGroupRef = MyECU_oCAN00_Tx_1ae5d671
        ComIPduSignalRef = sig_LampCnt_omsg_MyECU_Lamp_oCAN00_f37e68ea_Tx
        ComPduIdRef = msg_MyECU_Lamp_oCAN00_818e1651_Tx
        ComTxIPdu: ComMinimumDelayTime=0, ComTxIPduUnusedAreasDefault=0
          ComTxModeTrue
            ComTxMode: ComTxModeMode=PERIODIC, ComTxModeTimeOffset=0, ComTxModeTimePeriod=0.1
          ComTxModeFalse
            ComTxMode: ComTxModeMode=PERIODIC, ComTxModeTimeOffset=0, ComTxModeTimePeriod=0.1
      sig_RearInteriorLight_omsg_Transmit_oCAN00_49a633c1_Tx (ComSignal):
        ComBitPosition = 0
        ComBitSize = 1
        ComSignalEndianness = LITTLE_ENDIAN
        ComSignalInitValue = 0
        ComSignalType = BOOLEAN
        ComTransferProperty = PENDING
        ComSignalAccess = ACCESS_UNCLEAR
        ComHandleId = 5
        ComSystemTemplateSystemSignalRef = sig_RearInteriorLight
      Ignition_State (ComSignal):
        ComBitPosition = 0
        ComSignalEndianness = opaque
        ComSignalInitValue = 0
        ComSignalType = UINT8
        ComSignalAccess = ACCESS_NOT_NEEDED
        ComBitSize = 2
        ComTransferProperty = PENDING
      3 x ComIPdu, all with ComIPduType=NORMAL, ComIPduCancellationSupport=false:
        VCU_Com_Pdu: ComIPduDirection=SEND, ComIPduHandleId=0, ComIPduSignalProcessing=IMMEDIATE, ComPduIdRef=VCU_IPDU_ComTopdur, ComIPduSignalRef=Ignition_State
          ComTxIPdu: ComMinimumDelayTime=0, ComTxIPduUnusedAreasDefault=0
            ComTxModeFalse
              ComTxMode: ComTxModeMode=PERIODIC, ComTxModeTimeOffset=0, ComTxModeTimePeriod=0.1
            ComTxModeTrue
              ComTxMode: ComTxModeMode=PERIODIC, ComTxModeTimeOffset=0, ComTxModeTimePeriod=0.1
        VCU_Receive_oCAN00_ea3d327e_Rx: ComIPduDirection=RECEIVE, ComIPduHandleId=0, ComIPduSignalProcessing=DEFERRED, ComIPduGroupRef=MyECU_oCAN00_Rx_4cbf71f7, ComIPduSignalRef=VCU_CRASH_Mode_oVCU_Receive_oCAN00_5f8ab2fb_Rx, ComIPduSignalRef=VCU_Driving_Mode_oVCU_Receive_oCAN00_f4e075c7_Rx, ComIPduSignalRef=Vehicle_Speed_oVCU_Receive_oCAN00_b7e47cca_Rx, ComPduIdRef=VCU_Receive_oCAN00_ea3d327e_Rx
        VCU_Start_oCAN00_e045137b_Tx: ComIPduDirection=SEND, ComIPduHandleId=2, ComIPduSignalProcessing=DEFERRED, ComIPduGroupRef=MyECU_oCAN00_Tx_1ae5d671, ComIPduSignalRef=Brake_Signal_oVCU_Start_oCAN00_df96e3b4_Tx, ComIPduSignalRef=Drive_Standy_oVCU_Start_oCAN00_2617feb5_Tx, ComIPduSignalRef=VCU_Accelerator_Pedal_Position_oVCU_Start_oCAN00_a7808b9c_Tx, ComPduIdRef=VCU_Start_oCAN00_e045137b_Tx
          ComTxIPdu: ComMinimumDelayTime=0, ComTxIPduUnusedAreasDefault=0
            ComTxModeTrue
              ComTxMode: ComTxModeMode=MIXED, ComTxModeTimeOffset=0, ComTxModeTimePeriod=0.5, ComTxModeNumberOfRepetitions=4, ComTxModeRepetitionPeriod=0.1
            ComTxModeFalse
              ComTxMode: ComTxModeMode=NONE
      7 x ComSignal, all with ComSignalEndianness=LITTLE_ENDIAN, ComSignalInitValue=0, ComSignalAccess=ACCESS_UNCLEAR:
        Vehicle_Speed_oVCU_Receive_oCAN00_b7e47cca_Rx: ComBitPosition=0, ComBitSize=16, ComSignalType=UINT16, ComTimeout=0, ComHandleId=2, ComSystemTemplateSystemSignalRef=Vehicle_Speed
        VCU_Accelerator_Pedal_Position_oVCU_Start_oCAN00_a7808b9c_Tx: ComBitPosition=0, ComBitSize=12, ComSignalType=UINT16, ComTransferProperty=PENDING, ComHandleId=2, ComSystemTemplateSystemSignalRef=VCU_Accelerator_Pedal_Position
        Drive_Standy_oVCU_Start_oCAN00_2617feb5_Tx: ComBitPosition=16, ComBitSize=16, ComSignalType=UINT16, ComTransferProperty=TRIGGERED, ComHandleId=1, ComSystemTemplateSystemSignalRef=Drive_Standy
        VCU_Driving_Mode_oVCU_Receive_oCAN00_f4e075c7_Rx: ComBitPosition=16, ComBitSize=4, ComSignalType=UINT8, ComTimeout=0, ComHandleId=1, ComSystemTemplateSystemSignalRef=VCU_Driving_Mode
        Brake_Signal_oVCU_Start_oCAN00_df96e3b4_Tx: ComBitPosition=12, ComBitSize=1, ComSignalType=UINT8, ComTransferProperty=PENDING, ComHandleId=0, ComSystemTemplateSystemSignalRef=Brake_Signal
        VCU_CRASH_Mode_oVCU_Receive_oCAN00_5f8ab2fb_Rx: ComBitPosition=20, ComBitSize=4, ComSignalType=UINT8, ComTimeout=0.3, ComHandleId=0, ComFirstTimeout=1, ComInvalidNotification=, ComRxDataTimeoutAction=NONE, ComTimeoutNotification=Crash_fault, ComNotification=Crash_Success, ComSystemTemplateSystemSignalRef=VCU_CRASH_Mode
        VCU_Ingition_Mode_oVCU_Ingition_oCAN00_54fb8254_Tx: ComBitPosition=0, ComBitSize=2, ComSignalType=SINT8, ComTransferProperty=PENDING, ComHandleId=3, ComSystemTemplateSystemSignalRef=VCU_Ingition_Mode
      VCU_Ingition_oCAN00_98de77c4_Tx (ComIPdu):
        ComIPduDirection = SEND
        ComIPduType = NORMAL
        ComIPduHandleId = 1
        ComIPduSignalProcessing = IMMEDIATE
        ComIPduCancellationSupport = false
        ComIPduGroupRef = MyECU_oCAN00_Tx_1ae5d671
        ComIPduSignalRef = VCU_Ingition_Mode_oVCU_Ingition_oCAN00_54fb8254_Tx
        ComPduIdRef = VCU_Ingition_oCAN00_98de77c4_Tx
        ComTxIPdu: ComMinimumDelayTime=0, ComTxIPduUnusedAreasDefault=0
          ComTxModeTrue
            ComTxMode: ComTxModeMode=NONE
          ComTxModeFalse
            ComTxMode: ComTxModeMode=PERIODIC, ComTxModeTimePeriod=0.1, ComTxModeTimeOffset=0
    ComGeneral:
      ComConfigurationUseDet = true
      ComEnableSignalGroupArrayApi = false
      ComRetryFailedTransmitRequests = false
      ComSupportedIPduGroups = 2
      ComVersionInfoApi = false
      ComAdvancedIPduCallouts = true
      ComOptimizedIPduGroupHandling = false
      ComMetaDataSupport = false
      ComReceiveSignalMacroAPI = false
      ComDeferredEventCacheSupport = false
      ComMainfunctionTimingDomainSupport = false
      ComDescriptionRoutingCodeGeneration = false
      ComSafeBswChecks = false
      ComUserCbkHeaderFile = Appl_Cbk.h
